/dts-v1/;

/ {
	model = "MT6761";
	compatible = "mediatek,MT6761";
	interrupt-parent = <0x01>;
	#address-cells = <0x02>;
	#size-cells = <0x02>;

	chosen {
		bootargs = "console=tty0 console=ttyS0,921600n1 vmalloc=400M \t\t\t\tslub_debug=OFZPU page_owner=on \t\t\t\tswiotlb=noforce \t\t\t\tcgroup.memory=nosocket,nokmem \t\t\t\tandroidboot.hardware=mt6761 \t\t\t\tmaxcpus=8 loop.max_part=7 \t\t\t\tfirmware_class.path=/vendor/firmware";
		phandle = <0x26>;
	};

	opp_table0 {
		compatible = "operating-points-v2";
		opp-shared;
		phandle = <0x02>;

		opp0 {
			opp-hz = <0x00 0x32a9f880>;
			opp-microvolt = <0x9eb10>;
		};

		opp1 {
			opp-hz = <0x00 0x36b79180>;
			opp-microvolt = <0xa344e>;
		};

		opp2 {
			opp-hz = <0x00 0x3ad46cc0>;
			opp-microvolt = <0xa7d8c>;
		};

		opp3 {
			opp-hz = <0x00 0x3ef14800>;
			opp-microvolt = <0xac6ca>;
		};

		opp4 {
			opp-hz = <0x00 0x430e2340>;
			opp-microvolt = <0xb1008>;
		};

		opp5 {
			opp-hz = <0x00 0x487ab000>;
			opp-microvolt = <0xb71b0>;
		};

		opp6 {
			opp-hz = <0x00 0x4df67f00>;
			opp-microvolt = <0xbd358>;
		};

		opp7 {
			opp-hz = <0x00 0x53724e00>;
			opp-microvolt = <0xc3500>;
		};

		opp8 {
			opp-hz = <0x00 0x57616280>;
			opp-microvolt = <0xc96a8>;
		};

		opp9 {
			opp-hz = <0x00 0x5b5fb940>;
			opp-microvolt = <0xcf850>;
		};

		opp10 {
			opp-hz = <0x00 0x61559a40>;
			opp-microvolt = <0xd8acc>;
		};

		opp11 {
			opp-hz = <0x00 0x6553f100>;
			opp-microvolt = <0xdec74>;
		};

		opp12 {
			opp-hz = <0x00 0x695247c0>;
			opp-microvolt = <0xe4e1c>;
		};

		opp13 {
			opp-hz = <0x00 0x6d509e80>;
			opp-microvolt = <0xeafc4>;
		};

		opp14 {
			opp-hz = <0x00 0x72431940>;
			opp-microvolt = <0xf29d6>;
		};

		opp15 {
			opp-hz = <0x00 0x7744d640>;
			opp-microvolt = <0xfa3e8>;
		};
	};

	cpus {
		#address-cells = <0x01>;
		#size-cells = <0x00>;

		cpu@000 {
			device_type = "cpu";
			compatible = "arm,cortex-a53";
			reg = <0x00>;
			enable-method = "psci";
			clock-frequency = <0x8b799100>;
			operating-points-v2 = <0x02>;
			dynamic-power-coefficient = <0x113>;
			capacity-dmips-mhz = <0x400>;
			cpu-idle-states = <0x03 0x04 0x05 0x06 0x07 0x08 0x09>;
			phandle = <0x0a>;
		};

		cpu@001 {
			device_type = "cpu";
			compatible = "arm,cortex-a53";
			reg = <0x01>;
			enable-method = "psci";
			clock-frequency = <0x8b799100>;
			operating-points-v2 = <0x02>;
			dynamic-power-coefficient = <0x113>;
			capacity-dmips-mhz = <0x400>;
			cpu-idle-states = <0x03 0x04 0x05 0x06 0x07 0x08 0x09>;
			phandle = <0x0b>;
		};

		cpu@002 {
			device_type = "cpu";
			compatible = "arm,cortex-a53";
			reg = <0x02>;
			enable-method = "psci";
			clock-frequency = <0x8b799100>;
			operating-points-v2 = <0x02>;
			dynamic-power-coefficient = <0x113>;
			capacity-dmips-mhz = <0x400>;
			cpu-idle-states = <0x03 0x04 0x05 0x06 0x07 0x08 0x09>;
			phandle = <0x0c>;
		};

		cpu@003 {
			device_type = "cpu";
			compatible = "arm,cortex-a53";
			reg = <0x03>;
			enable-method = "psci";
			clock-frequency = <0x8b799100>;
			operating-points-v2 = <0x02>;
			dynamic-power-coefficient = <0x113>;
			capacity-dmips-mhz = <0x400>;
			cpu-idle-states = <0x03 0x04 0x05 0x06 0x07 0x08 0x09>;
			phandle = <0x0d>;
		};

		cpu-map {

			cluster0 {

				core0 {
					cpu = <0x0a>;
				};

				core1 {
					cpu = <0x0b>;
				};

				core2 {
					cpu = <0x0c>;
				};

				core3 {
					cpu = <0x0d>;
				};
			};
		};

		idle-states {
			entry-method = "arm,psci";

			standby {
				compatible = "arm,idle-state";
				arm,psci-suspend-param = <0x01>;
				entry-latency-us = <0x258>;
				exit-latency-us = <0x258>;
				min-residency-us = <0x4b0>;
				phandle = <0x03>;
			};

			mcdi-cpu {
				compatible = "arm,idle-state";
				arm,psci-suspend-param = <0x10001>;
				entry-latency-us = <0x258>;
				exit-latency-us = <0x258>;
				min-residency-us = <0x4b0>;
				phandle = <0x04>;
			};

			mcdi-cluster {
				compatible = "arm,idle-state";
				arm,psci-suspend-param = <0x1010001>;
				entry-latency-us = <0x258>;
				exit-latency-us = <0x258>;
				min-residency-us = <0x4b0>;
				phandle = <0x05>;
			};

			sodi {
				compatible = "arm,idle-state";
				arm,psci-suspend-param = <0x1010002>;
				entry-latency-us = <0x320>;
				exit-latency-us = <0x3e8>;
				min-residency-us = <0x7d0>;
				phandle = <0x06>;
			};

			sodi3 {
				compatible = "arm,idle-state";
				arm,psci-suspend-param = <0x1010003>;
				entry-latency-us = <0x320>;
				exit-latency-us = <0x3e8>;
				min-residency-us = <0x7d0>;
				phandle = <0x07>;
			};

			dpidle {
				compatible = "arm,idle-state";
				arm,psci-suspend-param = <0x1010004>;
				entry-latency-us = <0x320>;
				exit-latency-us = <0x3e8>;
				min-residency-us = <0x7d0>;
				phandle = <0x08>;
			};

			suspend {
				compatible = "arm,idle-state";
				arm,psci-suspend-param = <0x1010005>;
				entry-latency-us = <0x320>;
				exit-latency-us = <0x3e8>;
				min-residency-us = <0x7d0>;
				phandle = <0x09>;
			};
		};
	};

	psci {
		compatible = "arm,psci-1.0";
		method = "smc";
	};

	pmu {
		compatible = "arm,cortex-a7-pmu";
		interrupt-parent = <0x0e>;
		interrupts = <0x01 0x07 0x08>;
	};

	l2c_parity {
		compatible = "mediatek,l2c_parity-v1";
		interrupts = <0x00 0x00 0x04>;
	};

	memory {
		device_type = "memory";
		reg = <0x00 0x40000000 0x00 0x20000000>;
	};

	reserved-memory {
		#address-cells = <0x02>;
		#size-cells = <0x02>;
		ranges;

		reserve-memory-sspm_share {
			compatible = "mediatek,reserve-memory-sspm_share";
			no-map;
			status = "okay";
			size = <0x00 0x110000>;
			alignment = <0x00 0x10000>;
			alloc-ranges = <0x00 0x40000000 0x00 0x60000000>;
		};

		reserve-memory-scp_share {
			compatible = "mediatek,reserve-memory-scp_share";
			no-map;
			size = <0x00 0x300000>;
			alignment = <0x00 0x1000000>;
			alloc-ranges = <0x00 0x40000000 0x00 0x50000000>;
		};

		consys-reserve-memory {
			compatible = "mediatek,consys-reserve-memory";
			no-map;
			size = <0x00 0x400000>;
			alignment = <0x00 0x1000000>;
			alloc-ranges = <0x00 0x40000000 0x00 0x80000000>;
			phandle = <0x48>;
		};

		wifi-reserve-memory {
			compatible = "shared-dma-pool";
			no-map;
			size = <0x00 0x300000>;
			alignment = <0x00 0x1000000>;
			alloc-ranges = <0x00 0x40000000 0x00 0x80000000>;
			phandle = <0x49>;
		};

		soter-shared-mem {
			compatible = "microtrust,shared_mem";
			no-map;
			size = <0x00 0x200000>;
			alignment = <0x00 0x200000>;
			alloc-ranges = <0x00 0x40000000 0x00 0x50000000>;
		};
	};

	utos {
		compatible = "microtrust,utos";
		interrupts = <0x00 0xbc 0x01 0x00 0xbd 0x01>;
	};

	utos_tester {
		compatible = "microtrust,tester-v1";
	};

	cpu_dbgapb@0d410000 {
		compatible = "mediatek,hw_dbg";
		num = <0x08>;
		reg = <0x00 0xd410000 0x00 0x1000 0x00 0xd510000 0x00 0x1000 0x00 0xd610000 0x00 0x1000 0x00 0xd710000 0x00 0x1000 0x00 0xd810000 0x00 0x1000 0x00 0xd910000 0x00 0x1000 0x00 0xda10000 0x00 0x1000 0x00 0xdb10000 0x00 0x1000>;
		phandle = <0x64>;
	};

	atf_logger {
		compatible = "mediatek,atf_logger";
		interrupts = <0x00 0x4e 0x01>;
	};

	amms_control {
		compatible = "mediatek,amms";
		interrupts = <0x00 0x43 0x01>;
	};

	interrupt-controller@0c000000 {
		compatible = "arm,gic-v3";
		#interrupt-cells = <0x03>;
		#address-cells = <0x02>;
		#size-cells = <0x02>;
		#redistributor-regions = <0x01>;
		interrupt-parent = <0x0e>;
		interrupt-controller;
		reg = <0x00 0xc000000 0x00 0x40000 0x00 0xc080000 0x00 0x200000 0x00 0x10200a80 0x00 0x50>;
		interrupts = <0x01 0x09 0x04>;
		phandle = <0x0e>;
	};

	intpol-controller@10200a80 {
		compatible = "mediatek,mt6577-sysirq";
		interrupt-controller;
		#interrupt-cells = <0x03>;
		interrupt-parent = <0x0e>;
		reg = <0x00 0x10200a80 0x00 0x50>;
		phandle = <0x01>;
	};

	infracfg_ao@10001000 {
		compatible = "mediatek,common-infracfg_ao\0mediatek,mt6761-infracfg\0syscon";
		reg = <0x00 0x10001000 0x00 0x1000>;
		interrupts = <0x00 0x5b 0x01>;
		#clock-cells = <0x01>;
		phandle = <0x22>;
	};

	mcdi@0010fc00 {
		compatible = "mediatek,mt6761-mcdi";
		reg = <0x00 0x10fc00 0x00 0x800>;
	};

	scpsys@10001000 {
		compatible = "mediatek,mt6761-scpsys\0syscon";
		reg = <0x00 0x10001000 0x00 0x1000 0x00 0x10006000 0x00 0x1000 0x00 0x14002000 0x00 0x1000 0x00 0x1020e000 0x00 0x1000 0x00 0x18004000 0x00 0x1000>;
		clocks = <0x0f 0x6b 0x0f 0x6d 0x10 0x15 0x10 0x16 0x10 0x13 0x10 0x14 0x11 0x00 0x11 0x01 0x10 0x19 0x10 0x18>;
		clock-names = "mm\0mfg\0mm-0\0mm-1\0mm-2\0mm-3\0cam-0\0cam-1\0cam-2\0cam-3";
		#clock-cells = <0x01>;
		phandle = <0x34>;
	};

	scp_infra@10001000 {
		compatible = "mediatek,scpinfra";
		reg = <0x00 0x10001000 0x00 0x1000>;
		phandle = <0x65>;
	};

	topckgen@10000000 {
		compatible = "mediatek,mt6761-topckgen\0syscon";
		reg = <0x00 0x10000000 0x00 0x1000>;
		#clock-cells = <0x01>;
		phandle = <0x0f>;
	};

	dcm@10001000 {
		compatible = "mediatek,mt6761-dcm";
		reg = <0x00 0x10001000 0x00 0x1000 0x00 0x10200000 0x00 0x4000 0x00 0x10228000 0x00 0x2000 0x00 0x1022a000 0x00 0x2000 0x00 0x10230000 0x00 0x2000 0x00 0x10232000 0x00 0x2000 0x00 0x1022d000 0x00 0x1000 0x00 0x10235000 0x00 0x1000>;
		reg-names = "infra_ao\0mcucfg\0ddrphy0_ao\0dramc0_ao\0ddrphy1_ao\0dramc1_ao\0emi_ch0\0emi_ch1";
		phandle = <0x66>;
	};

	io_cfg_lt@10002000 {
		compatible = "mediatek,io_cfg_lt";
		reg = <0x00 0x10002000 0x00 0x200>;
		phandle = <0x17>;
	};

	io_cfg_lm@10002200 {
		compatible = "mediatek,io_cfg_lm";
		reg = <0x00 0x10002200 0x00 0x200>;
		phandle = <0x18>;
	};

	io_cfg_lb@10002400 {
		compatible = "mediatek,io_cfg_lb";
		reg = <0x00 0x10002400 0x00 0x200>;
		phandle = <0x19>;
	};

	io_cfg_bl@10002600 {
		compatible = "mediatek,io_cfg_bl";
		reg = <0x00 0x10002600 0x00 0x200>;
		phandle = <0x1a>;
	};

	io_cfg_rr@10002800 {
		compatible = "mediatek,io_cfg_rr";
		reg = <0x00 0x10002800 0x00 0x200>;
		phandle = <0x1b>;
	};

	io_cfg_rb@10002a00 {
		compatible = "mediatek,io_cfg_rb";
		reg = <0x00 0x10002a00 0x00 0x200>;
		phandle = <0x1c>;
	};

	io_cfg_rt@10002c00 {
		compatible = "mediatek,io_cfg_rt";
		reg = <0x00 0x10002c00 0x00 0x200>;
		phandle = <0x1d>;
	};

	pericfg@10003000 {
		compatible = "mediatek,pericfg\0syscon";
		reg = <0x00 0x10003000 0x00 0x1000>;
		#clock-cells = <0x01>;
		phandle = <0x67>;
	};

	efuse_dbg@10004000 {
		compatible = "mediatek,efuse_dbg";
		reg = <0x00 0x10004000 0x00 0x1000>;
	};

	smart_pa {
		phandle = <0x68>;
	};

	tcpc_pd {
		phandle = <0x69>;
	};

	md1_sim1_hot_plug_eint {
		phandle = <0x6a>;
	};

	md1_sim2_hot_plug_eint {
		phandle = <0x6b>;
	};

	gpio {
		compatible = "mediatek,gpio_usage_mapping";
		phandle = <0x6c>;
	};

	gpio@10005000 {
		compatible = "mediatek,gpio\0syscon";
		reg = <0x00 0x10005000 0x00 0x1000>;
		phandle = <0x16>;
	};

	syscfg_pctl_0@10005000 {
		compatible = "mediatek,mt6761-pctl-0-syscfg\0syscon";
		reg = <0x00 0x10005000 0x00 0x1000>;
		phandle = <0x6d>;
	};

	sleep@10006000 {
		compatible = "mediatek,sleep\0syscon";
		mediatek,pwrap-regmap = <0x12>;
		reg = <0x00 0x10006000 0x00 0x1000>;
		interrupts = <0x00 0x7d 0x08>;
		wakeup-source = <0x13 0x00 0x04 0x14 0x01 0x20 0x15 0x03 0x2000000>;
		phandle = <0x62>;
	};

	eint@1000b000 {
		compatible = "mediatek,eint";
		reg = <0x00 0x1000b000 0x00 0x1000>;
		phandle = <0x6e>;
	};

	pinctrl@10005000 {
		compatible = "mediatek,mt6761-pinctrl";
		reg_bases = <0x16 0x17 0x18 0x19 0x1a 0x1b 0x1c 0x1d>;
		pins-are-numbered;
		gpio-controller;
		gpio-ranges = <0x1e 0x00 0x00 0xb3>;
		#gpio-cells = <0x02>;
		interrupt-controller;
		#interrupt-cells = <0x02>;
		interrupts = <0x00 0x73 0x04>;
		interrupt-parent = <0x0e>;
		phandle = <0x1e>;

		msdc0@default {
			phandle = <0x4b>;

			pins_cmd {
				drive-strength = [03];
			};

			pins_dat {
				drive-strength = [03];
			};

			pins_clk {
				drive-strength = [03];
			};

			pins_rst {
				drive-strength = [03];
			};

			pins_ds {
				drive-strength = [03];
			};
		};

		msdc0@hs400 {
			phandle = <0x4c>;

			pins_cmd {
				drive-strength = [03];
			};

			pins_dat {
				drive-strength = [04];
			};

			pins_clk {
				drive-strength = [04];
			};

			pins_rst {
				drive-strength = [03];
			};

			pins_ds {
				drive-strength = [04];
			};
		};

		msdc0@hs200 {
			phandle = <0x4d>;

			pins_cmd {
				drive-strength = [03];
			};

			pins_dat {
				drive-strength = [04];
			};

			pins_clk {
				drive-strength = [04];
			};

			pins_rst {
				drive-strength = [03];
			};

			pins_ds {
				drive-strength = [04];
			};
		};

		msdc0@register_default {
			cmd_edge = [00];
			rdata_edge = [00];
			wdata_edge = [00];
			phandle = <0x4e>;
		};

		msdc1@default {
			phandle = <0x50>;

			pins_cmd {
				drive-strength = [03];
			};

			pins_dat {
				drive-strength = [03];
			};

			pins_clk {
				drive-strength = [03];
			};
		};

		msdc1@sdr104 {
			phandle = <0x51>;

			pins_cmd {
				drive-strength = [03];
			};

			pins_dat {
				drive-strength = [03];
			};

			pins_clk {
				drive-strength = [03];
			};
		};

		msdc1@sdr50 {
			phandle = <0x52>;

			pins_cmd {
				drive-strength = [03];
			};

			pins_dat {
				drive-strength = [03];
			};

			pins_clk {
				drive-strength = [03];
			};
		};

		msdc1@ddr50 {
			phandle = <0x53>;

			pins_cmd {
				drive-strength = [03];
			};

			pins_dat {
				drive-strength = [03];
			};

			pins_clk {
				drive-strength = [03];
			};
		};

		msdc1@register_default {
			cmd_edge = [00];
			rdata_edge = [00];
			wdata_edge = [00];
			phandle = <0x54>;
		};

		msdc3@default {
			phandle = <0x6f>;

			pins_cmd {
				drive-strength = [04];
			};

			pins_dat {
				drive-strength = [04];
			};

			pins_clk {
				drive-strength = [04];
			};
		};

		msdc3@register_default {
			cmd_edge = [01];
			rdata_edge = [01];
			wdata_edge = [01];
			phandle = <0x70>;
		};

		dualdefault {
			phandle = <0x5f>;
		};

		dual_high {
			phandle = <0x60>;

			pins_cmd_dat {
				pinmux = <0xb100>;
				input-enable;
				slew-rate = <0x00>;
				bias-disable;
			};
		};

		dual_low {
			phandle = <0x61>;

			pins_cmd_dat {
				pinmux = <0xb100>;
				slew-rate = <0x01>;
				output-low;
			};
		};
	};

	toprgu@10007000 {
		compatible = "mediatek,mt6761-wdt\0mediatek,mt6589-wdt\0mediatek,toprgu\0syscon\0simple-mfd";
		reg = <0x00 0x10007000 0x00 0x1000>;
		interrupts = <0x00 0x53 0x00>;
		#reset-cells = <0x01>;
		phandle = <0x43>;

		reboot-mode {
			compatible = "syscon-reboot-mode";
			offset = <0x24>;
			mask = <0x0f>;
			mode-charger = <0x01>;
			mode-recovery = <0x02>;
			mode-bootloader = <0x03>;
			mode-dm-verity-dev-corrupt = <0x04>;
			mode-kpoc = <0x05>;
			mode-ddr-reserve = <0x06>;
			mode-meta = <0x07>;
			mode-rpmbpk = <0x08>;
		};
	};

	chipid@08000000 {
		compatible = "mediatek,chipid";
		reg = <0x00 0x8000000 0x00 0x04 0x00 0x8000004 0x00 0x04 0x00 0x8000008 0x00 0x04 0x00 0x800000c 0x00 0x04>;
	};

	mobicore {
		compatible = "trustonic,mobicore";
		interrupts = <0x00 0xc2 0x01>;
	};

	tkcore {
		compatible = "trustkernel,tkcore";
		interrupts = <0x00 0xc4 0x01>;
	};

	timer {
		compatible = "arm,armv8-timer";
		interrupt-parent = <0x0e>;
		interrupts = <0x01 0x0d 0x08 0x01 0x0e 0x08 0x01 0x0b 0x08 0x01 0x0a 0x08>;
		clock-frequency = <0xc65d40>;
	};

	clocks {

		clk26m {
			compatible = "fixed-clock";
			#clock-cells = <0x00>;
			clock-frequency = <0x18cba80>;
			phandle = <0x21>;
		};

		clk13m {
			compatible = "fixed-clock";
			#clock-cells = <0x00>;
			clock-frequency = <0xc65d40>;
			phandle = <0x30>;
		};

		clk32k {
			compatible = "fixed-clock";
			#clock-cells = <0x00>;
			clock-frequency = <0x7d00>;
			phandle = <0x71>;
		};
	};

	hacc@1000a000 {
		compatible = "mediatek,hacc";
		reg = <0x00 0x1000a000 0x00 0x1000>;
		interrupts = <0x00 0x85 0x08>;
	};

	apirq@1000b000 {
		compatible = "mediatek,apirq";
		reg = <0x00 0x1000b000 0x00 0x1000>;
		interrupts = <0x00 0x73 0x04>;
	};

	regulator_vibrator {
		compatible = "regulator-vibrator";
		min-volt = <0x231860>;
		max-volt = <0x30d400>;
		min-limit = <0x0f>;
		max-limit = <0x3a98>;
		vib-supply = <0x1f>;
	};

	apmixed@1000c000 {
		compatible = "mediatek,mt6761-apmixedsys\0syscon";
		reg = <0x00 0x1000c000 0x00 0xe00>;
		#clock-cells = <0x01>;
		phandle = <0x20>;
	};

	fhctl@1000ce00 {
		compatible = "mediatek,mt6761-fhctl";
		reg = <0x00 0x1000ce00 0x00 0x100>;
		mediatek,apmixed = <0x20>;
		phandle = <0x72>;

		armpll {
			mediatek,fh-id = <0x00>;
			mediatek,fh-pll-id = <0x00>;
			mediatek,fh-cpu-pll;
		};

		mainpll {
			mediatek,fh-id = <0x01>;
			mediatek,fh-pll-id = <0x01>;
		};

		msdcpll {
			mediatek,fh-id = <0x02>;
			mediatek,fh-pll-id = <0x05>;
		};

		mfgpll {
			mediatek,fh-id = <0x03>;
			mediatek,fh-pll-id = <0x02>;
		};

		mpll {
			mediatek,fh-id = <0x05>;
			mediatek,fh-pll-id = <0x07>;
		};

		mmpll {
			mediatek,fh-id = <0x06>;
			mediatek,fh-pll-id = <0x03>;
		};
	};

	pwrap@1000d000 {
		compatible = "mediatek,mt6761-pwrap\0syscon";
		reg = <0x00 0x1000d000 0x00 0x1000>;
		reg-names = "pwrap";
		interrupts = <0x00 0x7b 0x04>;
		clocks = <0x21 0x22 0x02 0x0f 0x85>;
		clock-names = "spi\0wrap\0ulposc";
		phandle = <0x12>;

		main_pmic {
			compatible = "mediatek,mt6357";
			interrupt-controller;
			#interrupt-cells = <0x02>;
			interrupt-parent = <0x1e>;
			interrupts = <0x90 0x04 0x90 0x00>;
			phandle = <0x2c>;

			mtk_battery_oc_throttling {
				compatible = "mediatek,mt6357-battery_oc_throttling";
				oc-thd-h = <0x123e>;
				oc-thd-l = <0x157c>;
			};

			pmic_accdet {
				compatible = "mediatek,mt6357-accdet";
				accdet-name = "mt63xx-accdet";
				accdet-mic-vol = <0x06>;
				accdet-plugout-debounce = <0x01>;
				accdet-mic-mode = <0x01>;
				headset-mode-setting = <0x500 0x500 0x01 0x1f0 0x800 0x800 0x20 0x44>;
				headset-eint-level-pol = <0x08>;
				headset-use-ap-eint = <0x00>;
				headset-eint-num = <0x00>;
				headset-eint-trig-mode = <0x00>;
				headset-key-mode = <0x00>;
				headset-three-key-threshold = <0x00 0x50 0xdc 0x190>;
				headset-three-key-threshold-CDD = <0x00 0x79 0xc0 0x258>;
				headset-four-key-threshold = <0x00 0x3a 0x79 0xc0 0x190>;
				io-channels = <0x23 0x09>;
				io-channel-names = "pmic_accdet";
				nvmem = <0x24>;
				nvmem-names = "mt63xx-accdet-efuse";
				status = "okay";
				phandle = <0x73>;
			};

			mt6357keys {
				compatible = "mediatek,mt6357-keys";
				mediatek,long-press-mode = <0x01>;
				power-off-time-sec = <0x00>;
				phandle = <0x74>;

				power {
					linux,keycodes = <0x74>;
					wakeup-source;
				};

				google {
					linux,keycodes = <0xc4>;
				};
			};

			pmic_auxadc {
				compatible = "mediatek,pmic-auxadc\0mediatek,mt6357-auxadc";
				#io-channel-cells = <0x01>;
				#interconnect-cells = <0x01>;
				phandle = <0x23>;

				batadc {
					channel = <0x00>;
					resistance-ratio = <0x03 0x01>;
					avg-num = <0x80>;
				};

				isense {
					channel = <0x01>;
					resistance-ratio = <0x03 0x01>;
					avg-num = <0x80>;
				};

				vcdt {
					channel = <0x02>;
				};

				bat_temp {
					channel = <0x03>;
					resistance-ratio = <0x01 0x01>;
				};

				chip_temp {
					channel = <0x05>;
				};

				vcore_temp {
					channel = <0x06>;
				};

				vproc_temp {
					channel = <0x07>;
				};

				accdet {
					channel = <0x09>;
				};

				tsx_temp {
					channel = <0x0b>;
					avg-num = <0x80>;
				};

				hpofs_cal {
					channel = <0x0c>;
					avg-num = <0x100>;
				};

				dcxo_temp {
					channel = <0x0d>;
					avg-num = <0x10>;
				};

				vbif {
					channel = <0x0e>;
					resistance-ratio = <0x01 0x01>;
				};

				imp {
					channel = <0x0f>;
					resistance-ratio = <0x03 0x01>;
					avg-num = <0x80>;
				};

				imix_r {
					channel = <0x10>;
				};
			};

			mtk_gauge {
				compatible = "mediatek,mt6357-gauge";
				charger = <0x25>;
				bootmode = <0x26>;
				io-channels = <0x23 0x03 0x23 0x00 0x23 0x0e 0x23 0x0f 0x23 0x10 0x23 0x01 0x27 0x03>;
				io-channel-names = "pmic_battery_temp\0pmic_battery_voltage\0pmic_bif_voltage\0pmic_ptim_voltage\0pmic_ptim_r\0pmic_isense_voltage\0batteryID-channel";
				nvmem-cells = <0x28 0x29>;
				nvmem-cell-names = "initialization\0state-of-charge";
				DIFFERENCE_FULLOCV_ITH = <0xc8>;
				SHUTDOWN_1_TIME = <0x1e>;
				KEEP_100_PERCENT = <0x01>;
				R_FG_VALUE = <0x0a>;
				EMBEDDED_SEL = <0x01>;
				PMIC_SHUTDOWN_CURRENT = <0x14>;
				FG_METER_RESISTANCE = <0x4b>;
				CAR_TUNE_VALUE = <0x64>;
				PMIC_MIN_VOL = <0x82dc>;
				POWERON_SYSTEM_IBOOT = <0x1f4>;
				SHUTDOWN_GAUGE0_VOLTAGE = <0x84d0>;
				TEMPERATURE_T0 = <0x32>;
				TEMPERATURE_T1 = <0x19>;
				TEMPERATURE_T2 = <0x0a>;
				TEMPERATURE_T3 = <0x00>;
				TEMPERATURE_T4 = <0xfffffff6>;
				g_FG_PSEUDO100_T0 = <0x64>;
				g_FG_PSEUDO100_T1 = <0x64>;
				g_FG_PSEUDO100_T2 = <0x64>;
				g_FG_PSEUDO100_T3 = <0x64>;
				g_FG_PSEUDO100_T4 = <0x64>;
				Q_MAX_SYS_VOLTAGE_BAT0 = <0xd16>;
				Q_MAX_SYS_VOLTAGE_BAT1 = <0xd16>;
				Q_MAX_SYS_VOLTAGE_BAT2 = <0xd16>;
				Q_MAX_SYS_VOLTAGE_BAT3 = <0xd16>;
				COM_FG_METER_RESISTANCE = <0x64>;
				COM_R_FG_VALUE = <0x00>;
				enable_tmp_intr_suspend = <0x00>;
				ACTIVE_TABLE = <0x05>;
				MULTI_TEMP_GAUGE0 = <0x01>;
				RBAT_PULL_UP_R = <0x4204>;
				RBAT_PULL_UP_VOLT = <0x708>;
				tran_Q_diff = <0x1770 0x1770 0x1770 0x1770>;
				g_PMIC_MIN_VOL = <0x8660 0x82dc 0x88b8 0x8660 0x8660 0x80e8 0x88b8 0x8660 0x8660 0x82dc 0x86c4 0x8660 0x8598 0x7dc8 0x7ef4 0x8598 0x8598 0x7c9c 0x7c9c 0x8598 0x7b0c 0x7b0c 0x7b0c 0x7b0c 0x7918 0x7918 0x7918 0x7918 0x7918 0x7918 0x7918 0x7918 0x7918 0x7918 0x7918 0x7918 0x7918 0x7918 0x7918 0x79e0>;
				SHUTDOWN_GAUGE1_VBAT_EN = <0x01>;
				UI_LOW_LIMIT_SOC0 = <0xc8>;
				UI_LOW_LIMIT_VTH0 = <0x87f0>;
				UI_LOW_LIMIT_SOC1 = <0xc8>;
				UI_LOW_LIMIT_VTH1 = <0x87f0>;
				UI_LOW_LIMIT_SOC2 = <0xc8>;
				UI_LOW_LIMIT_VTH2 = <0x87f0>;
				UI_LOW_LIMIT_SOC3 = <0xc8>;
				UI_LOW_LIMIT_VTH3 = <0x87f0>;
				UI_LOW_LIMIT_SOC4 = <0xc8>;
				UI_LOW_LIMIT_VTH4 = <0x87f0>;
				battery0_profile_t0_num = <0x64>;
				battery0_profile_t0 = <0x00 0xad2a 0x406 0x25f 0xac56 0x400 0x4bf 0xaba9 0x3e8 0x71e 0xab1b 0x3e8 0x97d 0xaa9c 0x3e8 0xbdc 0xaa22 0x3e8 0xe3c 0xa9a9 0x3e8 0x109b 0xa932 0x3e8 0x12fa 0xa8bf 0x3e8 0x1559 0xa847 0x3e8 0x17b9 0xa7ce 0x3e8 0x1a18 0xa755 0x3e8 0x1c77 0xa6d9 0x3e8 0x1ed6 0xa659 0x3e8 0x2136 0xa5df 0x3e8 0x2395 0xa566 0x3e8 0x25f4 0xa4e9 0x3e8 0x2853 0xa469 0x3e8 0x2ab3 0xa3f0 0x3e8 0x2d12 0xa377 0x3e8 0x2f71 0xa2fe 0x3ef 0x31d1 0xa285 0x406 0x3430 0xa20f 0x406 0x368f 0xa19c 0x406 0x38ee 0xa124 0x406 0x3b4e 0xa0b4 0x406 0x3dad 0xa040 0x406 0x400c 0x9fd3 0x40d 0x426b 0x9f66 0x419 0x44cb 0x9ef8 0x41a 0x472a 0x9e8b 0x413 0x4989 0x9e24 0x412 0x4be8 0x9dbf 0x41a 0x4e48 0x9d58 0x41a 0x50a7 0x9cf7 0x41a 0x5306 0x9c9a 0x427 0x5565 0x9c3f 0x438 0x57c5 0x9be2 0x440 0x5a24 0x9b88 0x44c 0x5c83 0x9b33 0x44c 0x5ee3 0x9ae3 0x464 0x6142 0x9a93 0x47e 0x63a1 0x9a3a 0x48c 0x6600 0x99de 0x49c 0x6860 0x9970 0x48b 0x6abf 0x98d9 0x43e 0x6d1e 0x984b 0x3f4 0x6f7d 0x97ec 0x3f7 0x71dd 0x9799 0x401 0x743c 0x9750 0x3e8 0x769b 0x970e 0x3e8 0x78fa 0x96d1 0x3e8 0x7b5a 0x9695 0x3de 0x7db9 0x965a 0x3d9 0x8018 0x962a 0x3e8 0x8277 0x95f9 0x3e8 0x84d7 0x95c9 0x3e8 0x8736 0x9598 0x3e8 0x8995 0x9568 0x3e8 0x8bf4 0x953d 0x3e8 0x8e54 0x9518 0x3fe 0x90b3 0x94ea 0x3ea 0x9312 0x94c5 0x3f9 0x9572 0x94a1 0x406 0x97d1 0x9483 0x411 0x9a30 0x9462 0x40a 0x9c8f 0x9448 0x41a 0x9eef 0x942a 0x41a 0xa14e 0x940e 0x427 0xa3ad 0x93ef 0x438 0xa60c 0x93d3 0x438 0xa86c 0x93ae 0x436 0xaacb 0x9366 0x405 0xad2a 0x9318 0x3de 0xaf89 0x92d8 0x3e2 0xb1e9 0x92a8 0x3e8 0xb448 0x9281 0x404 0xb6a7 0x9251 0x3f2 0xb906 0x9226 0x3f8 0xbb66 0x91fa 0x3ef 0xbdc5 0x91d3 0x3e8 0xc024 0x91af 0x408 0xc284 0x918a 0x414 0xc4e3 0x915a 0x40e 0xc742 0x911d 0x406 0xc9a1 0x90d7 0x406 0xcc01 0x909b 0x40c 0xce60 0x9065 0x42a 0xd0bf 0x9017 0x403 0xd31e 0x8fd9 0x3d6 0xd57e 0x8fca 0x3ed 0xd7dd 0x8fc5 0x422 0xda3c 0x8fb3 0x440 0xdc9b 0x8f9d 0x470 0xdefb 0x8f7c 0x4ad 0xe15a 0x8eea 0x48d 0xe3b9 0x8d54 0x441 0xe618 0x8b3f 0x45f 0xe67c 0x888c 0x491 0xe6e0 0x8494 0x500>;
				battery0_profile_t1_num = <0x64>;
				battery0_profile_t1 = <0x00 0xad98 0x5aa 0x25f 0xaca4 0x588 0x4bf 0xabf0 0x57c 0x71e 0xab59 0x57d 0x97d 0xaad6 0x578 0xbdc 0xaa67 0x578 0xe3c 0xa9ed 0x579 0x109b 0xa974 0x582 0x12fa 0xa8fa 0x582 0x1559 0xa881 0x582 0x17b9 0xa807 0x582 0x1a18 0xa78e 0x579 0x1c77 0xa712 0x58d 0x1ed6 0xa692 0x57b 0x2136 0xa618 0x58c 0x2395 0xa594 0x578 0x25f4 0xa51b 0x585 0x2853 0xa49e 0x58c 0x2ab3 0xa41f 0x57a 0x2d12 0xa3ae 0x594 0x2f71 0xa32b 0x578 0x31d1 0xa2b7 0x587 0x3430 0xa242 0x596 0x368f 0xa1c9 0x58c 0x38ee 0xa159 0x5a7 0x3b4e 0xa0e3 0x593 0x3dad 0xa070 0x59e 0x400c 0x9fff 0x59e 0x426b 0x9f91 0x5aa 0x44cb 0x9f30 0x5b8 0x472a 0x9ec6 0x5ab 0x4989 0x9e5a 0x5b7 0x4be8 0x9df4 0x5b7 0x4e48 0x9d8e 0x5ca 0x50a7 0x9d34 0x5cc 0x5306 0x9cd0 0x5e1 0x5565 0x9c74 0x5ee 0x57c5 0x9c18 0x5e0 0x5a24 0x9bbd 0x5f3 0x5c83 0x9b68 0x5fa 0x5ee3 0x9b19 0x603 0x6142 0x9ac0 0x62c 0x63a1 0x9a5f 0x636 0x6600 0x99fa 0x643 0x6860 0x9980 0x5f8 0x6abf 0x9900 0x5ed 0x6d1e 0x9883 0x58b 0x6f7d 0x981f 0x57b 0x71dd 0x97c4 0x5c8 0x743c 0x977b 0x546 0x769b 0x973a 0x53a 0x78fa 0x96fd 0x546 0x7b5a 0x96c2 0x532 0x7db9 0x9691 0x533 0x8018 0x965b 0x52a 0x8277 0x962e 0x540 0x84d7 0x95ff 0x546 0x8736 0x95cf 0x53f 0x8995 0x95a3 0x535 0x8bf4 0x957e 0x550 0x8e54 0x955a 0x546 0x90b3 0x9535 0x559 0x9312 0x9511 0x54d 0x9572 0x94ed 0x550 0x97d1 0x94d7 0x556 0x9a30 0x94b8 0x578 0x9c8f 0x9495 0x55c 0x9eef 0x947d 0x579 0xa14e 0x9464 0x578 0xa3ad 0x944c 0x514 0xa60c 0x942a 0x514 0xa86c 0x9418 0x584 0xaacb 0x93ed 0x56d 0xad2a 0x93c6 0x546 0xaf89 0x93ab 0x546 0xb1e9 0x9386 0x54d 0xb448 0x9357 0x53c 0xb6a7 0x932d 0x53c 0xb906 0x9306 0x53c 0xbb66 0x92e2 0x53c 0xbdc5 0x92bd 0x546 0xc024 0x9299 0x546 0xc284 0x9274 0x546 0xc4e3 0x9238 0x546 0xc742 0x91f9 0x546 0xc9a1 0x91ba 0x546 0xcc01 0x9173 0x546 0xce60 0x9130 0x546 0xd0bf 0x90d8 0x540 0xd31e 0x90a5 0x53f 0xd57e 0x9099 0x546 0xd7dd 0x908d 0x558 0xda3c 0x9081 0x583 0xdc9b 0x906b 0x595 0xdefb 0x9040 0x5d0 0xe15a 0x8f72 0x5fa 0xe3b9 0x8d98 0x5fa 0xe618 0x8bbf 0x5fa 0xe67c 0x88bf 0x661 0xe6e0 0x8516 0x672>;
				battery0_profile_t2_num = <0x64>;
				battery0_profile_t2 = <0x00 0xad3e 0x7d0 0x25f 0xac7b 0x7ce 0x4bf 0xabe9 0x7c2 0x71e 0xab6b 0x7bc 0x97d 0xaafe 0x7bc 0xbdc 0xaa87 0x78b 0xe3c 0xaa23 0x79b 0x109b 0xa9b6 0x78f 0x12fa 0xa942 0x775 0x1559 0xa8d2 0x76c 0x17b9 0xa85b 0x75a 0x1a18 0xa7e9 0x764 0x1c77 0xa76a 0x745 0x1ed6 0xa6ee 0x73a 0x2136 0xa675 0x73a 0x2395 0xa5fa 0x736 0x25f4 0xa579 0x726 0x2853 0xa4ff 0x726 0x2ab3 0xa486 0x726 0x2d12 0xa40d 0x727 0x2f71 0xa394 0x73a 0x31d1 0xa31b 0x73a 0x3430 0xa2a1 0x73a 0x368f 0xa228 0x73a 0x38ee 0xa1b0 0x73a 0x3b4e 0xa140 0x73a 0x3dad 0xa0c7 0x73a 0x400c 0xa055 0x73a 0x426b 0x9fe8 0x73a 0x44cb 0x9f7a 0x758 0x472a 0x9f0d 0x75c 0x4989 0x9ea0 0x768 0x4be8 0x9e33 0x76c 0x4e48 0x9dd0 0x78a 0x50a7 0x9d65 0x78e 0x5306 0x9d01 0x79e 0x5565 0x9c9a 0x79e 0x57c5 0x9c37 0x79e 0x5a24 0x9bd6 0x79e 0x5c83 0x9b75 0x79e 0x5ee3 0x9b14 0x79e 0x6142 0x9ab3 0x79e 0x63a1 0x9a49 0x78c 0x6600 0x99da 0x751 0x6860 0x9961 0x715 0x6abf 0x98e8 0x6d8 0x6d1e 0x987e 0x6ab 0x6f7d 0x981d 0x690 0x71dd 0x97c0 0x65e 0x743c 0x9777 0x658 0x769b 0x972f 0x646 0x78fa 0x96ee 0x640 0x7b5a 0x96b2 0x640 0x7db9 0x9675 0x640 0x8018 0x963d 0x640 0x8277 0x960d 0x640 0x84d7 0x95dc 0x65b 0x8736 0x95ac 0x65e 0x8995 0x957d 0x65e 0x8bf4 0x9552 0x65e 0x8e54 0x9524 0x65e 0x90b3 0x94fd 0x65e 0x9312 0x94d9 0x672 0x9572 0x94b5 0x672 0x97d1 0x9490 0x672 0x9a30 0x946c 0x672 0x9c8f 0x9452 0x690 0x9eef 0x942f 0x679 0xa14e 0x9415 0x689 0xa3ad 0x93f7 0x677 0xa60c 0x93dd 0x68c 0xa86c 0x93c4 0x672 0xaacb 0x93ac 0x672 0xad2a 0x9397 0x679 0xaf89 0x9384 0x68c 0xb1e9 0x936e 0x690 0xb448 0x934b 0x676 0xb6a7 0x932e 0x68b 0xb906 0x9303 0x679 0xbb66 0x92dd 0x689 0xbdc5 0x92b8 0x690 0xc024 0x9292 0x6a4 0xc284 0x9264 0x6ae 0xc4e3 0x9239 0x6cd 0xc742 0x9202 0x6d6 0xc9a1 0x91bb 0x6d8 0xcc01 0x917f 0x6f9 0xce60 0x913e 0x71b 0xd0bf 0x90f5 0x74b 0xd31e 0x90a3 0x758 0xd57e 0x9067 0x76f 0xd7dd 0x9046 0x79a 0xda3c 0x902d 0x7f2 0xdc9b 0x9015 0x86b 0xdefb 0x8ff3 0x914 0xe15a 0x8fb1 0xa15 0xe3b9 0x8e97 0xc53 0xe618 0x8c1b 0xe9b 0xe67c 0x8928 0xf04 0xe6e0 0x8714 0xeec>;
				battery0_profile_t3_num = <0x64>;
				battery0_profile_t3 = <0x00 0xad3e 0xd02 0x25f 0xac36 0xd02 0x4bf 0xab82 0xcf1 0x71e 0xaaeb 0xcc0 0x97d 0xaa71 0xccc 0xbdc 0xa9ef 0xc9e 0xe3c 0xa97f 0xc95 0x109b 0xa906 0xc76 0x12fa 0xa890 0xc5a 0x1559 0xa81d 0xc3c 0x17b9 0xa7a5 0xc20 0x1a18 0xa730 0xc28 0x1c77 0xa6b1 0xc08 0x1ed6 0xa637 0xc08 0x2136 0xa5be 0xbf9 0x2395 0xa544 0xbe6 0x25f4 0xa4cb 0xbd6 0x2853 0xa451 0xbd6 0x2ab3 0xa3d8 0xbd6 0x2d12 0xa35f 0xbb9 0x2f71 0xa2eb 0xbcb 0x31d1 0xa270 0xbc7 0x3430 0xa1f2 0xbb8 0x368f 0xa182 0xbb8 0x38ee 0xa113 0xbd6 0x3b4e 0xa09c 0xbd1 0x3dad 0xa028 0xbbe 0x400c 0x9fb9 0xbc8 0x426b 0x9f4b 0xbea 0x44cb 0x9ede 0xbee 0x472a 0x9e71 0xc02 0x4989 0x9e03 0xc08 0x4be8 0x9d96 0xc08 0x4e48 0x9d20 0xbea 0x50a7 0x9cb9 0xbdb 0x5306 0x9c49 0xbb8 0x5565 0x9be1 0xbb8 0x57c5 0x9b78 0xba1 0x5a24 0x9b10 0xb83 0x5c83 0x9aa3 0xb60 0x5ee3 0x9a36 0xb23 0x6142 0x99c8 0xaf6 0x63a1 0x9965 0xadc 0x6600 0x98fe 0xabd 0x6860 0x9899 0xa9d 0x6abf 0x9838 0xa6b 0x6d1e 0x97df 0xa5a 0x6f7d 0x9794 0xa58 0x71dd 0x9744 0xa49 0x743c 0x9701 0xa55 0x769b 0x96ba 0xa5a 0x78fa 0x967b 0xa5a 0x7b5a 0x963e 0xa5a 0x7db9 0x9605 0xa65 0x8018 0x95d2 0xa7e 0x8277 0x959b 0xa8a 0x84d7 0x9573 0xaaa 0x8736 0x9543 0xaaf 0x8995 0x9512 0xabe 0x8bf4 0x94e8 0xad2 0x8e54 0x94c4 0xaf2 0x90b3 0x949f 0xb0e 0x9312 0x947b 0xb0e 0x9572 0x9457 0xb18 0x97d1 0x9432 0xb22 0x9a30 0x9421 0xb51 0x9c8f 0x9409 0xb65 0x9eef 0x93f1 0xb79 0xa14e 0x93d8 0xb86 0xa3ad 0x93c8 0xbc6 0xa60c 0x93b2 0xbeb 0xa86c 0x93a0 0xc28 0xaacb 0x938b 0xc72 0xad2a 0x9373 0xcbf 0xaf89 0x935b 0xd27 0xb1e9 0x9337 0xd81 0xb448 0x9314 0xdf0 0xb6a7 0x92f6 0xe88 0xb906 0x92cd 0xf0d 0xbb66 0x92a6 0xfb6 0xbdc5 0x9276 0x1053 0xc024 0x9245 0x1122 0xc284 0x920b 0x11df 0xc4e3 0x91c9 0x12a1 0xc742 0x918b 0x1378 0xc9a1 0x9142 0x1470 0xcc01 0x90f9 0x159a 0xce60 0x90b0 0x16fa 0xd0bf 0x9067 0x18ae 0xd31e 0x9020 0x1a98 0xd57e 0x8fed 0x1dba 0xd7dd 0x8fa5 0x21bc 0xda3c 0x8f5f 0x27ce 0xdc9b 0x8f06 0x3134 0xdefb 0x8ead 0x3d7b 0xe15a 0x8e15 0x4cd7 0xe3b9 0x8d36 0x6324 0xe618 0x8d36 0x6324 0xe67c 0x8d36 0x6324 0xe6e0 0x8d36 0x6324>;
				battery0_profile_t4_num = <0x64>;
				battery0_profile_t4 = <0x00 0xad34 0x1bee 0x25f 0xabf1 0x1bee 0x4bf 0xab0b 0x1bd9 0x71e 0xaa50 0x1b92 0x97d 0xa9a6 0x1b43 0xbdc 0xa911 0x1b22 0xe3c 0xa880 0x1ae6 0x109b 0xa7ee 0x1aa9 0x12fa 0xa763 0x1a6c 0x1559 0xa6de 0x1a2f 0x17b9 0xa659 0x19f7 0x1a18 0xa5dc 0x19d8 0x1c77 0xa557 0x19a7 0x1ed6 0xa4d9 0x1986 0x2136 0xa456 0x1950 0x2395 0xa3dc 0x192e 0x25f4 0xa363 0x1911 0x2853 0xa2e3 0x18e0 0x2ab3 0xa266 0x18a3 0x2d12 0xa1ec 0x1891 0x2f71 0xa176 0x187f 0x31d1 0xa103 0x1860 0x3430 0xa08a 0x1840 0x368f 0xa01a 0x1838 0x38ee 0x9fa3 0x1827 0x3b4e 0x9f32 0x1831 0x3dad 0x9eb8 0x1815 0x400c 0x9e3f 0x17f4 0x426b 0x9dc5 0x17d4 0x44cb 0x9d4c 0x17b9 0x472a 0x9cd2 0x178c 0x4989 0x9c5f 0x1763 0x4be8 0x9bea 0x1742 0x4e48 0x9b7b 0x1728 0x50a7 0x9b0f 0x1709 0x5306 0x9aa8 0x16fd 0x5565 0x9a3d 0x16e2 0x57c5 0x99d9 0x16c7 0x5a24 0x9979 0x16c6 0x5c83 0x9921 0x16c6 0x5ee3 0x98c0 0x16b5 0x6142 0x9866 0x16c0 0x63a1 0x9811 0x16c6 0x6600 0x97bc 0x16c6 0x6860 0x976c 0x16cf 0x6abf 0x9723 0x16ee 0x6d1e 0x96da 0x1709 0x6f7d 0x9692 0x1710 0x71dd 0x9652 0x1747 0x743c 0x9611 0x1776 0x769b 0x95da 0x17b2 0x78fa 0x959f 0x17d3 0x7b5a 0x956c 0x180b 0x7db9 0x9533 0x1836 0x8018 0x9503 0x1862 0x8277 0x94da 0x18aa 0x84d7 0x94ac 0x18ed 0x8736 0x9488 0x192f 0x8995 0x946a 0x198a 0x8bf4 0x944f 0x19e2 0x8e54 0x9437 0x1a51 0x90b3 0x941f 0x1aed 0x9312 0x9410 0x1b9a 0x9572 0x93f8 0x1c4b 0x97d1 0x93df 0x1d1e 0x9a30 0x93c7 0x1e20 0x9c8f 0x93ad 0x1f32 0x9eef 0x938d 0x2059 0xa14e 0x9374 0x21b2 0xa3ad 0x9354 0x2337 0xa60c 0x9339 0x24be 0xa86c 0x9317 0x2673 0xaacb 0x92fb 0x2849 0xad2a 0x92d6 0x2a04 0xaf89 0x92b2 0x2bc4 0xb1e9 0x928d 0x2da4 0xb448 0x9269 0x2f6e 0xb6a7 0x9244 0x3135 0xb906 0x9219 0x32d7 0xbb66 0x91e8 0x3448 0xbdc5 0x91c2 0x35e3 0xc024 0x9191 0x3731 0xc284 0x9160 0x388d 0xc4e3 0x9130 0x39c1 0xc742 0x90ff 0x3aec 0xc9a1 0x90c5 0x3beb 0xcc01 0x9094 0x3d23 0xce60 0x905d 0x3e72 0xd0bf 0x9020 0x400c 0xd31e 0x8fe3 0x41d1 0xd57e 0x8fa7 0x4498 0xd7dd 0x8f6f 0x491d 0xda3c 0x8f37 0x5184 0xdc9b 0x8f2a 0x53b6 0xdefb 0x8f2a 0x53b6 0xe15a 0x8f2a 0x53b6 0xe3b9 0x8f2a 0x53b6 0xe618 0x8f2a 0x53b6 0xe67c 0x8f2a 0x53b6 0xe6e0 0x8f2a 0x53b6>;
				battery2_profile_t0_num = <0x64>;
				battery2_profile_t0 = <0x00 0xace8 0x3ac 0x256 0xac7c 0x3ae 0x4ac 0xac1f 0x3b4 0x703 0xabbe 0x3ae 0x959 0xab60 0x3b4 0xbaf 0xaafe 0x3b6 0xe05 0xaa9a 0x3b4 0x105b 0xaa38 0x3ae 0x12b1 0xa9d0 0x3b4 0x1508 0xa966 0x3bd 0x175e 0xa8f8 0x3b7 0x19b4 0xa886 0x3b7 0x1c0a 0xa815 0x3c0 0x1e60 0xa7a1 0x3c0 0x20b6 0xa72b 0x3c0 0x230d 0xa6b1 0x3c0 0x2563 0xa637 0x3c0 0x27b9 0xa5bb 0x3c0 0x2a0f 0xa540 0x3c0 0x2c65 0xa4c8 0x3c7 0x2ebb 0xa44f 0x3ca 0x3112 0xa3d5 0x3cb 0x3368 0xa35e 0x3d4 0x35be 0xa2e3 0x3d4 0x3814 0xa26f 0x3d4 0x3a6a 0xa1f8 0x3cc 0x3cc0 0xa185 0x3d4 0x3f17 0xa112 0x3de 0x416d 0xa0a1 0x3de 0x43c3 0xa032 0x3de 0x4619 0x9fc5 0x3ee 0x486f 0x9f54 0x3e8 0x4ac5 0x9eec 0x3f2 0x4d1c 0x9e84 0x3f6 0x4f72 0x9e1d 0x402 0x51c8 0x9db8 0x40e 0x541e 0x9d53 0x410 0x5674 0x9cf4 0x424 0x58cb 0x9c94 0x428 0x5b21 0x9c35 0x434 0x5d77 0x9bd6 0x447 0x5fcd 0x9b79 0x456 0x6223 0x9b14 0x461 0x6479 0x9a9c 0x459 0x66d0 0x9a04 0x41d 0x6926 0x996f 0x3e9 0x6b7c 0x98fd 0x3d5 0x6dd2 0x98a1 0x3c9 0x7028 0x9852 0x3c3 0x727e 0x980c 0x3cf 0x74d5 0x97c1 0x3bf 0x772b 0x977f 0x3b6 0x7981 0x9740 0x3c0 0x7bd7 0x9704 0x3bf 0x7e2d 0x96c9 0x3b9 0x8083 0x9690 0x3bd 0x82da 0x965b 0x3c9 0x8530 0x9628 0x3ca 0x8786 0x95f4 0x3ca 0x89dc 0x95c2 0x3cc 0x8c32 0x9594 0x3d2 0x8e88 0x9566 0x3d4 0x90df 0x953a 0x3d4 0x9335 0x9515 0x3e0 0x958b 0x94ed 0x3e8 0x97e1 0x94c6 0x3e8 0x9a37 0x94a0 0x3f8 0x9c8e 0x947e 0x3fc 0x9ee4 0x945a 0x3fd 0xa13a 0x9437 0x405 0xa390 0x9414 0x40d 0xa5e6 0x93e9 0x401 0xa83c 0x93a7 0x3df 0xaa93 0x9354 0x3c8 0xace9 0x930e 0x3c2 0xaf3f 0x92da 0x3c8 0xb195 0x92ab 0x3d1 0xb3eb 0x927e 0x3dd 0xb641 0x924d 0x3d4 0xb898 0x921c 0x3d4 0xbaee 0x91f1 0x3d4 0xbd44 0x91ca 0x3d4 0xbf9a 0x91a5 0x3e6 0xc1f0 0x9175 0x3de 0xc446 0x9138 0x3de 0xc69d 0x90f5 0x3de 0xc8f3 0x90b7 0x3de 0xcb49 0x907a 0x3e7 0xcd9f 0x9027 0x3d2 0xcff5 0x8fe4 0x3b9 0xd24b 0x8fd1 0x3c7 0xd4a2 0x8fc8 0x3d9 0xd6f8 0x8fbd 0x3e6 0xd94e 0x8fb5 0x408 0xdba4 0x8fa0 0x43a 0xddfa 0x8f50 0x44d 0xe050 0x8ea6 0x417 0xe2a7 0x8d4b 0x40e 0xe4fd 0x8b46 0x424 0xe753 0x8612 0x492>;
				battery2_profile_t1_num = <0x64>;
				battery2_profile_t1 = <0x00 0xad20 0x5c8 0x256 0xaca8 0x5c8 0x4ac 0xac3f 0x5c4 0x703 0xabdb 0x5b8 0x959 0xab77 0x5ac 0xbaf 0xab15 0x5aa 0xe05 0xaab1 0x5a0 0x105b 0xaa4d 0x5a0 0x12b1 0xa9e7 0x59a 0x1508 0xa97d 0x596 0x175e 0xa90e 0x596 0x19b4 0xa89c 0x58d 0x1c0a 0xa829 0x593 0x1e60 0xa7b3 0x596 0x20b6 0xa738 0x58f 0x230d 0xa6c0 0x595 0x2563 0xa646 0x58c 0x27b9 0xa5ca 0x58c 0x2a0f 0xa550 0x591 0x2c65 0xa4d7 0x596 0x2ebb 0xa45a 0x58d 0x3112 0xa3e3 0x58d 0x3368 0xa36a 0x593 0x35be 0xa2f2 0x596 0x3814 0xa27b 0x596 0x3a6a 0xa208 0x5a8 0x3cc0 0xa192 0x5a1 0x3f17 0xa121 0x5a7 0x416d 0xa0b1 0x5b4 0x43c3 0xa041 0x5be 0x4619 0x9fcf 0x5b5 0x486f 0x9f63 0x5bf 0x4ac5 0x9efb 0x5d1 0x4d1c 0x9e93 0x5e1 0x4f72 0x9e2b 0x5ed 0x51c8 0x9dc7 0x5f9 0x541e 0x9d62 0x605 0x5674 0x9d00 0x611 0x58cb 0x9c9d 0x61d 0x5b21 0x9c3d 0x629 0x5d77 0x9be3 0x63d 0x5fcd 0x9b83 0x650 0x6223 0x9b22 0x65e 0x6479 0x9aba 0x655 0x66d0 0x9a41 0x637 0x6926 0x99b5 0x5e9 0x6b7c 0x9933 0x5a8 0x6dd2 0x98b7 0x571 0x7028 0x9857 0x556 0x727e 0x9808 0x550 0x74d5 0x97bf 0x548 0x772b 0x977b 0x546 0x7981 0x973a 0x546 0x7bd7 0x96fe 0x54a 0x7e2d 0x96c5 0x54a 0x8083 0x968d 0x546 0x82da 0x9659 0x546 0x8530 0x9625 0x546 0x8786 0x95f5 0x542 0x89dc 0x95c6 0x548 0x8c32 0x959a 0x550 0x8e88 0x9571 0x55a 0x90df 0x9549 0x564 0x9335 0x9522 0x564 0x958b 0x94fb 0x564 0x97e1 0x94d6 0x573 0x9a37 0x94b4 0x573 0x9c8e 0x9493 0x570 0x9ee4 0x9472 0x57c 0xa13a 0x9454 0x582 0xa390 0x9435 0x582 0xa5e6 0x9416 0x582 0xa83c 0x93f8 0x582 0xaa93 0x93d2 0x57b 0xace9 0x93a7 0x56e 0xaf3f 0x937a 0x55f 0xb195 0x9351 0x555 0xb3eb 0x9328 0x550 0xb641 0x92fc 0x550 0xb898 0x92ce 0x550 0xbaee 0x92a6 0x54c 0xbd44 0x927f 0x546 0xbf9a 0x9259 0x53d 0xc1f0 0x9230 0x549 0xc446 0x9200 0x550 0xc69d 0x91c2 0x553 0xc8f3 0x9183 0x559 0xcb49 0x914a 0x564 0xcd9f 0x9105 0x567 0xcff5 0x90b1 0x565 0xd24b 0x9079 0x55a 0xd4a2 0x905d 0x55a 0xd6f8 0x9050 0x56f 0xd94e 0x9042 0x57d 0xdba4 0x9035 0x59a 0xddfa 0x9016 0x5c1 0xe050 0x8fea 0x5eb 0xe2a7 0x8f37 0x5dc 0xe4fd 0x8d86 0x5e1 0xe753 0x8713 0x67c>;
				battery2_profile_t2_num = <0x64>;
				battery2_profile_t2 = <0x00 0xad1d 0x128e 0x256 0xac71 0x128a 0x4ac 0xabec 0x126c 0x703 0xab79 0x1242 0x959 0xab0b 0x1224 0xbaf 0xaaa6 0x1203 0xe05 0xaa3b 0x11cb 0x105b 0xa9d3 0x11a5 0x12b1 0xa969 0x117b 0x1508 0xa8fe 0x1146 0x175e 0xa88d 0x111d 0x19b4 0xa81d 0x10f2 0x1c0a 0xa7a9 0x10de 0x1e60 0xa732 0x10b4 0x20b6 0xa6be 0x1086 0x230d 0xa649 0x1060 0x2563 0xa5d2 0x103d 0x27b9 0xa55c 0x101f 0x2a0f 0xa4e3 0xfef 0x2c65 0xa46c 0xfc7 0x2ebb 0xa3f8 0xfb5 0x3112 0xa380 0xf95 0x3368 0xa30b 0xf86 0x35be 0xa296 0xf73 0x3814 0xa224 0xf67 0x3a6a 0xa1b1 0xf53 0x3cc0 0xa13e 0xf45 0x3f17 0xa0ca 0xf39 0x416d 0xa05c 0xf30 0x43c3 0x9ff0 0xf2a 0x4619 0x9f87 0xf30 0x486f 0x9f19 0xf32 0x4ac5 0x9ea6 0xf2a 0x4d1c 0x9e34 0xf30 0x4f72 0x9dc5 0xf2a 0x51c8 0x9d56 0xf17 0x541e 0x9ce6 0xeff 0x5674 0x9c74 0xee3 0x58cb 0x9c01 0xeba 0x5b21 0x9b90 0xe9c 0x5d77 0x9b1d 0xe69 0x5fcd 0x9aad 0xe4c 0x6223 0x9a3a 0xe10 0x6479 0x99c8 0xde0 0x66d0 0x995e 0xdbf 0x6926 0x98f3 0xd95 0x6b7c 0x9891 0xd84 0x6dd2 0x9832 0xd64 0x7028 0x97de 0xd60 0x727e 0x9790 0xd60 0x74d5 0x9744 0xd54 0x772b 0x96ff 0xd5c 0x7981 0x96bd 0xd66 0x7bd7 0x9680 0xd6d 0x7e2d 0x9649 0xd82 0x8083 0x9611 0xd94 0x82da 0x95d7 0xd98 0x8530 0x95a6 0xdae 0x8786 0x9576 0xdc6 0x89dc 0x9547 0xdde 0x8c32 0x951b 0xdf6 0x8e88 0x94ef 0xe0e 0x90df 0x94c6 0xe1e 0x9335 0x94a1 0xe48 0x958b 0x947c 0xe5b 0x97e1 0x9459 0xe6e 0x9a37 0x9437 0xe86 0x9c8e 0x941c 0xe9e 0x9ee4 0x9404 0xec5 0xa13a 0x93f0 0xef5 0xa390 0x93dc 0xf2f 0xa5e6 0x93c9 0xf70 0xa83c 0x93b4 0xfb9 0xaa93 0x939d 0x101b 0xace9 0x9386 0x1086 0xaf3f 0x936a 0x10f9 0xb195 0x934c 0x1170 0xb3eb 0x932b 0x11fd 0xb641 0x9307 0x12a4 0xb898 0x92e1 0x1347 0xbaee 0x92b5 0x13e8 0xbd44 0x9285 0x1493 0xbf9a 0x9253 0x1541 0xc1f0 0x921a 0x15f8 0xc446 0x91da 0x16c3 0xc69d 0x9199 0x178e 0xc8f3 0x9154 0x1868 0xcb49 0x910d 0x194b 0xcd9f 0x90c3 0x1a5e 0xcff5 0x907e 0x1b8f 0xd24b 0x903d 0x1cff 0xd4a2 0x9007 0x1ec9 0xd6f8 0x8fd7 0x20b9 0xd94e 0x8fac 0x233c 0xdba4 0x8f76 0x266f 0xddfa 0x8f31 0x2a87 0xe050 0x8eb7 0x2f87 0xe2a7 0x8e22 0x34d5 0xe4fd 0x8ce6 0x39fe 0xe753 0x8941 0x4f6a>;
				battery2_profile_t3_num = <0x64>;
				battery2_profile_t3 = <0x00 0xad3f 0x988 0x256 0xacb0 0x988 0x4ac 0xac42 0x986 0x703 0xabde 0x980 0x959 0xab7f 0x966 0xbaf 0xab22 0x960 0xe05 0xaabf 0x940 0x105b 0xaa5e 0x934 0x12b1 0xa9fc 0x928 0x1508 0xa993 0x915 0x175e 0xa928 0x8f3 0x19b4 0xa8bb 0x8e6 0x1c0a 0xa848 0x8d4 0x1e60 0xa7d4 0x8bf 0x20b6 0xa75d 0x8af 0x230d 0xa6e3 0x8ac 0x2563 0xa66c 0x8ab 0x27b9 0xa5f1 0x89f 0x2a0f 0xa576 0x893 0x2c65 0xa4fc 0x887 0x2ebb 0xa482 0x87b 0x3112 0xa40b 0x87a 0x3368 0xa394 0x877 0x35be 0xa319 0x86b 0x3814 0xa2a1 0x86d 0x3a6a 0xa22d 0x870 0x3cc0 0xa1bb 0x875 0x3f17 0xa148 0x877 0x416d 0xa0d5 0x875 0x43c3 0xa062 0x87a 0x4619 0x9ff5 0x883 0x486f 0x9f8b 0x894 0x4ac5 0x9f20 0x8a2 0x4d1c 0x9eb2 0x8ab 0x4f72 0x9e49 0x8bd 0x51c8 0x9dde 0x8c0 0x541e 0x9d75 0x8c5 0x5674 0x9d0d 0x8cf 0x58cb 0x9ca8 0x8de 0x5b21 0x9c42 0x8d8 0x5d77 0x9bdb 0x8d4 0x5fcd 0x9b73 0x8ca 0x6223 0x9b06 0x8b8 0x6479 0x9a95 0x897 0x66d0 0x9a1a 0x85c 0x6926 0x999f 0x81c 0x6b7c 0x9925 0x7da 0x6dd2 0x98b4 0x7a0 0x7028 0x9855 0x77c 0x727e 0x97ff 0x770 0x74d5 0x97b4 0x768 0x772b 0x976d 0x762 0x7981 0x972b 0x758 0x7bd7 0x96ed 0x75c 0x7e2d 0x96b2 0x762 0x8083 0x967a 0x76a 0x82da 0x9645 0x776 0x8530 0x960e 0x76f 0x8786 0x95de 0x784 0x89dc 0x95ad 0x784 0x8c32 0x957f 0x788 0x8e88 0x9553 0x793 0x90df 0x952a 0x79d 0x9335 0x94ff 0x79b 0x958b 0x94db 0x7ad 0x97e1 0x94b8 0x7b9 0x9a37 0x9490 0x7a9 0x9c8e 0x946f 0x7bb 0x9ee4 0x944e 0x7b8 0xa13a 0x9430 0x7c6 0xa390 0x9412 0x7c6 0xa5e6 0x93f3 0x7bd 0xa83c 0x93db 0x7c5 0xaa93 0x93c2 0x7c2 0xace9 0x93ab 0x7d0 0xaf3f 0x9392 0x7d0 0xb195 0x937a 0x7e2 0xb3eb 0x935c 0x7db 0xb641 0x9339 0x7e4 0xb898 0x930e 0x7e6 0xbaee 0x92e2 0x7ec 0xbd44 0x92b8 0x808 0xbf9a 0x9292 0x82c 0xc1f0 0x9268 0x850 0xc446 0x9232 0x86f 0xc69d 0x91f3 0x887 0xc8f3 0x91b2 0x8b0 0xcb49 0x9171 0x8d5 0xcd9f 0x9124 0x901 0xcff5 0x90d6 0x92d 0xd24b 0x908c 0x955 0xd4a2 0x905c 0x981 0xd6f8 0x9044 0x9c6 0xd94e 0x902d 0xa2a 0xdba4 0x9011 0xaa1 0xddfa 0x8ff2 0xb44 0xe050 0x8fc0 0xc2f 0xe2a7 0x8f55 0xd48 0xe4fd 0x8d93 0xef8 0xe753 0x84d0 0x1da6>;
				battery2_profile_t4_num = <0x64>;
				battery2_profile_t4 = <0x00 0xad58 0x26f2 0x256 0xac7c 0x26fa 0x4ac 0xabc6 0x270a 0x703 0xab1f 0x26da 0x959 0xaa7a 0x26e9 0xbaf 0xa9dd 0x26f2 0xe05 0xa946 0x269a 0x105b 0xa8b4 0x261f 0x12b1 0xa828 0x25ac 0x1508 0xa79c 0x254d 0x175e 0xa713 0x24d0 0x19b4 0xa691 0x2416 0x1c0a 0xa610 0x2375 0x1e60 0xa595 0x22f1 0x20b6 0xa51c 0x2281 0x230d 0xa4a2 0x2215 0x2563 0xa42b 0x21af 0x27b9 0xa3b4 0x2166 0x2a0f 0xa33b 0x211a 0x2c65 0xa2c6 0x20ef 0x2ebb 0xa252 0x2095 0x3112 0xa1de 0x2033 0x3368 0xa16e 0x1fee 0x35be 0xa0ff 0x1fb2 0x3814 0xa090 0x1f7e 0x3a6a 0xa022 0x1f64 0x3cc0 0x9fb4 0x1f51 0x3f17 0x9f44 0x1f30 0x416d 0x9ed0 0x1f09 0x43c3 0x9e57 0x1ed4 0x4619 0x9ddf 0x1e93 0x486f 0x9d68 0x1e50 0x4ac5 0x9cf2 0x1e10 0x4d1c 0x9c7e 0x1dd9 0x4f72 0x9c11 0x1db6 0x51c8 0x9ba6 0x1d8d 0x541e 0x9b3d 0x1d55 0x5674 0x9ad6 0x1d3d 0x58cb 0x9a71 0x1d1c 0x5b21 0x9a0e 0x1d06 0x5d77 0x99ad 0x1cec 0x5fcd 0x994c 0x1cd3 0x6223 0x98ec 0x1cbe 0x6479 0x9891 0x1cb2 0x66d0 0x9838 0x1cb9 0x6926 0x97e7 0x1cd1 0x6b7c 0x9796 0x1cca 0x6dd2 0x974a 0x1ccc 0x7028 0x9704 0x1ce1 0x727e 0x96bf 0x1d05 0x74d5 0x967b 0x1d20 0x772b 0x963c 0x1d43 0x7981 0x9604 0x1d70 0x7bd7 0x95c9 0x1d94 0x7e2d 0x9595 0x1db5 0x8083 0x9562 0x1dd3 0x82da 0x9535 0x1e0a 0x8530 0x9509 0x1e3c 0x8786 0x94e2 0x1e70 0x89dc 0x94bd 0x1ea5 0x8c32 0x949f 0x1ef5 0x8e88 0x9485 0x1f48 0x90df 0x946e 0x1fb4 0x9335 0x9456 0x2023 0x958b 0x9442 0x20ac 0x97e1 0x9429 0x214f 0x9a37 0x9414 0x2218 0x9c8e 0x93ff 0x22eb 0x9ee4 0x93e5 0x23d2 0xa13a 0x93cb 0x24d2 0xa390 0x93b3 0x25ed 0xa5e6 0x939a 0x26dd 0xa83c 0x937e 0x27f3 0xaa93 0x9362 0x290b 0xace9 0x9343 0x2a18 0xaf3f 0x9324 0x2b2e 0xb195 0x9306 0x2c57 0xb3eb 0x92e3 0x2d76 0xb641 0x92bf 0x2e8c 0xb898 0x9299 0x2f82 0xbaee 0x9272 0x30aa 0xbd44 0x9245 0x31c3 0xbf9a 0x9217 0x32b3 0xc1f0 0x91e5 0x3396 0xc446 0x91b1 0x347a 0xc69d 0x917b 0x354f 0xc8f3 0x9142 0x3612 0xcb49 0x9107 0x36e7 0xcd9f 0x90cd 0x37c0 0xcff5 0x908d 0x389f 0xd24b 0x904d 0x397f 0xd4a2 0x900d 0x3a72 0xd6f8 0x8fd9 0x3b9e 0xd94e 0x8faf 0x3d3a 0xdba4 0x8f7f 0x3f3a 0xddfa 0x8f4c 0x41c0 0xe050 0x8f0d 0x45a3 0xe2a7 0x8ea7 0x4ca4 0xe4fd 0x8e10 0x574e 0xe753 0x8e10 0x574e>;
				battery3_profile_t0_num = <0x64>;
				battery3_profile_t0 = <0x00 0xacba 0x49c 0x264 0xac26 0x49a 0x4c9 0xaba7 0x490 0x72d 0xab2d 0x48a 0x991 0xaab8 0x491 0xbf6 0xaa47 0x489 0xe5a 0xa9d7 0x490 0x10be 0xa965 0x48a 0x1323 0xa8f7 0x490 0x1587 0xa880 0x488 0x17eb 0xa806 0x488 0x1a50 0xa78d 0x488 0x1cb4 0xa712 0x488 0x1f18 0xa698 0x488 0x217d 0xa61b 0x48e 0x23e1 0xa59d 0x492 0x2645 0xa51e 0x48f 0x28aa 0xa4a3 0x489 0x2b0e 0xa427 0x492 0x2d72 0xa3aa 0x49c 0x2fd7 0xa334 0x49c 0x323b 0xa2c0 0x49c 0x349f 0xa24b 0x4a5 0x3704 0xa1d0 0x4b0 0x3968 0xa15e 0x4b3 0x3bcc 0xa0ea 0x4ba 0x3e31 0xa07a 0x4ba 0x4095 0xa006 0x4c4 0x42f9 0x9f9a 0x4ce 0x455e 0x9f28 0x4d7 0x47c2 0x9ebe 0x4e9 0x4a26 0x9e54 0x4f5 0x4c8b 0x9ded 0x4ed 0x4eef 0x9d87 0x4fd 0x5153 0x9d24 0x50a 0x53b8 0x9cc5 0x512 0x561c 0x9c63 0x51e 0x5880 0x9c09 0x532 0x5ae5 0x9bac 0x544 0x5d49 0x9b52 0x55a 0x5fad 0x9afa 0x563 0x6212 0x9aa1 0x56f 0x6476 0x9a2e 0x578 0x66da 0x99a0 0x55c 0x693f 0x9911 0x517 0x6ba3 0x98a5 0x4ce 0x6e07 0x9844 0x495 0x706c 0x97f7 0x475 0x72d0 0x97af 0x46a 0x7534 0x9769 0x461 0x7799 0x972c 0x456 0x79fd 0x96ef 0x453 0x7c61 0x96b4 0x44c 0x7ec6 0x967e 0x44c 0x812a 0x9649 0x451 0x838e 0x9615 0x458 0x85f3 0x95e3 0x460 0x8857 0x95b4 0x460 0x8abb 0x9587 0x469 0x8d20 0x955c 0x46a 0x8f84 0x9533 0x46d 0x91e8 0x950b 0x47a 0x944d 0x94e3 0x47e 0x96b1 0x94bc 0x488 0x9915 0x949a 0x488 0x9b7a 0x9479 0x488 0x9dde 0x945a 0x488 0xa042 0x943a 0x49a 0xa2a7 0x9417 0x49c 0xa50b 0x93e5 0x49f 0xa76f 0x939d 0x4a6 0xa9d4 0x9348 0x49e 0xac38 0x930c 0x488 0xae9c 0x92d7 0x484 0xb101 0x92a8 0x46b 0xb365 0x9276 0x459 0xb5c9 0x9248 0x444 0xb82e 0x921a 0x44b 0xba92 0x91ef 0x445 0xbcf6 0x91c9 0x44d 0xbf5b 0x919e 0x44e 0xc1bf 0x9168 0x456 0xc423 0x9124 0x45e 0xc688 0x90e3 0x452 0xc8ec 0x90a5 0x445 0xcb50 0x905b 0x454 0xcdb5 0x9009 0x460 0xd019 0x8fea 0x460 0xd27d 0x8fdf 0x44f 0xd4e2 0x8fd3 0x452 0xd746 0x8fc8 0x460 0xd9aa 0x8faa 0x46e 0xdc0f 0x8f64 0x487 0xde73 0x8e55 0x49f 0xe0d7 0x8cc9 0x4ca 0xe33c 0x8a85 0x4ca 0xe3ac 0x878f 0x4b2 0xe53c 0x8574 0x4b2 0xe618 0x8574 0x4b2 0xe6e0 0x8574 0x4b2>;
				battery3_profile_t1_num = <0x64>;
				battery3_profile_t1 = <0x00 0xad45 0x578 0x264 0xacae 0x580 0x4c9 0xac31 0x580 0x72d 0xabc2 0x57a 0x991 0xab58 0x581 0xbf6 0xaaee 0x579 0xe5a 0xaa84 0x580 0x10be 0xaa18 0x57a 0x1323 0xa9ad 0x580 0x1587 0xa93a 0x578 0x17eb 0xa8c5 0x578 0x1a50 0xa851 0x578 0x1cb4 0xa7d7 0x578 0x1f18 0xa75e 0x578 0x217d 0xa6e1 0x57e 0x23e1 0xa665 0x578 0x2645 0xa5e9 0x57f 0x28aa 0xa56a 0x579 0x2b0e 0xa4f3 0x578 0x2d72 0xa476 0x578 0x2fd7 0xa3fa 0x578 0x323b 0xa37f 0x578 0x349f 0xa305 0x581 0x3704 0xa28f 0x58c 0x3968 0xa217 0x58f 0x3bcc 0xa1a1 0x596 0x3e31 0xa12b 0x596 0x4095 0xa0b9 0x596 0x42f9 0xa047 0x5a0 0x455e 0x9fd7 0x5a9 0x47c2 0x9f6b 0x5bb 0x4a26 0x9f02 0x5d1 0x4c8b 0x9e95 0x5c9 0x4eef 0x9e2e 0x5d9 0x5153 0x9dc6 0x5e6 0x53b8 0x9d61 0x5e4 0x561c 0x9cfe 0x5e6 0x5880 0x9c9f 0x5fa 0x5ae5 0x9c40 0x60c 0x5d49 0x9be6 0x622 0x5fad 0x9b89 0x62b 0x6212 0x9b2b 0x637 0x6476 0x9ac8 0x654 0x66da 0x9a53 0x642 0x693f 0x99cd 0x5f3 0x6ba3 0x9941 0x5aa 0x6e07 0x98c4 0x57b 0x706c 0x985e 0x551 0x72d0 0x9808 0x550 0x7534 0x97be 0x547 0x7799 0x9776 0x53c 0x79fd 0x9735 0x539 0x7c61 0x96f8 0x528 0x7ec6 0x96bf 0x528 0x812a 0x9688 0x52d 0x838e 0x9654 0x534 0x85f3 0x9623 0x53c 0x8857 0x95f0 0x528 0x8abb 0x95c5 0x531 0x8d20 0x9597 0x532 0x8f84 0x956c 0x549 0x91e8 0x9544 0x556 0x944d 0x951d 0x55a 0x96b1 0x94fa 0x564 0x9915 0x94d6 0x564 0x9b7a 0x94b3 0x564 0x9dde 0x9490 0x564 0xa042 0x9474 0x576 0xa2a7 0x9455 0x578 0xa50b 0x9436 0x57b 0xa76f 0x941a 0x582 0xa9d4 0x93f9 0x57a 0xac38 0x93d4 0x564 0xae9c 0x93aa 0x560 0xb101 0x937e 0x551 0xb365 0x9351 0x535 0xb5c9 0x9321 0x516 0xb82e 0x92f7 0x527 0xba92 0x92cb 0x521 0xbcf6 0x92a6 0x529 0xbf5b 0x9280 0x52a 0xc1bf 0x925c 0x532 0xc423 0x922f 0x53a 0xc688 0x91f0 0x52e 0xc8ec 0x91af 0x521 0xcb50 0x9176 0x4cc 0xcdb5 0x913b 0x53c 0xd019 0x90e9 0x53c 0xd27d 0x909c 0x52b 0xd4e2 0x9076 0x52e 0xd746 0x9066 0x514 0xd9aa 0x905a 0x54a 0xdc0f 0x904b 0x559 0xde73 0x9033 0x57b 0xe0d7 0x900a 0x592 0xe33c 0x8f80 0x5a6 0xe4d8 0x8dea 0x58e 0xe5a0 0x8bbb 0x5b8 0xe668 0x88ea 0x5f7 0xe6e0 0x84a7 0x690>;
				battery3_profile_t2_num = <0x64>;
				battery3_profile_t2 = <0x00 0xad17 0x758 0x264 0xac73 0x758 0x4c9 0xabf6 0x756 0x72d 0xab86 0x750 0x991 0xab17 0x73c 0xbf6 0xaaaf 0x739 0xe5a 0xaa42 0x729 0x10be 0xa9d6 0x719 0x1323 0xa969 0x713 0x1587 0xa8f8 0x71c 0x17eb 0xa87e 0x6fe 0x1a50 0xa807 0x6fe 0x1cb4 0xa78c 0x6f7 0x1f18 0xa70e 0x6eb 0x217d 0xa692 0x6e1 0x23e1 0xa617 0x6e6 0x2645 0xa59a 0x6e6 0x28aa 0xa51d 0x6ea 0x2b0e 0xa4a0 0x6ea 0x2d72 0xa426 0x6dd 0x2fd7 0xa3ab 0x6d6 0x323b 0xa32f 0x6d6 0x349f 0xa2b6 0x6d6 0x3704 0xa23e 0x6d6 0x3968 0xa1c6 0x6da 0x3bcc 0xa152 0x6ec 0x3e31 0xa0de 0x6ec 0x4095 0xa06c 0x6ef 0x42f9 0x9ffb 0x6f9 0x455e 0x9f8c 0x708 0x47c2 0x9f1e 0x70f 0x4a26 0x9eb8 0x72e 0x4c8b 0x9e4c 0x747 0x4eef 0x9ddf 0x758 0x5153 0x9d71 0x752 0x53b8 0x9d08 0x766 0x561c 0x9c9b 0x758 0x5880 0x9c3b 0x75e 0x5ae5 0x9bda 0x75d 0x5d49 0x9b7a 0x75f 0x5fad 0x9b12 0x759 0x6212 0x9aa7 0x748 0x6476 0x9a2d 0x717 0x66da 0x99b2 0x6e6 0x693f 0x9937 0x6a5 0x6ba3 0x98c5 0x667 0x6e07 0x985f 0x646 0x706c 0x9807 0x634 0x72d0 0x97b4 0x61e 0x7534 0x976d 0x621 0x7799 0x9729 0x622 0x79fd 0x96ec 0x61e 0x7c61 0x96af 0x618 0x7ec6 0x9676 0x618 0x812a 0x9641 0x622 0x838e 0x960f 0x622 0x85f3 0x95db 0x627 0x8857 0x95ad 0x633 0x8abb 0x9581 0x63f 0x8d20 0x9555 0x63e 0x8f84 0x952b 0x63a 0x91e8 0x9502 0x646 0x944d 0x94db 0x64a 0x96b1 0x94b5 0x64b 0x9915 0x9493 0x65e 0x9b7a 0x9472 0x663 0x9dde 0x9451 0x661 0xa042 0x9432 0x663 0xa2a7 0x9415 0x66a 0xa50b 0x93f9 0x66e 0xa76f 0x93dc 0x66e 0xa9d4 0x93c2 0x672 0xac38 0x93a9 0x672 0xae9c 0x9390 0x672 0xb101 0x9374 0x672 0xb365 0x9351 0x66b 0xb5c9 0x9328 0x668 0xb82e 0x92ff 0x662 0xba92 0x92d6 0x662 0xbcf6 0x92b2 0x67a 0xbf5b 0x9288 0x686 0xc1bf 0x9256 0x691 0xc423 0x9218 0x6a3 0xc688 0x91d9 0x6bd 0xc8ec 0x9199 0x6da 0xcb50 0x915b 0x6f3 0xcdb5 0x910c 0x714 0xd019 0x90b9 0x727 0xd27d 0x9080 0x742 0xd4e2 0x9064 0x777 0xd746 0x9050 0x7c9 0xd9aa 0x9037 0x822 0xdc0f 0x900f 0x8a4 0xde73 0x8fd8 0x955 0xe0d7 0x8f4e 0xa27 0xe33c 0x8dc9 0xb13 0xe3c0 0x8b81 0xd1a 0xe488 0x8865 0x1126 0xe550 0x873f 0x12d4 0xe6e0 0x873f 0x12d4>;
				battery3_profile_t3_num = <0x64>;
				battery3_profile_t3 = <0x00 0xad36 0xdb6 0x264 0xac84 0xdb2 0x4c9 0xabfd 0xd90 0x72d 0xab86 0xd5f 0x991 0xab16 0xd49 0xbf6 0xaaaa 0xd3d 0xe5a 0xaa40 0xd31 0x10be 0xa9d4 0xd1f 0x1323 0xa966 0xd06 0x1587 0xa8f2 0xcda 0x17eb 0xa880 0xcc2 0x1a50 0xa80c 0xca0 0x1cb4 0xa795 0xc7d 0x1f18 0xa71c 0xc60 0x217d 0xa6a1 0xc42 0x23e1 0xa627 0xc30 0x2645 0xa5ac 0xc1f 0x28aa 0xa531 0xc0a 0x2b0e 0xa4b6 0xbef 0x2d72 0xa43b 0xbd1 0x2fd7 0xa3c0 0xbbd 0x323b 0xa347 0xbb8 0x349f 0xa2ce 0xb9d 0x3704 0xa25b 0xba2 0x3968 0xa1e2 0xb90 0x3bcc 0xa16c 0xb86 0x3e31 0xa0f8 0xb7e 0x4095 0xa085 0xb85 0x42f9 0xa011 0xb68 0x455e 0x9fa3 0xb68 0x47c2 0x9f37 0xb76 0x4a26 0x9ecd 0xb98 0x4c8b 0x9e5c 0xb9d 0x4eef 0x9de8 0xbaa 0x5153 0x9d71 0xb9e 0x53b8 0x9cfe 0xb92 0x561c 0x9c89 0xb72 0x5880 0x9c1a 0xb5b 0x5ae5 0x9ba9 0xb28 0x5d49 0x9b3b 0xb03 0x5fad 0x9acd 0xade 0x6212 0x9a5c 0xab8 0x6476 0x99e8 0xa87 0x66da 0x9976 0xa62 0x693f 0x9907 0xa39 0x6ba3 0x98a4 0xa22 0x6e07 0x9845 0xa11 0x706c 0x97f1 0xa0a 0x72d0 0x97a1 0x9f5 0x7534 0x9758 0x9e3 0x7799 0x9710 0x9ee 0x79fd 0x96d0 0xa01 0x7c61 0x9693 0xa16 0x7ec6 0x9657 0xa1e 0x812a 0x961f 0xa33 0x838e 0x95ec 0xa47 0x85f3 0x95b7 0xa4e 0x8857 0x9584 0xa5e 0x8abb 0x9559 0xa77 0x8d20 0x9529 0xa7a 0x8f84 0x9500 0xa8a 0x91e8 0x94d8 0xa9c 0x944d 0x94b2 0xaa8 0x96b1 0x9489 0xaab 0x9915 0x9467 0xab1 0x9b7a 0x9446 0xaaa 0x9dde 0x9428 0xaaa 0xa042 0x9409 0xaaa 0xa2a7 0x93f0 0xab4 0xa50b 0x93dd 0xac0 0xa76f 0x93cc 0xade 0xa9d4 0x93ba 0xaf7 0xac38 0x93a9 0xb14 0xae9c 0x9397 0xb34 0xb101 0x937e 0xb63 0xb365 0x9364 0xba0 0xb5c9 0x9341 0xbca 0xb82e 0x931b 0xc0c 0xba92 0x92f3 0xc4e 0xbcf6 0x92c7 0xc9d 0xbf5b 0x9295 0xcee 0xc1bf 0x9260 0xd57 0xc423 0x9220 0xdc9 0xc688 0x91d8 0xe4a 0xc8ec 0x9192 0xedc 0xcb50 0x9148 0xf85 0xcdb5 0x90fa 0x105d 0xd019 0x90a1 0x113c 0xd27d 0x9059 0x1262 0xd4e2 0x9021 0x13ac 0xd746 0x8ff8 0x155a 0xd9aa 0x8fce 0x179f 0xdc0f 0x8fa0 0x1a9c 0xde73 0x8f4c 0x1f35 0xe0d7 0x8ee5 0x249a 0xe33c 0x8de5 0x2e00 0xe3c0 0x8c10 0x3cec 0xe488 0x8af3 0x4632 0xe618 0x8af3 0x4632 0xe6e0 0x8af3 0x4632>;
				battery3_profile_t4_num = <0x64>;
				battery3_profile_t4 = <0x00 0xad2c 0x1bb2 0x264 0xac40 0x1bb6 0x4c9 0xab8e 0x1bbb 0x72d 0xaaf0 0x1b9c 0x991 0xaa5d 0x1b5e 0xbf6 0xa9d0 0x1b29 0xe5a 0xa948 0x1ae3 0x10be 0xa8c4 0x1aa0 0x1323 0xa842 0x1a5a 0x1587 0xa7c4 0x1a17 0x17eb 0xa742 0x19d2 0x1a50 0xa6c3 0x199d 0x1cb4 0xa646 0x1958 0x1f18 0xa5cb 0x1921 0x217d 0xa555 0x18f8 0x23e1 0xa4d9 0x18b5 0x2645 0xa45d 0x187b 0x28aa 0xa3e3 0x1852 0x2b0e 0xa36d 0x1823 0x2d72 0xa2f8 0x17f4 0x2fd7 0xa283 0x17d7 0x323b 0xa212 0x17c4 0x349f 0xa199 0x17a4 0x3704 0xa120 0x1777 0x3968 0xa0a9 0x175b 0x3bcc 0xa039 0x173c 0x3e31 0x9fd0 0x1738 0x4095 0x9f6a 0x173e 0x42f9 0x9ef6 0x1736 0x455e 0x9e7a 0x170c 0x47c2 0x9df9 0x16e3 0x4a26 0x9d78 0x16b5 0x4c8b 0x9cfb 0x167e 0x4eef 0x9c7f 0x1645 0x5153 0x9c07 0x160e 0x53b8 0x9b95 0x15d5 0x561c 0x9b29 0x15b7 0x5880 0x9ac9 0x1597 0x5ae5 0x9a69 0x157c 0x5d49 0x9a03 0x154c 0x5fad 0x999c 0x151b 0x6212 0x9935 0x14f5 0x6476 0x98d3 0x14c9 0x66da 0x9870 0x14f9 0x693f 0x9818 0x1530 0x6ba3 0x97c2 0x1536 0x6e07 0x9771 0x1539 0x706c 0x9727 0x1545 0x72d0 0x96dc 0x153c 0x7534 0x9699 0x1549 0x7799 0x965c 0x155c 0x79fd 0x9620 0x1572 0x7c61 0x95e6 0x1590 0x7ec6 0x95af 0x15bb 0x812a 0x9577 0x15e4 0x838e 0x9547 0x1634 0x85f3 0x9518 0x166a 0x8857 0x94e9 0x1695 0x8abb 0x94c0 0x16ce 0x8d20 0x949d 0x16df 0x8f84 0x947a 0x1700 0x91e8 0x945e 0x1725 0x944d 0x9446 0x1770 0x96b1 0x9430 0x17c5 0x9915 0x941c 0x1818 0x9b7a 0x940b 0x1877 0x9dde 0x93fa 0x18db 0xa042 0x93e3 0x1961 0xa2a7 0x93cf 0x19fa 0xa50b 0x93b9 0x1aa2 0xa76f 0x93a0 0x1b66 0xa9d4 0x9386 0x1c44 0xac38 0x936b 0x1d18 0xae9c 0x934c 0x1e0c 0xb101 0x932c 0x1f45 0xb365 0x9308 0x2071 0xb5c9 0x92e2 0x2197 0xb82e 0x92bb 0x22b0 0xba92 0x928c 0x23e4 0xbcf6 0x9259 0x250c 0xbf5b 0x9226 0x264b 0xc1bf 0x91ed 0x2795 0xc423 0x91ab 0x295f 0xc688 0x9167 0x2b55 0xc8ec 0x9120 0x2d8b 0xcb50 0x90d8 0x3002 0xcdb5 0x9088 0x328b 0xd019 0x903d 0x3514 0xd27d 0x8ffa 0x3788 0xd4e2 0x8fc3 0x39ed 0xd746 0x8f96 0x3c69 0xd9aa 0x8f6b 0x3f28 0xdc0f 0x8f36 0x4262 0xde73 0x8eea 0x4700 0xe0d7 0x8e6b 0x4f92 0xe33c 0x8da7 0x5e4c 0xe3c0 0x8da7 0x5e4c 0xe488 0x8da7 0x5e4c 0xe618 0x8da7 0x5e4c 0xe6e0 0x8da7 0x5e4c>;
				phandle = <0x5e>;
			};

			mtk_charger_type {
				compatible = "mediatek,mt6357-charger-type";
				io-channels = <0x23 0x02>;
				io-channel-names = "pmic_vbus";
				bc12_active = <0x01>;
				phandle = <0x25>;
			};

			mt6357_charger {
				compatible = "mediatek,mt6357-pulse-charger";
				charger_name = "primary_chg";
				alias_name = "mt6357";
				ichg = <0x1e8480>;
				cv = <0x432380>;
				vcdt_hv_thres = <0x6acfc0>;
				vbat_ov_thres = <0x43e6d0>;
				phandle = <0x75>;
			};

			mtk_ts_pmic {
				compatible = "mediatek,mtk_ts_pmic";
				io-channels = <0x23 0x05 0x23 0x06 0x23 0x07>;
				io-channel-names = "pmic_chip_temp\0pmic_buck1_temp\0pmic_buck2_temp";
				interconnects = <0x23 0x01>;
				#interconnect-cells = <0x01>;
				phandle = <0x2a>;
			};

			mt6357_ts_buck1 {
				compatible = "mediatek,mt6357_ts_buck1";
				io-channels = <0x23 0x06>;
				io-channel-names = "pmic_buck1_temp";
				interconnects = <0x2a 0x01>;
				phandle = <0x76>;
			};

			mt6357_ts_buck2 {
				compatible = "mediatek,mt6357_ts_buck2";
				io-channels = <0x23 0x07>;
				io-channel-names = "pmic_buck2_temp";
				interconnects = <0x2a 0x01>;
				phandle = <0x77>;
			};

			pmic_efuse {
				compatible = "mediatek,mt6357-efuse";
				#address-cells = <0x01>;
				#size-cells = <0x01>;
				phandle = <0x24>;
			};

			mt6357regulator {
				compatible = "mediatek,mt6357-regulator";
				phandle = <0x78>;

				buck_vs1 {
					regulator-name = "vs1";
					regulator-min-microvolt = <0x124f80>;
					regulator-max-microvolt = <0x2191c0>;
					regulator-ramp-delay = <0x30d4>;
					regulator-enable-ramp-delay = <0xdc>;
					regulator-always-on;
					phandle = <0x79>;
				};

				buck_vmodem {
					regulator-name = "vmodem";
					regulator-min-microvolt = <0x7a120>;
					regulator-max-microvolt = <0x123716>;
					regulator-ramp-delay = <0x186a>;
					regulator-enable-ramp-delay = <0xdc>;
					regulator-always-on;
					phandle = <0x35>;
				};

				buck_vcore {
					regulator-name = "vcore";
					regulator-min-microvolt = <0x7ea5e>;
					regulator-max-microvolt = <0x1406f4>;
					regulator-ramp-delay = <0x186a>;
					regulator-enable-ramp-delay = <0xdc>;
					regulator-always-on;
					phandle = <0x36>;
				};

				buck_vproc {
					regulator-name = "vproc";
					regulator-min-microvolt = <0x7ea5e>;
					regulator-max-microvolt = <0x1406f4>;
					regulator-ramp-delay = <0x186a>;
					regulator-enable-ramp-delay = <0xdc>;
					regulator-always-on;
					phandle = <0x7a>;
				};

				buck_vpa {
					regulator-name = "vpa";
					regulator-min-microvolt = <0x7a120>;
					regulator-max-microvolt = <0x37b1d0>;
					regulator-ramp-delay = <0xc350>;
					regulator-enable-ramp-delay = <0xdc>;
					phandle = <0x7b>;
				};

				ldo_vfe28 {
					regulator-name = "vfe28";
					regulator-min-microvolt = <0x2ab980>;
					regulator-max-microvolt = <0x2ab980>;
					regulator-enable-ramp-delay = <0x108>;
					phandle = <0x7c>;
				};

				ldo_vxo22 {
					regulator-name = "vxo22";
					regulator-min-microvolt = <0x2191c0>;
					regulator-max-microvolt = <0x249f00>;
					regulator-enable-ramp-delay = <0x6e>;
					regulator-always-on;
					phandle = <0x7d>;
				};

				ldo_vrf18 {
					regulator-name = "vrf18";
					regulator-min-microvolt = <0x1b7740>;
					regulator-max-microvolt = <0x1b7740>;
					regulator-enable-ramp-delay = <0x6e>;
					phandle = <0x7e>;
				};

				ldo_vrf12 {
					regulator-name = "vrf12";
					regulator-min-microvolt = <0x124f80>;
					regulator-max-microvolt = <0x124f80>;
					regulator-enable-ramp-delay = <0x6e>;
					phandle = <0x7f>;
				};

				ldo_vefuse {
					regulator-name = "vefuse";
					regulator-min-microvolt = <0x124f80>;
					regulator-max-microvolt = <0x325aa0>;
					regulator-enable-ramp-delay = <0x108>;
					phandle = <0x80>;
				};

				ldo_vcn33_bt {
					regulator-name = "vcn33_bt";
					regulator-min-microvolt = <0x325aa0>;
					regulator-max-microvolt = <0x3567e0>;
					regulator-enable-ramp-delay = <0x108>;
					phandle = <0x81>;
				};

				ldo_vcn33_wifi {
					regulator-name = "vcn33_wifi";
					regulator-min-microvolt = <0x325aa0>;
					regulator-max-microvolt = <0x3567e0>;
					regulator-enable-ramp-delay = <0x108>;
					phandle = <0x82>;
				};

				ldo_vcn28 {
					regulator-name = "vcn28";
					regulator-min-microvolt = <0x2ab980>;
					regulator-max-microvolt = <0x2ab980>;
					regulator-enable-ramp-delay = <0x108>;
					phandle = <0x83>;
				};

				ldo_vcn18 {
					regulator-name = "vcn18";
					regulator-min-microvolt = <0x1b7740>;
					regulator-max-microvolt = <0x1b7740>;
					regulator-enable-ramp-delay = <0x108>;
					phandle = <0x84>;
				};

				ldo_vcama {
					regulator-name = "vcama";
					regulator-min-microvolt = <0x2625a0>;
					regulator-max-microvolt = <0x2ab980>;
					regulator-enable-ramp-delay = <0x108>;
					phandle = <0x85>;
				};

				ldo_vcamd {
					regulator-name = "vcamd";
					regulator-min-microvolt = <0xf4240>;
					regulator-max-microvolt = <0x1b7740>;
					regulator-enable-ramp-delay = <0x108>;
					phandle = <0x86>;
				};

				ldo_vcamio {
					regulator-name = "vcamio";
					regulator-min-microvolt = <0x1b7740>;
					regulator-max-microvolt = <0x1b7740>;
					regulator-enable-ramp-delay = <0x108>;
					phandle = <0x87>;
				};

				ldo_vldo28 {
					regulator-name = "vldo28";
					regulator-min-microvolt = <0x2ab980>;
					regulator-max-microvolt = <0x2dc6c0>;
					regulator-enable-ramp-delay = <0x108>;
					phandle = <0x5c>;
				};

				ldo_vsram_others {
					regulator-name = "vsram_others";
					regulator-min-microvolt = <0x7ea5e>;
					regulator-max-microvolt = <0x1406f4>;
					regulator-ramp-delay = <0x186a>;
					regulator-enable-ramp-delay = <0x6e>;
					regulator-always-on;
					phandle = <0x88>;
				};

				ldo_vsram_proc {
					regulator-name = "vsram_proc";
					regulator-min-microvolt = <0x7ea5e>;
					regulator-max-microvolt = <0x1406f4>;
					regulator-ramp-delay = <0x186a>;
					regulator-enable-ramp-delay = <0x6e>;
					regulator-always-on;
					phandle = <0x89>;
				};

				ldo_vaux18 {
					regulator-name = "vaux18";
					regulator-min-microvolt = <0x1b7740>;
					regulator-max-microvolt = <0x1b7740>;
					regulator-enable-ramp-delay = <0x108>;
					regulator-always-on;
					phandle = <0x8a>;
				};

				ldo_vaud28 {
					regulator-name = "vaud28";
					regulator-min-microvolt = <0x2ab980>;
					regulator-max-microvolt = <0x2ab980>;
					regulator-enable-ramp-delay = <0x108>;
					regulator-always-on;
					phandle = <0x8b>;
				};

				ldo_vio28 {
					regulator-name = "vio28";
					regulator-min-microvolt = <0x2ab980>;
					regulator-max-microvolt = <0x2ab980>;
					regulator-enable-ramp-delay = <0x108>;
					regulator-always-on;
					phandle = <0x8c>;
				};

				ldo_vio18 {
					regulator-name = "vio18";
					regulator-min-microvolt = <0x1b7740>;
					regulator-max-microvolt = <0x1b7740>;
					regulator-enable-ramp-delay = <0x108>;
					regulator-always-on;
					phandle = <0x8d>;
				};

				ldo_vdram {
					regulator-name = "vdram";
					regulator-min-microvolt = <0x10c8e0>;
					regulator-max-microvolt = <0x124f80>;
					regulator-enable-ramp-delay = <0xce4>;
					regulator-always-on;
					phandle = <0x8e>;
				};

				ldo_vmc {
					regulator-name = "vmc";
					regulator-min-microvolt = <0x1b7740>;
					regulator-max-microvolt = <0x325aa0>;
					regulator-enable-ramp-delay = <0x2c>;
					phandle = <0x56>;
				};

				ldo_vmch {
					regulator-name = "vmch";
					regulator-min-microvolt = <0x2c4020>;
					regulator-max-microvolt = <0x325aa0>;
					regulator-enable-ramp-delay = <0x2c>;
					phandle = <0x55>;
				};

				ldo_vemc {
					regulator-name = "vemc";
					regulator-min-microvolt = <0x2c4020>;
					regulator-max-microvolt = <0x325aa0>;
					regulator-enable-ramp-delay = <0x2c>;
					regulator-always-on;
					phandle = <0x4f>;
				};

				ldo_vsim1 {
					regulator-name = "vsim1";
					regulator-min-microvolt = <0x19f0a0>;
					regulator-max-microvolt = <0x2f4d60>;
					regulator-enable-ramp-delay = <0x108>;
					phandle = <0x8f>;
				};

				ldo_vsim2 {
					regulator-name = "vsim2";
					regulator-min-microvolt = <0x19f0a0>;
					regulator-max-microvolt = <0x2f4d60>;
					regulator-enable-ramp-delay = <0x108>;
					phandle = <0x90>;
				};

				ldo_vibr {
					regulator-name = "vibr";
					regulator-min-microvolt = <0x124f80>;
					regulator-max-microvolt = <0x325aa0>;
					regulator-enable-ramp-delay = <0x2c>;
					phandle = <0x1f>;
				};

				ldo_vusb33 {
					regulator-name = "vusb33";
					regulator-min-microvolt = <0x2dc6c0>;
					regulator-max-microvolt = <0x2f4d60>;
					regulator-enable-ramp-delay = <0x108>;
					regulator-always-on;
					phandle = <0x91>;
				};
			};

			mtk_dynamic_loading_throttling {
				compatible = "mediatek,mt6357-dynamic_loading_throttling";
				mediatek,charger = <0x2b>;
				uvlo-level = <0xa28>;
				isense_support;
				io-channels = <0x23 0x0f 0x23 0x10 0x23 0x01 0x23 0x00>;
				io-channel-names = "pmic_ptim\0pmic_imix_r\0pmic_isense\0pmic_batadc";
			};

			pmic_lbat_service {
				compatible = "mediatek,mt6357-lbat_service";
			};

			mt6357_debug {
				compatible = "mediatek,mt63xx-debug";
			};

			mt63xx-oc-debug {
				compatible = "mediatek,mt63xx-oc-debug";
			};

			leds-mt6357 {
				compatible = "mediatek,mt6357_leds";

				Isink1 {
					reg = <0x01>;
					label = "blue";
					linux,default-trigger = "none";
					default-state = "off";
				};
			};

			mtk_rtc {
				compatible = "mediatek,mt6357-rtc";
				#address-cells = <0x01>;
				#size-cells = <0x01>;
				bootmode = <0x26>;
				phandle = <0x92>;

				fg_init {
					reg = <0x00 0x01>;
					bits = <0x00 0x08>;
					phandle = <0x28>;
				};

				fg_soc {
					reg = <0x01 0x01>;
					bits = <0x00 0x08>;
					phandle = <0x29>;
				};

				ext_32k {
					reg = <0x02 0x01>;
					bits = <0x06 0x01>;
					phandle = <0x93>;
				};
			};

			pmic_codec {
				compatible = "mediatek,mt6357-sound";
				mediatek,pwrap-regmap = <0x12>;
				nvmem = <0x24>;
				nvmem-names = "pmic-hp-efuse";
				io-channels = <0x23 0x0c 0x23 0x09>;
				io-channel-names = "pmic_codec\0pmic_accdet";
				use_hp_depop_flow = <0x00>;
				use_ul_260k = <0x00>;
				phandle = <0x94>;
			};

			clock_buffer_ctrl {
				compatible = "mediatek,clock_buffer";
				n-clkbuf-pmic-dependent = <0x09>;
				clkbuf-pmic-dependent = "pmic-drvcurr\0pmic-auxout-sel\0pmic-auxout-xo\0pmic-auxout-drvcurr\0pmic-auxout-bblpm-en\0pmic-cofst-fpm\0pmic-cdac-fpm\0pmic-core-idac-fpm\0pmic-aac-fpm-swen";
				pmic-dcxo-cw = <0x788>;
				pmic-xo-mode = <0x788 0x00 0x788 0x03 0x788 0x06 0x788 0x09 0xffff 0xffff 0x7a2 0x08 0x7a2 0x0b>;
				pmic-xo-en = <0x788 0x02 0x788 0x05 0x788 0x08 0x788 0x0b 0xffff 0xffff 0x7a2 0x0a 0x7a2 0x0d>;
				pmic-bblpm-sw = <0x788 0x0c>;
				pmic-srclkeni3 = <0x44a 0x00>;
				n-pmic-drvcurr = <0x07>;
				pmic-drvcurr = <0x7b0 0x00 0x7b0 0x02 0x7b0 0x04 0x7b0 0x06 0xffff 0xffff 0x7b0 0x0a 0x7b0 0x0c>;
				n-pmic-auxout-sel = <0x06>;
				pmic-auxout-sel = <0x7b4 0x00 0x7b4 0x05 0x7b4 0x06 0x7b4 0x07 0x7b4 0x06 0x7b4 0x18>;
				n-pmic-auxout-xo = <0x07>;
				pmic-auxout-xo = <0x7b6 0x00 0x7b6 0x06 0x7b6 0x00 0x7b6 0x06 0xffff 0xffff 0x7b6 0x06 0x7b6 0x0c>;
				n-pmic-auxout-drvcurr = <0x07>;
				pmic-auxout-drvcurr = <0x7b6 0x01 0x7b6 0x07 0x7b6 0x01 0x7b6 0x07 0xffff 0xffff 0x7b6 0x01 0x7b6 0x0c>;
				n-pmic-auxout-bblpm-en = <0x01>;
				pmic-auxout-bblpm-en = <0x7b6 0x00>;
				n-pmic-cofst-fpm = <0x01>;
				pmic-cofst-fpm = <0x796 0x0e>;
				n-pmic-cdac-fpm = <0x01>;
				pmic-cdac-fpm = <0x794 0x00>;
				n-pmic-core-idac-fpm = <0x01>;
				pmic-core-idac-fpm = <0x79a 0x0e>;
				n-pmic-aac-fpm-swen = <0x01>;
				pmic-aac-fpm-swen = <0x79e 0x0e>;
				phandle = <0x95>;
			};
		};
	};

	scp@10500000 {
		compatible = "mediatek,scp";
		status = "okay";
		reg = <0x00 0x10500000 0x00 0x40000 0x00 0x105c0000 0x00 0x3000 0x00 0x105c4000 0x00 0x1000 0x00 0x105d4000 0x00 0x6000>;
		interrupts = <0x00 0x88 0x04>;
		core_1 = "enable";
		scp_sramSize = <0x40000>;
		scp_feature_tbl = <0x00 0x2f 0x01 0x164 0x02 0x3e 0x03 0x2f 0x04 0x1a 0x05 0x00 0x06 0xc8 0x07 0x00 0x08 0x64 0x09 0x0a>;
		scp_mem_key = "mediatek,reserve-memory-scp_share";
		scp_mem_tbl = <0x01 0x100000 0x04 0x200000>;
		phandle = <0x96>;
	};

	scp_dvfs {
		compatible = "mediatek,scp_dvfs";
		clocks = <0x0f 0x6c 0x21 0x0f 0x10 0x0f 0x1d 0x0f 0x04 0x0f 0x1a 0x0f 0x08 0x0f 0x1c>;
		clock-names = "clk_mux\0clk_pll_0\0clk_pll_1\0clk_pll_2\0clk_pll_3\0clk_pll_4\0clk_pll_5\0clk_pll_6";
		dvfsrc-opp-num = <0x03>;
		dvfs-opp = <0xff 0xff 0xff 0x00 0x00 0xfa 0x00 0xff 0xff 0xff 0x00 0x00 0x111 0x03 0xff 0xff 0xff 0x02 0x08 0x14a 0x05 0xff 0xff 0xff 0x03 0x0c 0x1a0 0x06>;
		pmic = <0x2c>;
		pmic-feature = "pmic-vow-lp\0pmic-pmrc";
		pmic-feature-cfg = <0x00 0x00>;
		gpio = <0x16 0x01>;
		gpio-feature = "gpio-mode";
		gpio-feature-cfg = <0x00>;
	};

	sleep_reg_md@1000f000 {
		compatible = "mediatek,sleep_reg_md";
		reg = <0x00 0x1000f000 0x00 0x1000>;
	};

	kp@10010000 {
		compatible = "mediatek,kp";
		reg = <0x00 0x10010000 0x00 0x1000>;
		interrupts = <0x00 0x7c 0x02>;
		clocks = <0x21>;
		clock-names = "kpd";
		phandle = <0x13>;
	};

	mrdump_ext_rst {
		compatible = "mediatek, mrdump_ext_rst-eint";
		force_mode = "EINT";
		mode = "IRQ";
		status = "okay";
		phandle = <0x97>;
	};

	touch {
		compatible = "mediatek,touch";
		phandle = <0x98>;
	};

	accdet {
		compatible = "mediatek,pmic-accdet";
		phandle = <0x99>;
	};

	fingerprint {
		compatible = "mediatek,goodix-fp";
		phandle = <0x9a>;
	};

	topmisc@10011000 {
		compatible = "mediatek,topmisc";
		reg = <0x00 0x10011000 0x00 0x1000>;
	};

	dvfsrc@10012000 {
		compatible = "mediatek,mt6761-dvfsrc";
		reg = <0x00 0x10012000 0x00 0x1000 0x00 0x10006000 0x00 0x1000>;
		reg-names = "dvfsrc\0spm";
		#address-cells = <0x02>;
		#size-cells = <0x02>;
		ranges;
		phandle = <0x9b>;

		opp2 {
			opp-level = <0x02>;
			phandle = <0x2f>;
		};

		opp1 {
			opp-level = <0x01>;
			phandle = <0x2e>;
		};

		opp0 {
			opp-level = <0x00>;
			phandle = <0x2d>;
		};

		dvfsrc-up {
			compatible = "mediatek,mt6761-dvfsrc-up";
		};

		dvfsrc-debug {
			compatible = "mediatek,mt6761-dvfsrc-debug";
			required-opps = <0x2d 0x2e 0x2f>;
		};

		dvfsrc-met {
			compatible = "mediatek,mt6761-dvfsrc-met";
		};

		qos@00110780 {
			compatible = "mediatek,mt6761-qos";
			reg = <0x00 0x110780 0x00 0x80>;
		};
	};

	mbist_ao@10013000 {
		compatible = "mediatek,mbist_ao";
		reg = <0x00 0x10013000 0x00 0x1000>;
	};

	apcldmain_ao@10014000 {
		compatible = "mediatek,apcldmain_ao";
		reg = <0x00 0x10014000 0x00 0x400>;
	};

	apcldmaout_ao@10014400 {
		compatible = "mediatek,apcldmaout_ao";
		reg = <0x00 0x10014400 0x00 0x400>;
	};

	apcldmamisc_ao@10014800 {
		compatible = "mediatek,apcldmamisc_ao";
		reg = <0x00 0x10014800 0x00 0x400>;
	};

	apcldmamisc_ao@10014c00 {
		compatible = "mediatek,apcldmamisc_ao";
		reg = <0x00 0x10014c00 0x00 0x400>;
	};

	aes_top0@10016000 {
		compatible = "mediatek,aes_top0";
		reg = <0x00 0x10016000 0x00 0x1000>;
	};

	timer@10017000 {
		compatible = "mediatek,sys_timer\0mediatek,mt6761-timer\0mediatek,mt6765-timer";
		reg = <0x00 0x10017000 0x00 0x1000>;
		reg-names = "sys_timer_base";
		interrupts = <0x00 0x8a 0x04>;
		clocks = <0x30>;
		phandle = <0x9c>;
	};

	modem_temp_share@10018000 {
		compatible = "mediatek,modem_temp_share";
		reg = <0x00 0x10018000 0x00 0x1000>;
	};

	security_ao@1001a000 {
		compatible = "mediatek,security_ao";
		reg = <0x00 0x1001a000 0x00 0x1000>;
	};

	topckgen_ao@1001b000 {
		compatible = "mediatek,topckgen_ao";
		reg = <0x00 0x1001b000 0x00 0x1000>;
	};

	iocfg_0@10002000 {
		compatible = "mediatek,iocfg_0";
		reg = <0x00 0x10002000 0x00 0x200>;
	};

	iocfg_1@10002200 {
		compatible = "mediatek,iocfg_1";
		reg = <0x00 0x10002200 0x00 0x200>;
	};

	iocfg_2@10002400 {
		compatible = "mediatek,iocfg_2";
		reg = <0x00 0x10002400 0x00 0x200>;
	};

	iocfg_3@10002600 {
		compatible = "mediatek,iocfg_3";
		reg = <0x00 0x10002600 0x00 0x200>;
	};

	iocfg_4@10002800 {
		compatible = "mediatek,iocfg_4";
		reg = <0x00 0x10002800 0x00 0x200>;
	};

	iocfg_5@10002a00 {
		compatible = "mediatek,iocfg_5";
		reg = <0x00 0x10002a00 0x00 0x200>;
	};

	mdcldmain_ao@10015000 {
		compatible = "mediatek,mdcldmain_ao";
		reg = <0x00 0x10015000 0x00 0x400>;
	};

	mdcldmaout_ao@10015400 {
		compatible = "mediatek,mdcldmaout_ao";
		reg = <0x00 0x10015400 0x00 0x400>;
	};

	mdcldmamisc_ao@10015800 {
		compatible = "mediatek,mdcldmamisc_ao";
		reg = <0x00 0x10015800 0x00 0x400>;
	};

	sys_cirq@10204000 {
		compatible = "mediatek,sys_cirq";
		reg = <0x00 0x10204000 0x00 0x1000>;
		mediatek,cirq_num = <0xd1>;
		mediatek,spi_start_offset = <0x10>;
		interrupts = <0x00 0xe0 0x08>;
	};

	mcucfg@10200000 {
		compatible = "mediatek,mcucfg";
		reg = <0x00 0x10200000 0x00 0x200>;
		interrupts = <0x00 0x00 0x04>;
	};

	mcucfg@10200200 {
		compatible = "mediatek,mcucfg";
		reg = <0x00 0x10200200 0x00 0x200>;
		interrupts = <0x00 0x01 0x08>;
	};

	mcucfg@10200400 {
		compatible = "mediatek,mcucfg";
		reg = <0x00 0x10200400 0x00 0x200>;
		interrupts = <0x00 0x02 0x04>;
	};

	mcucfg@10200600 {
		compatible = "mediatek,mcucfg";
		reg = <0x00 0x10200600 0x00 0x200>;
		interrupts = <0x00 0x03 0x04>;
	};

	mcucfg@10200800 {
		compatible = "mediatek,mcucfg";
		reg = <0x00 0x10200800 0x00 0x200>;
		interrupts = <0x00 0x04 0x04>;
	};

	mcucfg@10200a00 {
		compatible = "mediatek,mcucfg";
		reg = <0x00 0x10200a00 0x00 0x300>;
		interrupts = <0x00 0x05 0x08>;
	};

	mcucfg@10200f00 {
		compatible = "mediatek,mcucfg";
		reg = <0x00 0x10200f00 0x00 0x100>;
		interrupts = <0x00 0x06 0x08>;
	};

	mcucfg@10201000 {
		compatible = "mediatek,mcucfg";
		reg = <0x00 0x10201000 0x00 0x1000>;
		interrupts = <0x00 0x07 0x08>;
	};

	mcucfg@10202000 {
		compatible = "mediatek,mcucfg";
		reg = <0x00 0x10202000 0x00 0x1000>;
		interrupts = <0x00 0x08 0x08>;
	};

	mcucfg@10203000 {
		compatible = "mediatek,mcucfg";
		reg = <0x00 0x10203000 0x00 0x1000>;
		interrupts = <0x00 0x09 0x08>;
	};

	mcucfg_mp0_counter@10200000 {
		compatible = "mediatek,mcucfg_mp0_counter";
		reg = <0x00 0x10200000 0x00 0x4000>;
	};

	m4u@10205000 {
		cell-index = <0x00>;
		compatible = "mediatek,iommu_v0";
		reg = <0x00 0x10205000 0x00 0x1000>;
		mediatek,larbs = <0x31 0x32 0x33>;
		interrupts = <0x00 0x9e 0x08>;
		#iommu-cells = <0x01>;
		phandle = <0x63>;
	};

	devapc@10207000 {
		compatible = "mediatek,devapc";
		reg = <0x00 0x10207000 0x00 0x1000>;
		interrupts = <0x00 0x56 0x08>;
		clocks = <0x22 0x28>;
		clock-names = "devapc-infra-clock";
	};

	hwrng {
		compatible = "mediatek,mt67xx-rng";
		phandle = <0x9d>;
	};

	bus_dbg@10208000 {
		compatible = "mediatek,bus_dbg-v2";
		reg = <0x00 0x10208000 0x00 0x1000 0x00 0x10001000 0x00 0x1000>;
		mediatek,bus_dbg_con_offset = <0x2fc>;
		interrupts = <0x00 0x55 0x08>;
	};

	ap_ccif0@10209000 {
		compatible = "mediatek,ap_ccif0";
		reg = <0x00 0x10209000 0x00 0x1000>;
		interrupts = <0x00 0x5c 0x08>;
	};

	md_ccif0@1020a000 {
		compatible = "mediatek,md_ccif0";
		reg = <0x00 0x1020a000 0x00 0x1000>;
	};

	ap_ccif1@1020b000 {
		compatible = "mediatek,ap_ccif1";
		reg = <0x00 0x1020b000 0x00 0x1000>;
		interrupts = <0x00 0x5e 0x08>;
	};

	md_ccif1@1020c000 {
		compatible = "mediatek,md_ccif1";
		reg = <0x00 0x1020c000 0x00 0x1000>;
	};

	infra_mbist@1020d000 {
		compatible = "mediatek,infra_mbist";
		reg = <0x00 0x1020d000 0x00 0x1000>;
	};

	infracfg@1020e000 {
		compatible = "mediatek,infracfg";
		reg = <0x00 0x1020e000 0x00 0x1000>;
	};

	trng@1020f000 {
		compatible = "mediatek,trng";
		reg = <0x00 0x1020f000 0x00 0x1000>;
		interrupts = <0x00 0x69 0x08>;
	};

	dxcc_sec@10210000 {
		compatible = "mediatek,dxcc_sec";
		reg = <0x00 0x10210000 0x00 0x1000>;
		interrupts = <0x00 0x6a 0x04>;
	};

	mcupm_sram2@10211000 {
		compatible = "mediatek,mcupm_sram2";
		reg = <0x00 0x10211000 0x00 0x1000>;
	};

	cq_dma@10212000 {
		compatible = "mediatek,mt-cqdma-v1";
		reg = <0x00 0x10212000 0x00 0x80 0x00 0x10212080 0x00 0x80 0x00 0x10212100 0x00 0x68>;
		interrupts = <0x00 0x39 0x08 0x00 0x3a 0x08 0x00 0x3b 0x08>;
		nr_channel = <0x03>;
		keep_clock_ao = "yes";
		clocks = <0x22 0x43>;
		clock-names = "cqdma";
	};

	mcupm_sram3@10213000 {
		compatible = "mediatek,mcupm_sram3";
		reg = <0x00 0x10213000 0x00 0x1000>;
	};

	sramrom@10214000 {
		compatible = "mediatek,sramrom";
		reg = <0x00 0x10214000 0x00 0x1000>;
	};

	mcupm_reg@10216000 {
		compatible = "mediatek,mcupm_reg";
		reg = <0x00 0x10216000 0x00 0x1000>;
	};

	mcupm_sram0@10217000 {
		compatible = "mediatek,mcupm_sram0";
		reg = <0x00 0x10217000 0x00 0x1000>;
	};

	mcupm_sram1@10218000 {
		compatible = "mediatek,mcupm_sram1";
		reg = <0x00 0x10218000 0x00 0x1000>;
	};

	emi@10219000 {
		compatible = "mediatek,emi";
		reg = <0x00 0x10219000 0x00 0x1000 0x00 0x10226000 0x00 0x1000 0x00 0x1022d000 0x00 0x1000 0x00 0x10235000 0x00 0x1000>;
		interrupts = <0x00 0x58 0x08>;
	};

	apcldmain@1021b000 {
		compatible = "mediatek,apcldmain";
		reg = <0x00 0x1021b000 0x00 0x100>;
	};

	apcldmaout@1021b400 {
		compatible = "mediatek,apcldmaout";
		reg = <0x00 0x1021b400 0x00 0x100>;
	};

	apcldmamisc@1021b800 {
		compatible = "mediatek,apcldmamisc";
		reg = <0x00 0x1021b800 0x00 0x100>;
		interrupts = <0x00 0x6d 0x04>;
	};

	mdcldmain@1021c000 {
		compatible = "mediatek,mdcldmain";
		reg = <0x00 0x1021c000 0x00 0x400>;
	};

	mdcldmaout@1021c400 {
		compatible = "mediatek,mdcldmaout";
		reg = <0x00 0x1021c400 0x00 0x400>;
	};

	mdcldmamisc@1021c800 {
		compatible = "mediatek,mdcldmamisc";
		reg = <0x00 0x1021c800 0x00 0x1000>;
	};

	ccifdriver@10209000 {
		compatible = "mediatek,ccci_ccif";
		reg = <0x00 0x10209000 0x00 0x1000 0x00 0x1020a000 0x00 0x1000>;
		mediatek,sram_size = <0x200>;
		interrupts = <0x00 0x5c 0x08 0x00 0x5d 0x08>;
		clocks = <0x22 0x29 0x22 0x2c 0x22 0x23 0x22 0x24 0x22 0x58 0x22 0x59>;
		clock-names = "infra-ccif-ap\0infra-ccif-md\0infra-ccif1-ap\0infra-ccif1-md\0infra-ccif2-ap\0infra-ccif2-md";
		phandle = <0x9e>;
	};

	cldmadriver@10014000 {
		compatible = "mediatek,ccci_cldma";
		reg = <0x00 0x10014000 0x00 0x1000 0x00 0x1021b000 0x00 0x1000>;
		interrupts = <0x00 0x6d 0x04>;
		mediatek,cldma_capability = <0x06>;
		mediatek,md_generation = <0x1895>;
		mediatek,platform = <0x1a69>;
		clocks = <0x22 0x32>;
		clock-names = "infra-cldma-bclk";
		cldma-infracfg = <0x22>;
		phandle = <0x9f>;
	};

	mddriver@10014000 {
		compatible = "mediatek,mddriver\0mediatek,mddriver-mt6761";
		reg = <0x00 0x10014000 0x00 0x1000 0x00 0x1021b000 0x00 0x1000 0x00 0x10209000 0x00 0x1000 0x00 0x1020a000 0x00 0x1000>;
		interrupts = <0x00 0x6d 0x04 0x00 0x5c 0x08 0x00 0x5d 0x08 0x00 0xcd 0x02>;
		mediatek,mdhif_type = <0x03>;
		mediatek,md_id = <0x00>;
		mediatek,ap_plat_info = <0x1a69>;
		mediatek,md_generation = <0x1895>;
		mediatek,offset_apon_md1 = <0x1c24>;
		mediatek,cldma_capability = <0x06>;
		clocks = <0x34 0x00 0x22 0x32 0x22 0x29 0x22 0x2c 0x22 0x23 0x22 0x24 0x22 0x58 0x22 0x59>;
		clock-names = "scp-sys-md1-main\0infra-cldma-bclk\0infra-ccif-ap\0infra-ccif-md\0infra-ccif1-ap\0infra-ccif1-md\0infra-ccif2-ap\0infra-ccif2-md";
		_vmodem-supply = <0x35>;
		_vcore-supply = <0x36>;
		ccci-infracfg = <0x22>;
		phandle = <0x15>;
	};

	md_auxadc {
		compatible = "mediatek,md_auxadc";
		io-channels = <0x27 0x02>;
		io-channel-names = "md-channel\0md-battery";
		phandle = <0xa0>;
	};

	bpi_bsi_slv0@1021e000 {
		compatible = "mediatek,bpi_bsi_slv0";
		reg = <0x00 0x1021e000 0x00 0x1000>;
	};

	bpi_bsi_slv1@1021f000 {
		compatible = "mediatek,bpi_bsi_slv1";
		reg = <0x00 0x1021f000 0x00 0x6000>;
	};

	bpi_bsi_slv2@10225000 {
		compatible = "mediatek,bpi_bsi_slv2";
		reg = <0x00 0x10225000 0x00 0x1000>;
	};

	dvfsp@10227000 {
		compatible = "mediatek,dvfsp";
		reg = <0x00 0x10227000 0x00 0x1000>;
	};

	dvfsp@00110800 {
		compatible = "mediatek,mt6761-dvfsp";
		reg = <0x00 0x110800 0x00 0x1400 0x00 0x110800 0x00 0x1400>;
		nvmem-cells = <0x37>;
		nvmem-cell-names = "efuse_segment_cell";
	};

	dramc@1022a000 {
		compatible = "mediatek,dramc";
		reg = <0x00 0x1022a000 0x00 0x2000 0x00 0x10232000 0x00 0x2000 0x00 0x1022c000 0x00 0x1000 0x00 0x10234000 0x00 0x1000 0x00 0x10228000 0x00 0x2000 0x00 0x10230000 0x00 0x2000 0x00 0x1022e000 0x00 0x1000 0x00 0x10236000 0x00 0x1000>;
	};

	gce@10238000 {
		compatible = "mediatek,gce\0syscon";
		reg = <0x00 0x10238000 0x00 0x4000>;
		interrupts = <0x00 0x62 0x08>;
		g3d_config_base = <0x13000000 0x00 0xffff0000>;
		mmsys_config_base = <0x14000000 0x01 0xffff0000>;
		disp_dither_base = <0x14010000 0x02 0xffff0000>;
		mm_na_base = <0x14020000 0x03 0xffff0000>;
		imgsys_base = <0x15020000 0x04 0xffff0000>;
		vdec_gcon_base = <0x18800000 0x05 0xffff0000>;
		venc_gcon_base = <0x18810000 0x06 0xffff0000>;
		conn_peri_base = <0x18820000 0x07 0xffff0000>;
		topckgen_base = <0x18830000 0x08 0xffff0000>;
		kp_base = <0x18840000 0x09 0xffff0000>;
		scp_sram_base = <0x10000000 0x0a 0xffff0000>;
		infra_na3_base = <0x10010000 0x0b 0xffff0000>;
		infra_na4_base = <0x10020000 0x0c 0xffff0000>;
		scp_base = <0x10030000 0x0d 0xffff0000>;
		mcucfg_base = <0x10040000 0x0e 0xffff0000>;
		gcpu_base = <0x10050000 0x0f 0xffff0000>;
		usb0_base = <0x10200000 0x10 0xffff0000>;
		usb_sif_base = <0x10280000 0x11 0xffff0000>;
		audio_base = <0x17000000 0x12 0xffff0000>;
		vdec_base = <0x17010000 0x13 0xffff0000>;
		msdc2_base = <0x17020000 0x14 0xffff0000>;
		vdec1_base = <0x17030000 0x15 0xffff0000>;
		msdc3_base = <0x18000000 0x16 0xffff0000>;
		ap_dma_base = <0x18010000 0x17 0xffff0000>;
		gce_base = <0x18020000 0x18 0xffff0000>;
		vdec2_base = <0x18040000 0x19 0xffff0000>;
		vdec3_base = <0x18050000 0x1a 0xffff0000>;
		camsys_base = <0x18080000 0x1b 0xffff0000>;
		camsys1_base = <0x180a0000 0x1c 0xffff0000>;
		camsys2_base = <0x180b0000 0x1d 0xffff0000>;
		pwm_sw_base = <0x1100e000 0x63 0xffff0000>;
		mipitx0_base = <0x11c80000 0x63 0xffff0000>;
		mdp_rdma0_sof = <0x00>;
		mdp_ccorr0_sof = <0x01>;
		mdp_rsz0_sof = <0x02>;
		mdp_rsz1_sof = <0x03>;
		mdp_wdma_sof = <0x04>;
		mdp_wrot0_sof = <0x05>;
		mdp_tdshp0_sof = <0x06>;
		disp_ovl0_sof = <0x07>;
		disp_2l_ovl0_sof = <0x08>;
		disp_rdma0_sof = <0x09>;
		disp_wdma0_sof = <0x0a>;
		disp_color0_sof = <0x0b>;
		disp_ccorr0_sof = <0x0c>;
		disp_aal0_sof = <0x0d>;
		disp_gamma0_sof = <0x0e>;
		disp_dither0_sof = <0x0f>;
		disp_dsi0_sof = <0x10>;
		disp_rsz0_sof = <0x11>;
		img_dl_relay_sof = <0x12>;
		disp_pwm0_sof = <0x13>;
		mdp_rdma0_frame_done = <0x14>;
		mdp_ccorr0_frame_done = <0x15>;
		mdp_rsz0_frame_done = <0x16>;
		mdp_rsz1_frame_done = <0x17>;
		mdp_wrot0_write_frame_done = <0x18>;
		mdp_wdma_frame_done = <0x19>;
		mdp_tdshp0_frame_done = <0x1a>;
		disp_ovl0_frame_done = <0x1b>;
		disp_2l_ovl0_frame_done = <0x1c>;
		disp_rsz0_frame_done = <0x1d>;
		disp_rdma0_frame_done = <0x1e>;
		disp_wdma0_frame_done = <0x1f>;
		disp_color0_frame_done = <0x20>;
		disp_ccorr0_frame_done = <0x21>;
		disp_aal0_frame_done = <0x22>;
		disp_gamma0_frame_done = <0x23>;
		disp_dither0_frame_done = <0x24>;
		disp_dsi0_frame_done = <0x25>;
		stream_done_0 = <0x82>;
		stream_done_1 = <0x83>;
		stream_done_2 = <0x84>;
		stream_done_3 = <0x85>;
		stream_done_4 = <0x86>;
		stream_done_5 = <0x87>;
		stream_done_6 = <0x88>;
		stream_done_7 = <0x89>;
		stream_done_8 = <0x8a>;
		stream_done_9 = <0x8b>;
		buf_underrun_event_0 = <0x8c>;
		dsi0_te_event = <0x8d>;
		dsi0_irq_event = <0x8e>;
		dsi0_done_event = <0x8f>;
		disp_wdma0_rst_done = <0x93>;
		mdp_wdma_rst_done = <0x94>;
		mdp_wrot0_rst_done = <0x95>;
		mdp_rdma0_rst_done = <0x97>;
		disp_ovl0_frame_rst_done_pusle = <0x98>;
		dip_cq_thread2_frame_done = <0x101>;
		dip_cq_thread1_frame_done = <0x102>;
		dip_cq_thread0_frame_done = <0x103>;
		isp_frame_done_p1_1 = <0x104>;
		isp_frame_done_p1_0 = <0x105>;
		camsv_0_pass1_done = <0x106>;
		camsv_1_pass1_done = <0x107>;
		seninf_0_fifo_full = <0x108>;
		seninf_1_fifo_full = <0x109>;
		seninf_2_fifo_full = <0x10a>;
		seninf_3_fifo_full = <0x10b>;
		seninf_4_fifo_full = <0x10c>;
		seninf_5_fifo_full = <0x10d>;
		seninf_6_fifo_full = <0x10e>;
		seninf_7_fifo_full = <0x10f>;
		venc_done = <0x121>;
		jpgenc_done = <0x122>;
		jpgdec_done = <0x123>;
		venc_mb_done = <0x124>;
		venc_128byte_cnt_done = <0x125>;
		max_prefetch_cnt = <0x01>;
		prefetch_size = <0x60>;
		sram_size_cpr_64 = <0x40>;
		mmsys_config = <0x38>;
		mdp_rdma0 = <0x39>;
		mdp_rsz0 = <0x3a>;
		mdp_rsz1 = <0x3b>;
		mdp_wdma0 = <0x3c>;
		mdp_wrot0 = <0x3d>;
		mdp_tdshp0 = <0x3e>;
		mdp_color0 = <0x3f>;
		mdp_ccorr0 = <0x40>;
		mm_mutex = <0x41>;
		sram_share_cnt = <0x01>;
		sram_share_engine = <0x0a>;
		sram_share_event = <0x2c6>;
		clocks = <0x22 0x09 0x22 0x18>;
		clock-names = "GCE\0GCE_TIMER";
		mediatek,mailbox-gce = <0x42>;
		thread_count = <0x10>;
		secure_thread = <0x08 0x0a>;
		mboxes = <0x42 0x00 0x00 0x04 0x42 0x01 0x00 0x04 0x42 0x02 0x00 0x05 0x42 0x03 0x00 0x04 0x42 0x04 0x00 0x04 0x42 0x05 0x00 0x04 0x42 0x06 0xc8 0x03 0x42 0x07 0xffffffff 0x02 0x42 0x08 0x00 0x01 0x42 0x09 0x00 0x01 0x42 0x0a 0x00 0x01 0x42 0x0b 0x00 0x01 0x42 0x0c 0x00 0x01 0x42 0x0d 0x00 0x01 0x42 0x0e 0x00 0x01 0x42 0x0f 0x00 0x01>;
		phandle = <0xa1>;
	};

	gce_mbox@10238000 {
		compatible = "mediatek,mt6761-gce";
		reg = <0x00 0x10238000 0x00 0x4000>;
		interrupts = <0x00 0x62 0x08>;
		#mbox-cells = <0x03>;
		#gce-event-cells = <0x01>;
		#gce-subsys-cells = <0x02>;
		default_tokens = [02 bc 02 bd 02 be 02 bf 02 c0 02 c6 02 c7];
		clocks = <0x22 0x09 0x22 0x18>;
		clock-names = "gce\0gce-timer";
		phandle = <0x42>;
	};

	ap_ccif2@1023c000 {
		compatible = "mediatek,ap_ccif2";
		reg = <0x00 0x1023c000 0x00 0x1000>;
		interrupts = <0x00 0x57 0x08>;
	};

	md_ccif2@1023d000 {
		compatible = "mediatek,md_ccif2";
		reg = <0x00 0x1023d000 0x00 0x1000>;
	};

	ap_ccif3@1023e000 {
		compatible = "mediatek,ap_ccif3";
		reg = <0x00 0x1023e000 0x00 0x1000>;
		interrupts = <0x00 0x5a 0x08>;
	};

	md_ccif3@1023f000 {
		compatible = "mediatek,md_ccif3";
		reg = <0x00 0x1023f000 0x00 0x1000>;
	};

	sspm@10440000 {
		compatible = "mediatek,mt6761-sspm";
		reg = <0x00 0x10440000 0x00 0x10000 0x00 0x10450000 0x00 0x100 0x00 0x10451000 0x00 0x08 0x00 0x10460000 0x00 0x100 0x00 0x10461000 0x00 0x08 0x00 0x10470000 0x00 0x100 0x00 0x10471000 0x00 0x08 0x00 0x10480000 0x00 0x100 0x00 0x10481000 0x00 0x08 0x00 0x10490000 0x00 0x100 0x00 0x10491000 0x00 0x08>;
		reg-names = "cfgreg\0mbox0_base\0mbox0_ctrl\0mbox1_base\0mbox1_ctrl\0mbox2_base\0mbox2_ctrl\0mbox3_base\0mbox3_ctrl\0mbox4_base\0mbox4_ctrl";
		interrupts = <0x00 0x92 0x04 0x00 0x95 0x04 0x00 0x96 0x04 0x00 0x97 0x04 0x00 0x98 0x04 0x00 0x99 0x04>;
		interrupt-names = "ipc\0mbox0\0mbox1\0mbox2\0mbox3\0mbox4";
	};

	gic500@0c000000 {
		compatible = "mediatek,gic500";
		reg = <0x00 0xc000000 0x00 0x400000>;
	};

	gic_cpu@0c400000 {
		compatible = "mediatek,gic_cpu";
		reg = <0x00 0xc400000 0x00 0x40000>;
	};

	dfd@10200b00 {
		compatible = "mediatek,dfd";
		reg = <0x00 0x10200b00 0x00 0x10000>;
		mediatek,enabled = <0x01>;
		mediatek,chain_length = <0x61a8>;
		mediatek,rg_dfd_timeout = <0xa0>;
		mediatek,check_dfd_support = <0x01>;
		mediatek,dfd_infra_base = <0x390>;
		mediatek,dfd_ap_addr_offset = <0x18>;
		mediatek,dfd_latch_offset = <0x48>;
		reg_base = <0x43>;
	};

	dbg_cti@0d020000 {
		compatible = "mediatek,dbg_cti";
		reg = <0x00 0xd020000 0x00 0x10000>;
	};

	dbg_etr@0d030000 {
		compatible = "mediatek,dbg_etr";
		reg = <0x00 0xd030000 0x00 0x10000>;
	};

	dbg_funnel@0d040000 {
		compatible = "mediatek,dbg_funnel";
		reg = <0x00 0xd040000 0x00 0x10000>;
	};

	dbg_dem@0d0a0000 {
		compatible = "mediatek,dbg_dem";
		reg = <0x00 0xd0a0000 0x00 0x10000>;
		interrupts = <0x00 0x54 0x08>;
	};

	dbg_mdsys1@0d0c0000 {
		compatible = "mediatek,dbg_mdsys1";
		reg = <0x00 0xd0c0000 0x00 0x40000>;
	};

	dbg_apmcu_mp0@0d400000 {
		compatible = "mediatek,dbg_apmcu_mp0";
		reg = <0x00 0xd400000 0x00 0x1000>;
	};

	dbg_apmcu_mp0@0d410000 {
		compatible = "mediatek,dbg_apmcu_mp0";
		reg = <0x00 0xd410000 0x00 0x1000>;
	};

	dbg_apmcu_mp0@0d420000 {
		compatible = "mediatek,dbg_apmcu_mp0";
		reg = <0x00 0xd420000 0x00 0x1000>;
	};

	dbg_apmcu_mp0@0d430000 {
		compatible = "mediatek,dbg_apmcu_mp0";
		reg = <0x00 0xd430000 0x00 0x1000>;
	};

	dbg_apmcu_mp0@0d440000 {
		compatible = "mediatek,dbg_apmcu_mp0";
		reg = <0x00 0xd440000 0x00 0x1000>;
	};

	dbg_apmcu_mp0@0d510000 {
		compatible = "mediatek,dbg_apmcu_mp0";
		reg = <0x00 0xd510000 0x00 0x1000>;
	};

	dbg_apmcu_mp0@0d520000 {
		compatible = "mediatek,dbg_apmcu_mp0";
		reg = <0x00 0xd520000 0x00 0x1000>;
	};

	dbg_apmcu_mp0@0d530000 {
		compatible = "mediatek,dbg_apmcu_mp0";
		reg = <0x00 0xd530000 0x00 0x1000>;
	};

	dbg_apmcu_mp0@0d540000 {
		compatible = "mediatek,dbg_apmcu_mp0";
		reg = <0x00 0xd540000 0x00 0x1000>;
	};

	dbg_apmcu_mp0@0d610000 {
		compatible = "mediatek,dbg_apmcu_mp0";
		reg = <0x00 0xd610000 0x00 0x1000>;
	};

	dbg_apmcu_mp0@0d620000 {
		compatible = "mediatek,dbg_apmcu_mp0";
		reg = <0x00 0xd620000 0x00 0x1000>;
	};

	dbg_apmcu_mp0@0d630000 {
		compatible = "mediatek,dbg_apmcu_mp0";
		reg = <0x00 0xd630000 0x00 0x1000>;
	};

	dbg_apmcu_mp0@0d640000 {
		compatible = "mediatek,dbg_apmcu_mp0";
		reg = <0x00 0xd640000 0x00 0x1000>;
	};

	dbg_apmcu_mp0@0d710000 {
		compatible = "mediatek,dbg_apmcu_mp0";
		reg = <0x00 0xd710000 0x00 0x1000>;
	};

	dbg_apmcu_mp0@0d720000 {
		compatible = "mediatek,dbg_apmcu_mp0";
		reg = <0x00 0xd720000 0x00 0x1000>;
	};

	dbg_apmcu_mp0@0d730000 {
		compatible = "mediatek,dbg_apmcu_mp0";
		reg = <0x00 0xd730000 0x00 0x1000>;
	};

	dbg_apmcu_mp0@0d740000 {
		compatible = "mediatek,dbg_apmcu_mp0";
		reg = <0x00 0xd740000 0x00 0x1000>;
	};

	dbg_apmcu_mp1@0d800000 {
		compatible = "mediatek,dbg_apmcu_mp1";
		reg = <0x00 0xd800000 0x00 0x1000>;
	};

	dbg_apmcu_mp1@0d810000 {
		compatible = "mediatek,dbg_apmcu_mp1";
		reg = <0x00 0xd810000 0x00 0x1000>;
	};

	dbg_apmcu_mp1@0d820000 {
		compatible = "mediatek,dbg_apmcu_mp1";
		reg = <0x00 0xd820000 0x00 0x1000>;
	};

	dbg_apmcu_mp1@0d830000 {
		compatible = "mediatek,dbg_apmcu_mp1";
		reg = <0x00 0xd830000 0x00 0x1000>;
	};

	dbg_apmcu_mp1@0d840000 {
		compatible = "mediatek,dbg_apmcu_mp1";
		reg = <0x00 0xd840000 0x00 0x1000>;
	};

	dbg_apmcu_mp1@0d910000 {
		compatible = "mediatek,dbg_apmcu_mp1";
		reg = <0x00 0xd910000 0x00 0x1000>;
	};

	dbg_apmcu_mp1@0d920000 {
		compatible = "mediatek,dbg_apmcu_mp1";
		reg = <0x00 0xd920000 0x00 0x1000>;
	};

	dbg_apmcu_mp1@0d930000 {
		compatible = "mediatek,dbg_apmcu_mp1";
		reg = <0x00 0xd930000 0x00 0x1000>;
	};

	dbg_apmcu_mp1@0d940000 {
		compatible = "mediatek,dbg_apmcu_mp1";
		reg = <0x00 0xd940000 0x00 0x1000>;
	};

	dbg_apmcu_mp1@0da10000 {
		compatible = "mediatek,dbg_apmcu_mp1";
		reg = <0x00 0xda10000 0x00 0x1000>;
	};

	dbg_apmcu_mp1@0da20000 {
		compatible = "mediatek,dbg_apmcu_mp1";
		reg = <0x00 0xda20000 0x00 0x1000>;
	};

	dbg_apmcu_mp1@0da30000 {
		compatible = "mediatek,dbg_apmcu_mp1";
		reg = <0x00 0xda30000 0x00 0x1000>;
	};

	dbg_apmcu_mp1@0da40000 {
		compatible = "mediatek,dbg_apmcu_mp1";
		reg = <0x00 0xda40000 0x00 0x1000>;
	};

	dbg_apmcu_mp1@0db10000 {
		compatible = "mediatek,dbg_apmcu_mp1";
		reg = <0x00 0xdb10000 0x00 0x1000>;
	};

	dbg_apmcu_mp1@0db20000 {
		compatible = "mediatek,dbg_apmcu_mp1";
		reg = <0x00 0xdb20000 0x00 0x1000>;
	};

	dbg_apmcu_mp1@0db30000 {
		compatible = "mediatek,dbg_apmcu_mp1";
		reg = <0x00 0xdb30000 0x00 0x1000>;
	};

	dbg_apmcu_mp1@0db40000 {
		compatible = "mediatek,dbg_apmcu_mp1";
		reg = <0x00 0xdb40000 0x00 0x1000>;
	};

	ap_dma@11000000 {
		compatible = "mediatek,ap_dma";
		reg = <0x00 0x11000000 0x00 0x1000>;
		interrupts = <0x00 0x29 0x08>;
	};

	auxadc@11001000 {
		compatible = "mediatek,mt6765-auxadc";
		reg = <0x00 0x11001000 0x00 0x1000>;
		interrupts = <0x00 0x14 0x02>;
		clocks = <0x22 0x21>;
		clock-names = "main";
		#io-channel-cells = <0x01>;
		mediatek,cali-en-bit = <0x14>;
		mediatek,cali-ge-bit = <0x0a>;
		mediatek,cali-oe-bit = <0x00>;
		mediatek,cali-efuse-index = <0x6a>;
		#interconnect-cells = <0x01>;
		phandle = <0x27>;
	};

	dma-controller@11000580 {
		compatible = "mediatek,mt6577-uart-dma";
		reg = <0x00 0x11000680 0x00 0x80 0x00 0x11000700 0x00 0x80 0x00 0x11000780 0x00 0x80 0x00 0x11000800 0x00 0x80>;
		interrupts = <0x00 0x35 0x08 0x00 0x36 0x08 0x00 0x37 0x08 0x00 0x3c 0x08>;
		clocks = <0x22 0x26>;
		clock-names = "apdma";
		dma-requests = <0x04>;
		#dma-bits = <0x22>;
		#dma-cells = <0x01>;
		phandle = <0x44>;
	};

	serial@11020000 {
		compatible = "mediatek,mt6761-uart\0mediatek,mt6577-uart";
		reg = <0x00 0x11002000 0x00 0x1000>;
		interrupts = <0x00 0x23 0x08>;
		clocks = <0x21 0x22 0x16>;
		clock-names = "baud\0bus";
		dmas = <0x44 0x00 0x44 0x01>;
		dma-names = "tx\0rx";
		phandle = <0xa2>;
	};

	serial@11030000 {
		compatible = "mediatek,mt6761-uart\0mediatek,mt6577-uart";
		reg = <0x00 0x11003000 0x00 0x1000>;
		interrupts = <0x00 0x24 0x08>;
		clocks = <0x21 0x22 0x17>;
		clock-names = "baud\0bus";
		dmas = <0x44 0x02 0x44 0x03>;
		dma-names = "tx\0rx";
		phandle = <0xa3>;
	};

	pwm@11006000 {
		compatible = "mediatek,pwm";
		reg = <0x00 0x11006000 0x00 0x1000>;
		interrupts = <0x00 0x15 0x08>;
		clocks = <0x22 0x10 0x22 0x11 0x22 0x12 0x22 0x13 0x22 0x14 0x22 0x30 0x22 0x0f 0x22 0x15>;
		clock-names = "PWM1-main\0PWM2-main\0PWM3-main\0PWM4-main\0PWM5-main\0PWM6-main\0PWM-HCLK-main\0PWM-main";
		phandle = <0xa4>;
	};

	i2c_common {
		compatible = "mediatek,i2c_common";
		dma_support = [02];
		idvfs = [01];
		set_dt_div = [01];
		check_max_freq = [01];
		ver = [02];
		set_ltiming = [01];
		ext_time_config = [18 01];
		cnt_constraint = [01];
		phandle = <0xa5>;
	};

	i2c0@11007000 {
		compatible = "mediatek,i2c";
		id = <0x00>;
		reg = <0x00 0x11007000 0x00 0x1000 0x00 0x11000080 0x00 0x80>;
		interrupts = <0x00 0x1c 0x08>;
		clocks = <0x22 0x0b 0x22 0x26>;
		clock-names = "main\0dma";
		clock-div = <0x05>;
		scl-gpio-id = <0x53>;
		sda-gpio-id = <0x52>;
		gpio_start = <0x10002a00>;
		mem_len = <0x200>;
		eh_cfg = <0x20>;
		pu_cfg = <0x50>;
		rsel_cfg = <0x70>;
		aed = <0x1a>;
		mediatek,hs_only;
		phandle = <0xa6>;
	};

	i2c1@11008000 {
		compatible = "mediatek,i2c";
		id = <0x01>;
		reg = <0x00 0x11008000 0x00 0x1000 0x00 0x11000100 0x00 0x80>;
		interrupts = <0x00 0x1d 0x08>;
		clocks = <0x22 0x0b 0x22 0x26>;
		clock-names = "main\0dma";
		clock-div = <0x05>;
		scl-gpio-id = <0x54>;
		sda-gpio-id = <0x51>;
		gpio_start = <0x10002a00>;
		mem_len = <0x200>;
		eh_cfg = <0x20>;
		pu_cfg = <0x50>;
		rsel_cfg = <0x70>;
		aed = <0x1a>;
		mediatek,hs_only;
		phandle = <0xa7>;
	};

	i2c2@11009000 {
		compatible = "mediatek,i2c";
		id = <0x02>;
		reg = <0x00 0x11009000 0x00 0x1000 0x00 0x11000180 0x00 0x180>;
		interrupts = <0x00 0x1e 0x08>;
		clocks = <0x22 0x0b 0x22 0x26>;
		clock-names = "main\0dma";
		clock-div = <0x05>;
		scl-gpio-id = <0x67>;
		sda-gpio-id = <0x68>;
		gpio_start = <0x10002800>;
		mem_len = <0x200>;
		eh_cfg = <0x20>;
		pu_cfg = <0x60>;
		rsel_cfg = <0xa0>;
		aed = <0x1a>;
		ch_offset_default = <0x100>;
		ch_offset_ccu = <0x200>;
		mediatek,hs_only;
		phandle = <0xa8>;
	};

	i2c3@1100f000 {
		compatible = "mediatek,i2c";
		id = <0x03>;
		reg = <0x00 0x1100f000 0x00 0x1000 0x00 0x11000300 0x00 0x100>;
		interrupts = <0x00 0x1f 0x08>;
		clocks = <0x22 0x0b 0x22 0x26>;
		clock-names = "main\0dma";
		clock-div = <0x05>;
		scl-gpio-id = <0x32>;
		sda-gpio-id = <0x33>;
		gpio_start = <0x10002600>;
		mem_len = <0x200>;
		eh_cfg = <0x20>;
		pu_cfg = <0x90>;
		rsel_cfg = <0xb0>;
		aed = <0x1a>;
		ch_offset_default = <0x100>;
		mediatek,hs_only;
		phandle = <0xa9>;
	};

	i2c4@11011000 {
		compatible = "mediatek,i2c";
		id = <0x04>;
		reg = <0x00 0x11011000 0x00 0x1000 0x00 0x11000400 0x00 0x180>;
		interrupts = <0x00 0x20 0x08>;
		clocks = <0x22 0x0b 0x22 0x26>;
		clock-names = "main\0dma";
		clock-div = <0x05>;
		scl-gpio-id = <0x69>;
		sda-gpio-id = <0x6a>;
		gpio_start = <0x10002800>;
		mem_len = <0x200>;
		eh_cfg = <0x20>;
		pu_cfg = <0x60>;
		rsel_cfg = <0xa0>;
		aed = <0x1a>;
		ch_offset_default = <0x100>;
		ch_offset_ccu = <0x200>;
		mediatek,hs_only;
		phandle = <0xaa>;
	};

	i2c5@11016000 {
		compatible = "mediatek,i2c";
		id = <0x05>;
		reg = <0x00 0x11016000 0x00 0x1000 0x00 0x11000580 0x00 0x80>;
		interrupts = <0x00 0x4a 0x08>;
		clocks = <0x22 0x0b 0x22 0x26>;
		clock-names = "main\0dma";
		clock-div = <0x05>;
		scl-gpio-id = <0x30>;
		sda-gpio-id = <0x31>;
		gpio_start = <0x10002600>;
		mem_len = <0x200>;
		eh_cfg = <0x20>;
		pu_cfg = <0x90>;
		rsel_cfg = <0xb0>;
		aed = <0x1a>;
		mediatek,hs_only;
		phandle = <0xab>;
	};

	i2c6@1100d000 {
		compatible = "mediatek,i2c";
		id = <0x06>;
		reg = <0x00 0x1100d000 0x00 0x1000 0x00 0x11000600 0x00 0x80>;
		interrupts = <0x00 0x4b 0x08>;
		clocks = <0x22 0x0b 0x22 0x26>;
		clock-names = "main\0dma";
		clock-div = <0x05>;
		scl-gpio-id = <0xa1>;
		sda-gpio-id = <0xa2>;
		gpio_start = <0x10002c00>;
		mem_len = <0x200>;
		eh_cfg = <0x20>;
		pu_cfg = <0x50>;
		rsel_cfg = <0x70>;
		aed = <0x1a>;
		ch_offset_default = <0x100>;
		ch_offset_ccu = <0x200>;
		mediatek,hs_only;
		phandle = <0xac>;
	};

	i2c7 {
		phandle = <0xad>;
	};

	i2c8 {
		phandle = <0xae>;
	};

	i2c9 {
		phandle = <0xaf>;
	};

	spi0@1100a000 {
		compatible = "mediatek,mt6765-spi";
		mediatek,pad-select = <0x00>;
		reg = <0x00 0x1100a000 0x00 0x1000>;
		interrupts = <0x00 0x3e 0x08>;
		clocks = <0x0f 0x0d 0x0f 0x74 0x22 0x1b>;
		clock-names = "parent-clk\0sel-clk\0spi-clk";
		phandle = <0xb0>;
	};

	therm_ctrl@1100b000 {
		compatible = "mediatek,therm_ctrl";
		reg = <0x00 0x1100b000 0x00 0x1000>;
		interrupts = <0x00 0x16 0x08>;
		clocks = <0x22 0x0a>;
		clock-names = "therm-main";
		nvmem = <0x45>;
		nvmem-names = "mtk_efuse";
		nvmem-cells = <0x46 0x47>;
		nvmem-cell-names = "cpu_freq_segment_cell\0thermal_efuse_cell";
	};

	thermal-sensor1 {
		compatible = "mediatek,mtboard-thermistor1";
		io-channels = <0x27 0x00>;
		io-channel-names = "thermistor-ch0";
		interconnects = <0x27 0x00>;
		phandle = <0xb1>;
	};

	thermal-sensor2 {
		compatible = "mediatek,mtboard-thermistor2";
		io-channels = <0x27 0x01>;
		io-channel-names = "thermistor-ch1";
		interconnects = <0x27 0x01>;
		phandle = <0xb2>;
	};

	thermal-sensor3 {
		compatible = "mediatek,mtboard-thermistor3";
		io-channels = <0x27 0x02>;
		io-channel-names = "thermistor-ch2";
		interconnects = <0x27 0x02>;
		phandle = <0xb3>;
	};

	eem_fsm@1100b000 {
		compatible = "mediatek,eem_fsm";
		reg = <0x00 0x1100b000 0x00 0x1000>;
		interrupts = <0x00 0x45 0x08>;
		nvmem = <0x45>;
		nvmem-names = "mtk_efuse";
		nvmem-cells = <0x37>;
		nvmem-cell-names = "efuse_segment_cell";
	};

	btif@1100c000 {
		compatible = "mediatek,btif";
		reg = <0x00 0x1100c000 0x00 0x1000 0x00 0x11000880 0x00 0x80 0x00 0x11000900 0x00 0x80>;
		interrupts = <0x00 0x38 0x08 0x00 0x4c 0x08 0x00 0x4d 0x08>;
		clocks = <0x22 0x1a 0x22 0x26>;
		clock-names = "btifc\0apdmac";
	};

	consys@18002000 {
		compatible = "mediatek,mt6761-consys";
		#address-cells = <0x02>;
		#size-cells = <0x02>;
		reg = <0x00 0x18002000 0x00 0x1000 0x00 0x10007000 0x00 0x100 0x00 0x10001000 0x00 0x1000 0x00 0x10006000 0x00 0x1000 0x00 0x18007000 0x00 0x1000 0x00 0x180b1000 0x00 0x1000 0x00 0x180a3000 0x00 0x1000 0x00 0x180a5000 0x00 0x800 0x00 0x180c1000 0x00 0x1000 0x00 0x18004000 0x00 0x1000>;
		interrupts = <0x00 0xd3 0x08 0x00 0xd5 0x08 0x00 0xd6 0x01>;
		clocks = <0x34 0x01>;
		clock-names = "conn";
		pmic = <0x2c>;
		memory-region = <0x48>;
		phandle = <0x14>;
	};

	wifi@18000000 {
		compatible = "mediatek,wifi";
		reg = <0x00 0x18000000 0x00 0x100000>;
		interrupts = <0x00 0xd4 0x08>;
		memory-region = <0x49>;
	};

	disp_pwm@1100e000 {
		compatible = "mediatek,disp_pwm";
		reg = <0x00 0x1100e000 0x00 0x1000>;
	};

	spi1@11010000 {
		compatible = "mediatek,mt6765-spi";
		mediatek,pad-select = <0x00>;
		reg = <0x00 0x11010000 0x00 0x1000>;
		interrupts = <0x00 0x42 0x08>;
		clocks = <0x0f 0x0d 0x0f 0x74 0x22 0x34>;
		clock-names = "parent-clk\0sel-clk\0spi-clk";
		phandle = <0xb4>;
	};

	spi2@11012000 {
		compatible = "mediatek,mt6765-spi";
		mediatek,pad-select = <0x00>;
		reg = <0x00 0x11012000 0x00 0x1000>;
		interrupts = <0x00 0x48 0x08>;
		clocks = <0x0f 0x0d 0x0f 0x74 0x22 0x37>;
		clock-names = "parent-clk\0sel-clk\0spi-clk";
		phandle = <0xb5>;
	};

	spi3@11013000 {
		compatible = "mediatek,mt6765-spi";
		mediatek,pad-select = <0x00>;
		reg = <0x00 0x11013000 0x00 0x1000>;
		interrupts = <0x00 0x49 0x08>;
		clocks = <0x0f 0x0d 0x0f 0x74 0x22 0x38>;
		clock-names = "parent-clk\0sel-clk\0spi-clk";
		phandle = <0xb6>;
	};

	spi4@11014000 {
		compatible = "mediatek,mt6765-spi";
		mediatek,pad-select = <0x00>;
		reg = <0x00 0x11014000 0x00 0x1000>;
		interrupts = <0x00 0x27 0x08>;
		clocks = <0x0f 0x0d 0x0f 0x74 0x22 0x41>;
		clock-names = "parent-clk\0sel-clk\0spi-clk";
		phandle = <0xb7>;
	};

	spi5@11015000 {
		compatible = "mediatek,mt6765-spi";
		mediatek,pad-select = <0x00>;
		reg = <0x00 0x11015000 0x00 0x1000>;
		interrupts = <0x00 0x28 0x08>;
		clocks = <0x0f 0x0d 0x0f 0x74 0x22 0x42>;
		clock-names = "parent-clk\0sel-clk\0spi-clk";
		phandle = <0xb8>;
	};

	imp_iic@11017000 {
		compatible = "mediatek,imp_iic";
		reg = <0x00 0x11017000 0x00 0x1000>;
	};

	nfi@11018000 {
		compatible = "mediatek,nfi";
		reg = <0x00 0x11018000 0x00 0x1000>;
	};

	nfiecc@11019000 {
		compatible = "mediatek,nfiecc";
		reg = <0x00 0x11019000 0x00 0x1000>;
	};

	usb0@11200000 {
		compatible = "mediatek,mt6761-usb20";
		reg = <0x00 0x11200000 0x00 0x10000 0x00 0x11cc0000 0x00 0x10000>;
		interrupts = <0x00 0x11 0x08>;
		mode = <0x02>;
		multipoint = <0x01>;
		num_eps = <0x10>;
		clocks = <0x22 0x08 0x0f 0x7f 0x0f 0x23>;
		clock-names = "usb0\0usb0_clk_top_sel\0usb0_clk_univpll3_d4";
		charger = <0x25>;
		nvmem-cells = <0x4a>;
		nvmem-cell-names = "efuse_idx107";
		phandle = <0xb9>;
	};

	usb_sif@11210000 {
		compatible = "mediatek,usb_sif";
		reg = <0x00 0x11210000 0x00 0x1000>;
	};

	msdc@11230000 {
		compatible = "mediatek,msdc";
		reg = <0x00 0x11230000 0x00 0x10000>;
		interrupts = <0x00 0x17 0x08>;
		index = [00];
		clk_src = [01];
		bus-width = <0x08>;
		max-frequency = <0xbebc200>;
		cap-mmc-highspeed;
		mmc-ddr-1_8v;
		mmc-hs200-1_8v;
		mmc-hs400-1_8v;
		no-sd;
		no-sdio;
		non-removable;
		pinctl = <0x4b>;
		pinctl_hs400 = <0x4c>;
		pinctl_hs200 = <0x4d>;
		register_setting = <0x4e>;
		host_function = [00];
		bootable;
		status = "okay";
		infracfg = <0x22>;
		topckgen = <0x0f>;
		vmmc-supply = <0x4f>;
		clocks = <0x22 0x4f 0x22 0x1c 0x22 0x45>;
		clock-names = "msdc0-clock\0msdc0-hclock\0msdc0-aes-clock";
		phandle = <0xba>;
	};

	msdc@11240000 {
		compatible = "mediatek,msdc";
		reg = <0x00 0x11240000 0x00 0x10000>;
		interrupts = <0x00 0x18 0x08>;
		index = [01];
		clk_src = [02];
		bus-width = <0x04>;
		max-frequency = <0xbebc200>;
		cap-sd-highspeed;
		sd-uhs-sdr12;
		sd-uhs-sdr25;
		sd-uhs-sdr50;
		sd-uhs-sdr104;
		sd-uhs-ddr50;
		no-mmc;
		no-sdio;
		pinctl = <0x50>;
		pinctl_sdr104 = <0x51>;
		pinctl_sdr50 = <0x52>;
		pinctl_ddr50 = <0x53>;
		register_setting = <0x54>;
		host_function = [01];
		cd_level = [01];
		cd-gpios = <0x1e 0x00 0x00>;
		status = "okay";
		vmmc-supply = <0x55>;
		vqmmc-supply = <0x56>;
		mediatek,pwrap-regmap = <0x12>;
		clocks = <0x22 0x50 0x22 0x1d>;
		clock-names = "msdc1-clock\0msdc1-hclock";
		phandle = <0xbb>;
	};

	msdc@11250000 {
		compatible = "mediatek,msdc2";
		reg = <0x00 0x11250000 0x00 0x10000>;
		status = "disable";
		phandle = <0xbc>;
	};

	msdc@11260000 {
		compatible = "mediatek,msdc3";
		reg = <0x00 0x11250000 0x00 0x10000>;
		status = "disable";
		phandle = <0xbd>;
	};

	msdc1_ins@0 {
		compatible = "mediatek,mt6761-sdcard-ins";
		phandle = <0xbe>;
	};

	msdc0_top@11cd0000 {
		compatible = "mediatek,msdc0_top";
		reg = <0x00 0x11cd0000 0x00 0x1000>;
	};

	msdc1_top@11c90000 {
		compatible = "mediatek,msdc1_top";
		reg = <0x00 0x11c90000 0x00 0x1000>;
	};

	usb1p_sif@11210000 {
		compatible = "mediatek,usb1p_sif";
		reg = <0x00 0x11210000 0x00 0x10000>;
	};

	audclk@11220000 {
		compatible = "mediatek,mt6761-audsys\0syscon";
		reg = <0x00 0x11220000 0x00 0x1000>;
		#clock-cells = <0x01>;
		phandle = <0x58>;
	};

	audio@11220000 {
		compatible = "mediatek,audio\0syscon";
		reg = <0x00 0x11220000 0x00 0x1000>;
		mediatek,btcvsd_snd = <0x57>;
		phandle = <0xbf>;
	};

	mt_soc_dl1_pcm@11220000 {
		compatible = "mediatek,mt_soc_pcm_dl1";
		reg = <0x00 0x11220000 0x00 0x1000>;
		interrupts = <0x00 0x61 0x08>;
		clocks = <0x58 0x00 0x58 0x04 0x58 0x05 0x58 0x03 0x58 0x01 0x58 0x02 0x58 0x06 0x22 0x2b 0x22 0x33 0x0f 0x78 0x0f 0x79 0x0f 0x05 0x0f 0x7a 0x0f 0x2b 0x0f 0x7b 0x0f 0x2e 0x20 0x06 0x21>;
		clock-names = "aud_afe_clk\0aud_dac_clk\0aud_dac_predis_clk\0aud_adc_clk\0aud_apll22m_clk\0aud_apll1_tuner_clk\0aud_tml_clk\0aud_infra_clk\0mtkaif_26m_clk\0top_mux_audio\0top_mux_audio_int\0top_sys_pll1_d4\0top_mux_aud_1\0top_apll1_ck\0top_mux_aud_eng1\0top_apll1_d8\0apmixed_apll1\0top_clk26m_clk";
		phandle = <0xc0>;
	};

	audio_sram@11221000 {
		compatible = "mediatek,audio_sram";
		reg = <0x00 0x11221000 0x00 0x9000>;
	};

	mtk-btcvsd-snd@18050000 {
		compatible = "mediatek,mtk-btcvsd-snd";
		reg = <0x00 0x18050000 0x00 0x1000 0x00 0x18080000 0x00 0x10000>;
		interrupts = <0x00 0xd2 0x08>;
		mediatek,infracfg = <0x22>;
		mediatek,offset = <0xf00 0x800 0x140 0x144 0x148>;
		phandle = <0x57>;
	};

	mipi_rx_ana_csi0a@11c10000 {
		compatible = "mediatek,mt6761-mipi0a\0syscon";
		reg = <0x00 0x11c10000 0x00 0x1000>;
		#clock-cells = <0x01>;
		phandle = <0x5b>;
	};

	mipi_rx_ana_csi1@11c20000 {
		compatible = "mediatek,mipi_rx_ana_csi1";
		reg = <0x00 0x11c20000 0x00 0x10000>;
	};

	mipi_rx_ana_csi0b@11c11000 {
		compatible = "mediatek,mt6761-mipi0b\0syscon";
		reg = <0x00 0x11c11000 0x00 0x1000>;
		#clock-cells = <0x01>;
		phandle = <0xc1>;
	};

	mipi_rx_ana_csi1a@11c12000 {
		compatible = "mediatek,mt6761-mipi1a\0syscon";
		reg = <0x00 0x11c12000 0x00 0x1000>;
		#clock-cells = <0x01>;
		phandle = <0xc2>;
	};

	mipi_rx_ana_csi1b@11c13000 {
		compatible = "mediatek,mt6761-mipi1b\0syscon";
		reg = <0x00 0x11c13000 0x00 0x1000>;
		#clock-cells = <0x01>;
		phandle = <0xc3>;
	};

	mipi_rx_ana_csi2a@11c14000 {
		compatible = "mediatek,mt6761-mipi2a\0syscon";
		reg = <0x00 0x11c14000 0x00 0x1000>;
		#clock-cells = <0x01>;
		phandle = <0xc4>;
	};

	mipi_rx_ana_csi2b@11c15000 {
		compatible = "mediatek,mt6761-mipi2b\0syscon";
		reg = <0x00 0x11c15000 0x00 0x1000>;
		#clock-cells = <0x01>;
		phandle = <0xc5>;
	};

	mipi_rx_ana_csi2@11c30000 {
		compatible = "mediatek,mipi_rx_ana_csi2";
		reg = <0x00 0x11c30000 0x00 0x10000>;
	};

	efuse@11c50000 {
		compatible = "mediatek,devinfo";
		reg = <0x00 0x11c50000 0x00 0x10000>;
		#address-cells = <0x01>;
		#size-cells = <0x01>;
		phandle = <0x45>;

		segment@78 {
			reg = <0x78 0x04>;
			phandle = <0x37>;
		};

		segment@1c {
			reg = <0x1c 0x04>;
			phandle = <0x46>;
		};

		segment@190 {
			reg = <0x190 0x0c>;
			phandle = <0x47>;
		};

		efuse_analog7@1ac {
			reg = <0x1ac 0x04>;
			phandle = <0x4a>;
		};
	};

	mipi_tx0@11c80000 {
		compatible = "mediatek,mipi_tx0";
		reg = <0x00 0x11c80000 0x00 0x10000>;
	};

	msdc1_pad_macro@11c90000 {
		compatible = "mediatek,msdc1_pad_macro";
		reg = <0x00 0x11c90000 0x00 0x10000>;
	};

	msdc0_pad_macro@11cd0000 {
		compatible = "mediatek,msdc0_pad_macro";
		reg = <0x00 0x11cd0000 0x00 0x10000>;
	};

	mfg_clark@13000000 {
		compatible = "mediatek,clark";
		reg = <0x00 0x13000000 0x00 0x80000>;
		interrupts = <0x00 0xcb 0x08>;
		interrupt-names = "RGX";
		clock-frequency = <0x21f98280>;
		ged-supply = <0x59>;
		phandle = <0xc6>;
	};

	mfg_cfg@13ffe000 {
		compatible = "mediatek,mfgcfg\0syscon";
		reg = <0x00 0x13ffe000 0x00 0x1000>;
		#clock-cells = <0x01>;
		phandle = <0xc7>;
	};

	gpufreq {
		compatible = "mediatek,mt6761-gpufreq";
		clocks = <0x0f 0x6d 0x0f 0x28 0x21 0x34 0x07 0x34 0x04 0x34 0x06>;
		clock-names = "clk_mux\0clk_main_parent\0clk_sub_parent\0mtcmos_mfg_async\0mtcmos_mfg\0mtcmos_mfg_core0";
		nvmem-cells = <0x37>;
		nvmem-cell-names = "efuse_segment_cell";
		vcore-supply = <0x36>;
		phandle = <0x5a>;
	};

	ged {
		compatible = "mediatek,ged";
		gpufreq-supply = <0x5a>;
		phandle = <0x59>;
	};

	mmsys_config@14000000 {
		compatible = "mediatek,mt6761-mmsys_config\0syscon";
		reg = <0x00 0x14000000 0x00 0x1000>;
		interrupts = <0x00 0xab 0x08>;
		#clock-cells = <0x01>;
		phandle = <0x10>;
	};

	dispsys_config@14000000 {
		compatible = "mediatek,mmsys_config\0syscon";
		reg = <0x00 0x14000000 0x00 0x1000>;
		interrupts = <0x00 0xab 0x08>;
		clocks = <0x10 0x17 0x10 0x1a 0x10 0x1b>;
		clock-names = "CAM_MDP\0IMG_DL_RELAY\0IMG_DL_ASYNC_TOP";
		phandle = <0x38>;
	};

	nfc {
		compatible = "mediatek,nfc-gpio-v2";
		gpio-rst = <0xac>;
		gpio-rst-std = <0x1e 0xac 0x00>;
		gpio-irq = <0x0a>;
		gpio-irq-std = <0x1e 0x0a 0x00>;
		phandle = <0xc8>;
	};

	irq_nfc {
		compatible = "mediatek,irq_nfc-eint";
		phandle = <0xc9>;
	};

	disp_mutex0@14001000 {
		compatible = "mediatek,disp_mutex0";
		reg = <0x00 0x14001000 0x00 0x1000>;
		interrupts = <0x00 0x9a 0x08>;
		phandle = <0x41>;
	};

	smi_common@14002000 {
		compatible = "mediatek,smi_common\0mediatek,mt6761-smi-common";
		reg = <0x00 0x14002000 0x00 0x1000>;
		mmsys_config = <0x38>;
		clocks = <0x34 0x03 0x10 0x15 0x10 0x16 0x10 0x13>;
		clock-names = "apb\0gals0\0gals1\0smi";
		mediatek,smi-id = <0x03>;
		mediatek,smi-cnt = <0x04>;
		phandle = <0xca>;
	};

	mmdvfs_pmqos {
		compatible = "mediatek,mmdvfs_pmqos";
		mm_step0 = <0x1b4 0x01 0x00 0x01>;
		mm_step0_ext = <0x1b4 0x02 0x06 0x10c4ec>;
		mm_step1 = <0x138 0x01 0x00 0x02>;
		mm_step1_ext = <0x138 0x02 0x06 0x10c4ec>;
		mm_step2 = <0xe3 0x01 0x00 0x03>;
		mm_step2_ext = <0xe3 0x02 0x06 0x117627>;
		vopp_steps = <0x00 0x01 0x03>;
		disp_freq = "mm_step0\0mm_step1\0mm_step2";
		mdp_freq = "mm_step0\0mm_step1\0mm_step2";
		cam_freq = "mm_step0\0mm_step1\0mm_step2";
		img_freq = "mm_step0\0mm_step1\0mm_step2";
		vdec_freq = "mm_step0\0mm_step1\0mm_step2";
		venc_freq = "mm_step0\0mm_step1\0mm_step2";
		clocks = <0x0f 0x6b 0x0f 0x24 0x0f 0x1a 0x0f 0x25>;
		clock-names = "mmdvfs_clk_mm_sel_ck\0mmdvfs_clk_mmpll_ck\0mmdvfs_clk_univpll1_d2_ck\0mmdvfs_clk_mmpll_d2_ck";
	};

	smi_larb0@14003000 {
		compatible = "mediatek,smi_larb0\0mediatek,smi_larb\0mediatek,mt6761-smi-larb";
		reg = <0x00 0x14003000 0x00 0x1000>;
		mediatek,larb-id = <0x00>;
		clocks = <0x34 0x03 0x10 0x14>;
		clock-names = "apb\0smi";
		mediatek,smi-id = <0x00>;
		phandle = <0x31>;
	};

	mdp_rdma0@14004000 {
		compatible = "mediatek,mdp_rdma0";
		reg = <0x00 0x14004000 0x00 0x1000>;
		interrupts = <0x00 0x9b 0x08>;
		clocks = <0x10 0x00>;
		clock-names = "MDP_RDMA0";
		phandle = <0x39>;
	};

	mdp_ccorr0@14005000 {
		compatible = "mediatek,mdp_ccorr0";
		reg = <0x00 0x14005000 0x00 0x1000>;
		interrupts = <0x00 0xaa 0x08>;
		clocks = <0x10 0x01>;
		clock-names = "MDP_CCORR";
		phandle = <0x40>;
	};

	mdp_rsz0@14006000 {
		compatible = "mediatek,mdp_rsz0";
		reg = <0x00 0x14006000 0x00 0x1000>;
		interrupts = <0x00 0x9c 0x08>;
		clocks = <0x10 0x02>;
		clock-names = "MDP_RSZ0";
		phandle = <0x3a>;
	};

	mdp_rsz1@14007000 {
		compatible = "mediatek,mdp_rsz1";
		reg = <0x00 0x14007000 0x00 0x1000>;
		interrupts = <0x00 0x9d 0x08>;
		clocks = <0x10 0x03>;
		clock-names = "MDP_RSZ1";
		phandle = <0x3b>;
	};

	mdp_wdma0@14008000 {
		compatible = "mediatek,mdp_wdma0";
		reg = <0x00 0x14008000 0x00 0x1000>;
		interrupts = <0x00 0xa0 0x08>;
		clocks = <0x10 0x06>;
		clock-names = "MDP_WDMA";
		phandle = <0x3c>;
	};

	mdp_wrot0@14009000 {
		compatible = "mediatek,mdp_wrot0";
		reg = <0x00 0x14009000 0x00 0x1000>;
		interrupts = <0x00 0x9f 0x08>;
		clocks = <0x10 0x05>;
		clock-names = "MDP_WROT0";
		phandle = <0x3d>;
	};

	mdp_tdshp0@1400a000 {
		compatible = "mediatek,mdp_tdshp0";
		reg = <0x00 0x1400a000 0x00 0x1000>;
		clocks = <0x10 0x04>;
		clock-names = "MDP_TDSHP";
		phandle = <0x3e>;
	};

	disp_ovl0@1400b000 {
		compatible = "mediatek,disp_ovl0";
		reg = <0x00 0x1400b000 0x00 0x1000>;
		interrupts = <0x00 0xa1 0x08>;
	};

	disp_ovl0_2l@1400c000 {
		compatible = "mediatek,disp_ovl0_2l";
		reg = <0x00 0x1400c000 0x00 0x1000>;
		interrupts = <0x00 0xad 0x08>;
	};

	disp_rdma0@1400d000 {
		compatible = "mediatek,disp_rdma0";
		reg = <0x00 0x1400d000 0x00 0x1000>;
		interrupts = <0x00 0xa2 0x08>;
	};

	disp_wdma0@1400e000 {
		compatible = "mediatek,disp_wdma0";
		reg = <0x00 0x1400e000 0x00 0x1000>;
		interrupts = <0x00 0xa3 0x08>;
	};

	disp_color0@1400f000 {
		compatible = "mediatek,disp_color0";
		reg = <0x00 0x1400f000 0x00 0x1000>;
		interrupts = <0x00 0xa4 0x08>;
		phandle = <0x3f>;
	};

	disp_ccorr0@14010000 {
		compatible = "mediatek,disp_ccorr0";
		reg = <0x00 0x14010000 0x00 0x1000>;
		interrupts = <0x00 0xa5 0x08>;
	};

	disp_aal0@14011000 {
		compatible = "mediatek,disp_aal0";
		reg = <0x00 0x14011000 0x00 0x1000>;
		interrupts = <0x00 0xa6 0x08>;
	};

	disp_gamma0@14012000 {
		compatible = "mediatek,disp_gamma0";
		reg = <0x00 0x14012000 0x00 0x1000>;
		interrupts = <0x00 0xa7 0x08>;
	};

	disp_dither0@14013000 {
		compatible = "mediatek,disp_dither0";
		reg = <0x00 0x14013000 0x00 0x1000>;
		interrupts = <0x00 0xa8 0x08>;
	};

	dsi0@14014000 {
		compatible = "mediatek,dsi0";
		reg = <0x00 0x14014000 0x00 0x1000>;
		interrupts = <0x00 0xa9 0x08>;
	};

	disp_rsz0@14015000 {
		compatible = "mediatek,disp_rsz0";
		reg = <0x00 0x14015000 0x00 0x1000>;
		interrupts = <0x00 0xdc 0x08>;
	};

	mtkfb@0 {
		compatible = "mediatek,mtkfb";
		phandle = <0xcb>;
	};

	dispsys {
		compatible = "mediatek,dispsys";
		mediatek,larb = <0x31>;
		clocks = <0x34 0x03 0x10 0x13 0x10 0x14 0x10 0x15 0x10 0x16 0x10 0x07 0x10 0x08 0x10 0x0a 0x10 0x0b 0x10 0x0c 0x10 0x0d 0x10 0x0e 0x10 0x0f 0x10 0x10 0x10 0x11 0x10 0x1c 0x10 0x1d 0x10 0x09 0x20 0x13 0x0f 0x7c 0x22 0x31 0x21 0x0f 0x1e 0x0f 0x2f 0x0f 0x31>;
		clock-names = "MMSYS_MTCMOS\0MMSYS_SMI_COMMON\0MMSYS_SMI_LARB0\0MMSYS_GALS_COMM0\0MMSYS_GALS_COMM1\0MMSYS_DISP_OVL0\0MMSYS_DISP_OVL0_2L\0MMSYS_DISP_RDMA0\0MMSYS_DISP_WDMA0\0MMSYS_DISP_COLOR0\0MMSYS_DISP_CCORR0\0MMSYS_DISP_AAL0\0MMSYS_DISP_GAMMA0\0MMSYS_DISP_DITHER0\0MMSYS_DSI0_MM_CK\0MMSYS_DSI0_IF_CK\0MMSYS_26M\0MMSYS_DISP_RSZ0\0APMIXED_MIPI_26M\0TOP_MUX_DISP_PWM\0DISP_PWM\0TOP_26M\0TOP_UNIVPLL2_D4\0TOP_ULPOSC1_D2\0TOP_ULPOSC1_D8";
	};

	dsi_te {
		compatible = "mediatek, DSI_TE-eint";
		status = "disabled";
		phandle = <0xcc>;
	};

	mm_mutex@14016000 {
		compatible = "mediatek,mm_mutex";
		reg = <0x00 0x14016000 0x00 0x1000>;
		phandle = <0xcd>;
	};

	camsys@15000000 {
		compatible = "mediatek,mt6761-camsys\0syscon";
		reg = <0x00 0x15000000 0x00 0x1000>;
		#clock-cells = <0x01>;
		phandle = <0x11>;
	};

	ispsys@15000000 {
		compatible = "mediatek,mt6761-ispsys";
		reg = <0x00 0x15004000 0x00 0x9000 0x00 0x1500d000 0x00 0x1000 0x00 0x15000000 0x00 0x52000 0x00 0x15040000 0x00 0x8000 0x00 0x10215000 0x00 0x3000 0x00 0x10211000 0x00 0x1000>;
		interrupts = <0x00 0xb3 0x08 0x00 0xb4 0x08 0x00 0xb5 0x08 0x00 0xb8 0x08 0x00 0xb9 0x08 0x00 0xba 0x08 0x00 0xbb 0x08>;
		clocks = <0x34 0x03 0x34 0x08 0x11 0x00 0x11 0x01 0x11 0x02 0x11 0x03 0x11 0x04 0x11 0x05 0x10 0x15 0x10 0x16 0x10 0x13>;
		clock-names = "CG_SCP_SYS_DIS\0CG_SCP_SYS_CAM\0CG_CAM_LARB2\0CG_CAM\0CG_CAMTG\0CG_CAM_SENINF\0CG_CAMSV0\0CG_CAMSV1\0CG_MM_SMI_COMM0\0CG_MM_SMI_COMM1\0CG_MM_SMI_COMMON";
	};

	smi_larb2@15001000 {
		compatible = "mediatek,smi_larb2\0mediatek,smi_larb\0mediatek,mt6761-smi-larb";
		reg = <0x00 0x15001000 0x00 0x1000>;
		mediatek,larb-id = <0x02>;
		clocks = <0x34 0x08 0x10 0x18 0x11 0x00>;
		clock-names = "apb\0gals\0smi";
		mediatek,smi-id = <0x02>;
		phandle = <0x33>;
	};

	cam@15004000 {
		compatible = "mediatek,cam";
		reg = <0x00 0x15004000 0x00 0x1000>;
	};

	cam_lut@15005000 {
		compatible = "mediatek,cam_lut";
		reg = <0x00 0x15005000 0x00 0x1000>;
	};

	camd@15006000 {
		compatible = "mediatek,camd";
		reg = <0x00 0x15006000 0x00 0x1000>;
	};

	cam_dma@15007000 {
		compatible = "mediatek,cam_dma";
		reg = <0x00 0x15007000 0x00 0x1000>;
	};

	fdvt@1500b000 {
		compatible = "mediatek,fdvt";
		reg = <0x00 0x1500b000 0x00 0x1000>;
		interrupts = <0x00 0xb6 0x08>;
		clocks = <0x11 0x06>;
		clock-names = "FD_CLK_CAM_FDVT";
	};

	cam_inner@1500d000 {
		compatible = "mediatek,cam_inner";
		reg = <0x00 0x1500d000 0x00 0x1000>;
	};

	camd_inner@1500e000 {
		compatible = "mediatek,camd_inner";
		reg = <0x00 0x1500e000 0x00 0x1000>;
	};

	cam_inner_dma@1500f000 {
		compatible = "mediatek,cam_inner_dma";
		reg = <0x00 0x1500f000 0x00 0x1000>;
	};

	camsv0@15050000 {
		compatible = "mediatek,camsv0";
		reg = <0x00 0x15050000 0x00 0x1000>;
	};

	camsv1@15051000 {
		compatible = "mediatek,camsv1";
		reg = <0x00 0x15051000 0x00 0x1000>;
	};

	kd_camera_hw1@15040000 {
		compatible = "mediatek,camera_hw";
		reg = <0x00 0x15040000 0x00 0x1000>;
		pmic = <0x2c>;
		clocks = <0x0f 0x6f 0x0f 0x70 0x0f 0x71 0x0f 0x72 0x0f 0x16 0x0f 0x15 0x0f 0x20 0x0f 0x13 0x0f 0x1f 0x0f 0x14 0x21 0x11 0x03 0x20 0x0c 0x20 0x10 0x5b 0x00 0x0f 0x86 0x0f 0x1d 0x34 0x08>;
		clock-names = "CLK_TOP_CAMTG_SEL\0CLK_TOP_CAMTG1_SEL\0CLK_TOP_CAMTG2_SEL\0CLK_TOP_CAMTG3_SEL\0CLK_MCLK_6M\0CLK_MCLK_12M\0CLK_MCLK_13M\0CLK_MCLK_48M\0CLK_MCLK_52M\0CLK_MCLK_24M\0CLK_MCLK_26M\0CLK_CAM_SENINF_CG\0CLK_MIPI_C0_26M_CG\0CLK_MIPI_C1_26M_CG\0CLK_MIPI_ANA_0A_CG\0CLK_TOP_CAMTM_SEL_CG\0CLK_TOP_CAMTM_208_CG\0CLK_SCP_SYS_CAM";
		phandle = <0xce>;
	};

	camera_af_hw_node {
		compatible = "mediatek,camera_af_lens";
		camaf_m1_pmic-supply = <0x5c>;
		phandle = <0xcf>;
	};

	flashlights_aw36515 {
		compatible = "mediatek,flashlights_aw36515";
		phandle = <0xd0>;
	};

	flashlight_core {
		compatible = "mediatek,flashlight_core";
		phandle = <0xd1>;
	};

	flashlights_mt6370 {
		compatible = "mediatek,flashlights_mt6370";
		decouple = <0x00>;
		phandle = <0xd2>;

		channel@1 {
			type = <0x00>;
			ct = <0x00>;
			part = <0x00>;
		};

		channel@2 {
			type = <0x00>;
			ct = <0x01>;
			part = <0x00>;
		};
	};

	flashlights_aw3644 {
		compatible = "mediatek,flashlights_aw3644";
		phandle = <0xd3>;
	};

	vcodecsys@17000000 {
		compatible = "mediatek,mt6761-vcodecsys\0syscon";
		reg = <0x00 0x17000000 0x00 0x10000>;
		#clock-cells = <0x01>;
		phandle = <0x5d>;
	};

	venc_gcon@17000000 {
		compatible = "mediatek,venc_gcon\0syscon";
		reg = <0x00 0x17000000 0x00 0x10000>;
		clocks = <0x34 0x03 0x34 0x09 0x10 0x15 0x10 0x16 0x10 0x13 0x5d 0x03 0x5d 0x01>;
		clock-names = "MT_SCP_SYS_DIS\0MT_SCP_SYS_VCODEC\0MT_CG_MM_SMI_COMM0\0MT_CG_MM_SMI_COMM1\0MT_CG_MM_SMI_COMMON\0MT_CG_VDEC\0MT_CG_VENC";
		phandle = <0xd4>;
	};

	smi_larb1@17010000 {
		compatible = "mediatek,smi_larb1\0mediatek,smi_larb\0mediatek,mt6761-smi-larb";
		reg = <0x00 0x17010000 0x00 0x1000>;
		mediatek,larb-id = <0x01>;
		clocks = <0x34 0x09 0x5d 0x01>;
		clock-names = "apb\0smi";
		mediatek,smi-id = <0x01>;
		phandle = <0x32>;
	};

	venc@17020000 {
		compatible = "mediatek,venc";
		reg = <0x00 0x17020000 0x00 0x10000>;
		interrupts = <0x00 0xae 0x08>;
	};

	venc_jpg@17030000 {
		compatible = "mediatek,venc_jpg";
		reg = <0x00 0x17030000 0x00 0x10000>;
		interrupts = <0x00 0xb0 0x08>;
		clocks = <0x5d 0x02>;
		clock-names = "MT_CG_VENC_JPGENC";
	};

	vdec@17040000 {
		compatible = "mediatek,vdec";
		reg = <0x00 0x17040000 0x00 0x10000>;
		interrupts = <0x00 0xb1 0x08>;
	};

	mbist@17050000 {
		compatible = "mediatek,mbist";
		reg = <0x00 0x17050000 0x00 0x10000>;
	};

	otg_iddig {
		compatible = "mediatek,usb_iddig_bi_eint";
		phandle = <0xd5>;
	};

	odm {
		compatible = "simple-bus";
		phandle = <0xd6>;
	};

	audio_snd_card {
		compatible = "mediatek,audio_snd_card";
	};

	mt_soc_deep_buffer_dl_pcm {
		compatible = "mediatek,mt_soc_pcm_deep_buffer_dl";
	};

	mt_soc_ul1_pcm {
		compatible = "mediatek,mt_soc_pcm_capture";
	};

	mt_soc_voice_md1 {
		compatible = "mediatek,mt_soc_pcm_voice_md1";
	};

	mt_soc_uldlloopback_pcm {
		compatible = "mediatek,mt_soc_pcm_uldlloopback";
	};

	mt_soc_i2s0_pcm {
		compatible = "mediatek,mt_soc_pcm_dl1_i2s0";
	};

	mt_soc_mrgrx_pcm {
		compatible = "mediatek,mt_soc_pcm_mrgrx";
	};

	mt_soc_mrgrx_awb_pcm {
		compatible = "mediatek,mt_soc_pcm_mrgrx_awb";
	};

	mt_soc_fm_i2s_pcm {
		compatible = "mediatek,mt_soc_pcm_fm_i2s";
	};

	mt_soc_fm_i2s_awb_pcm {
		compatible = "mediatek,mt_soc_pcm_fm_i2s_awb";
	};

	mt_soc_i2s0dl1_pcm {
		compatible = "mediatek,mt_soc_pcm_dl1_i2s0dl1";
	};

	mt_soc_dl1_awb_pcm {
		compatible = "mediatek,mt_soc_pcm_dl1_awb";
	};

	mt_soc_voice_md1_bt {
		compatible = "mediatek,mt_soc_pcm_voice_md1_bt";
	};

	mt_soc_voip_bt_out {
		compatible = "mediatek,mt_soc_pcm_dl1_bt";
	};

	mt_soc_voip_bt_in {
		compatible = "mediatek,mt_soc_pcm_bt_dai";
	};

	mt_soc_tdmrx_pcm {
		compatible = "mediatek,mt_soc_tdm_capture";
	};

	mt_soc_fm_mrgtx_pcm {
		compatible = "mediatek,mt_soc_pcm_fmtx";
	};

	mt_soc_ul2_pcm {
		compatible = "mediatek,mt_soc_pcm_capture2";
	};

	mt_soc_i2s0_awb_pcm {
		compatible = "mediatek,mt_soc_pcm_i2s0_awb";
	};

	mt_soc_voice_md2 {
		compatible = "mediatek,mt_soc_pcm_voice_md2";
	};

	mt_soc_routing_pcm {
		compatible = "mediatek,mt_soc_pcm_routing";
	};

	mt_soc_voice_md2_bt {
		compatible = "mediatek,mt_soc_pcm_voice_md2_bt";
	};

	mt_soc_hp_impedance_pcm {
		compatible = "mediatek,mt_soc_pcm_hp_impedance";
	};

	mt_soc_dummy_pcm {
		compatible = "mediatek,mt_soc_pcm_dummy";
	};

	mt_soc_codec_dummy_name {
		compatible = "mediatek,mt_soc_codec_dummy";
	};

	mt_soc_routing_dai_name {
		compatible = "mediatek,mt_soc_dai_routing";
	};

	mt_soc_dai_name {
		compatible = "mediatek,mt_soc_dai_stub";
	};

	mt_soc_dl2_pcm {
		compatible = "mediatek,mt_soc_pcm_dl2";
	};

	mt_soc_anc_pcm {
		compatible = "mediatek,mt_soc_pcm_anc";
	};

	mt_soc_pcm_voice_ultra {
		compatible = "mediatek,mt_soc_pcm_voice_ultra";
	};

	mt_soc_pcm_voice_usb {
		compatible = "mediatek,mt_soc_pcm_voice_usb";
	};

	mt_soc_pcm_voice_usb_echoref {
		compatible = "mediatek,mt_soc_pcm_voice_usb_echoref";
	};

	tran_battery {
		compatible = "tran,chg_fun";
		enable_pcb_tml;
		pcb_temp_step_one = <0xa7f8>;
		pcb_cur_step_one = <0xc8>;
		pcb_temp_step_two = <0xafc8>;
		pcb_cur_step_two = <0x64>;
		pcb_min_chg_cur = <0x120160>;
		jeita_below_t0_chg_cur = <0x00>;
		jeita_t0_to_t1_chg_cur = <0xc3500>;
		jeita_t2_to_t3_chg_cur = <0x1cafc0>;
		jeita_t3_to_t4_chg_cur = <0x1cafc0>;
		jeita_above_t4_chg_cur = <0x00>;
		jeita_below_t0_input_cur = <0xc3500>;
		jeita_t0_to_t1_input_cur = <0xc3500>;
		jeita_t2_to_t3_input_cur = <0x1cafc0>;
		jeita_t3_to_t4_input_cur = <0x1cafc0>;
		jeita_above_t4_input_cur = <0xf4240>;
		jeita_above_t4_topoff_voltage = <0x3c45b0>;
		jeita_t3_to_t4_topoff_voltage = <0x3c45b0>;
		jeita_t2_to_t3_topoff_voltage = <0x401640>;
		jeita_t1_to_t2_topoff_voltage = <0x401640>;
		jeita_t0_to_t1_topoff_voltage = <0x401640>;
		jeita_below_t0_topoff_voltage = <0x401640>;
		phandle = <0xd7>;
	};

	tran_battery_aging {
		compatible = "tran,chg_aging";
		battery_aging_module0 = <0x00>;
		battery_aging_module1 = <0x00>;
		battery_aging_module2 = <0x00>;
		battery_aging_module3 = <0x00>;
		phandle = <0xd8>;
	};

	mt_charger {
		compatible = "mediatek,mt-charger";
		phandle = <0xd9>;
	};

	lk_charger {
		compatible = "mediatek,lk_charger";
		enable_anime;
		max_charger_voltage = <0x632ea0>;
		fast_charge_voltage = <0x2625a0>;
		usb_charger_current = <0x7ef40>;
		ac_charger_current = <0x16e360>;
		ac_charger_input_current = <0x16e360>;
		non_std_ac_charger_current = <0x7ef40>;
		charging_host_charger_current = <0xf4240>;
		ta_ac_charger_current = <0x2dc6c0>;
		pd_charger_current = <0x7a120>;
		cur_threshold = <0x00>;
		temp_t4_threshold = <0x32>;
		temp_t3_threshold = <0x2d>;
		temp_t2_threshold = <0x0f>;
		temp_t1_threshold = <0x00>;
		phandle = <0xda>;
	};

	pdc {
		compatible = "mediatek,charger,pd";
		gauge = <0x5e>;
		min_charger_voltage = <0x4630c0>;
		pd_vbus_low_bound = <0x4c4b40>;
		pd_vbus_upper_bound = <0x4c4b40>;
		vsys_watt = <0x4c4b40>;
		ibus_err = <0x0e>;
		pd_stop_battery_soc = <0x50>;
		sc_input_current = <0x30d400>;
		sc_charger_current = <0x2dc6c0>;
		dcs_input_current = <0x30d400>;
		dcs_chg1_charger_current = <0x16e360>;
		dcs_chg2_charger_current = <0x16e360>;
		dual_polling_ieoc = <0x6ddd0>;
		slave_mivr_diff = <0x186a0>;
		phandle = <0xdb>;
	};

	pe4 {
		compatible = "mediatek,charger,pe4";
		gauge = <0x5e>;
		min_charger_voltage = <0x4630c0>;
		pe40_stop_battery_soc = <0x50>;
		high_temp_to_leave_pe40 = <0x2e>;
		high_temp_to_enter_pe40 = <0x27>;
		low_temp_to_leave_pe40 = <0x0a>;
		low_temp_to_enter_pe40 = <0x10>;
		ibus_err = <0x0e>;
		pe40_r_cable_1a_lower = <0x1f4>;
		pe40_r_cable_2a_lower = <0x15f>;
		pe40_r_cable_3a_lower = <0xf0>;
		sc_input_current = <0x30d400>;
		sc_charger_current = <0x2dc6c0>;
		dcs_input_current = <0x30d400>;
		dcs_chg1_charger_current = <0x16e360>;
		dcs_chg2_charger_current = <0x16e360>;
		dual_polling_ieoc = <0x6ddd0>;
		slave_mivr_diff = <0x186a0>;
		phandle = <0xdc>;
	};

	charger {
		compatible = "mediatek,charger";
		algorithm_name = "Pulse";
		gauge = <0x5e>;
		charger = <0x25>;
		bootmode = <0x26>;
		pmic = <0x2c>;
		enable_sw_jeita;
		disable_pd_dual;
		enable_ir_comp;
		r_bat_comp = <0x1e>;
		v_comp_max = <0x9c40>;
		disable_topoff_ir_comp;
		multi_battery_cv;
		battery_cv = <0x43e6d0 0x43e6d0 0x43e6d0 0x43e6d0>;
		max_charger_voltage = <0x632ea0>;
		min_charger_voltage = <0x4630c0>;
		usb_charger_current_suspend = <0x00>;
		usb_charger_current_unconfigured = <0x11170>;
		usb_charger_current_configured = <0x7ef40>;
		usb_charger_current = <0x7ef40>;
		ac_charger_current = <0x1cafc0>;
		ac_charger_input_current = <0x1cafc0>;
		non_std_ac_charger_current = <0x120160>;
		charging_host_charger_current = <0xf4240>;
		apple_1_0a_charger_current = <0x9eb10>;
		apple_2_1a_charger_current = <0xc3500>;
		ta_ac_charger_current = <0x2dc6c0>;
		enable_dynamic_mivr;
		min_charger_voltage_1 = <0x432380>;
		min_charger_voltage_2 = <0x401640>;
		max_dmivr_charger_current = <0x1b7740>;
		jeita_temp_above_t4_cv = <0x3f52f0 0x3f52f0 0x3f52f0 0x3f52f0>;
		jeita_temp_t3_to_t4_cv = <0x3f52f0 0x3f52f0 0x3f52f0 0x3f52f0>;
		jeita_temp_t2_to_t3_cv = <0x43e6d0 0x43e6d0 0x43e6d0 0x43e6d0>;
		jeita_temp_t1_to_t2_cv = <0x43e6d0 0x43e6d0 0x43e6d0 0x43e6d0>;
		jeita_temp_t0_to_t1_cv = <0x43e6d0 0x43e6d0 0x43e6d0 0x43e6d0>;
		jeita_temp_below_t0_cv = <0x43e6d0 0x43e6d0 0x43e6d0 0x43e6d0>;
		temp_t4_thres = <0x37>;
		temp_t4_thres_minus_x_degree = <0x33>;
		temp_t3_thres = <0x2d>;
		temp_t3_thres_minus_x_degree = <0x2c>;
		temp_t2_thres = <0x0f>;
		temp_t2_thres_plus_x_degree = <0x10>;
		temp_t1_thres = <0x01>;
		temp_t1_thres_plus_x_degree = <0x01>;
		temp_t0_thres = <0x01>;
		temp_t0_thres_plus_x_degree = <0x01>;
		temp_neg_10_thres = <0x02>;
		enable_min_charge_temp;
		min_charge_temp = <0x00>;
		min_charge_temp_plus_x_degree = <0x01>;
		max_charge_temp = <0x35>;
		max_charge_temp_minus_x_degree = <0x34>;
		ta_12v_support;
		ta_9v_support;
		pe_ichg_level_threshold = <0xf4240>;
		ta_ac_12v_input_current = <0x30d400>;
		ta_ac_9v_input_current = <0x30d400>;
		ta_ac_7v_input_current = <0x30d400>;
		pe20_ichg_level_threshold = <0xf4240>;
		ta_start_battery_soc = <0x00>;
		ta_stop_battery_soc = <0x55>;
		high_temp_to_leave_pe40 = <0x2e>;
		high_temp_to_enter_pe40 = <0x27>;
		low_temp_to_leave_pe40 = <0x0a>;
		low_temp_to_enter_pe40 = <0x10>;
		pe40_single_charger_input_current = <0x2dc6c0>;
		pe40_single_charger_current = <0x2dc6c0>;
		pe40_dual_charger_input_current = <0x2dc6c0>;
		pe40_dual_charger_chg1_current = <0x1e8480>;
		pe40_dual_charger_chg2_current = <0x1e8480>;
		pe40_stop_battery_soc = <0x50>;
		pe40_r_cable_1a_lower = <0x212>;
		pe40_r_cable_2a_lower = <0x186>;
		pe40_r_cable_3a_lower = <0xfc>;
		chg1_ta_ac_charger_current = <0x16e360>;
		chg2_ta_ac_charger_current = <0x16e360>;
		slave_mivr_diff = <0x186a0>;
		dual_polling_ieoc = <0x6ddd0>;
		cable_imp_threshold = <0x2bb>;
		vbat_cable_imp_threshold = <0x3b8260>;
		bif_threshold1 = <0x40d990>;
		bif_threshold2 = <0x419ce0>;
		bif_cv_under_threshold2 = <0x43e6d0>;
		pd_vbus_low_bound = <0x4c4b40>;
		pd_vbus_upper_bound = <0x4c4b40>;
		pd_ichg_level_threshold = <0xf4240>;
		pd_stop_battery_soc = <0x50>;
		ibus_err = <0x0e>;
		vsys_watt = <0x4c4b40>;
		recharge_offset = <0x186a0>;
		topoff_voltage = <0x401640>;
		chg_full_current = <0x30d40>;
		pinctrl-names = "dual_gpio_init\0dual_gpio_high\0dual_gpio_low";
		pinctrl-0 = <0x5f>;
		pinctrl-1 = <0x60>;
		pinctrl-2 = <0x61>;
		en_2a_dual_chg;
		max_dual_charger_time = <0x5460>;
		max_dual_bat_cur = <0x2ab980>;
		low_dual_cur_bound = <0x124f80>;
		max_dual_cv1 = <0x1162>;
		vbus_to_rsense_drop = <0x208>;
		dual_step1_cv = <0xd48>;
		dual_step1_cc = <0x30d40>;
		dual_step2_cv = <0xed8>;
		dual_step2_cc = <0x30d40>;
		io-channels = <0x27 0x04 0x23 0x01>;
		io-channel-names = "adapt_vol_channel\0pmic_isense_voltage";
		phandle = <0x2b>;
	};

	pmic_clock_buffer_ctrl {
		compatible = "mediatek,pmic_clock_buffer";
		mediatek,clkbuf-quantity = <0x07>;
		mediatek,clkbuf-config = <0x02 0x01 0x01 0x02 0x00 0x00 0x00>;
		mediatek,clkbuf-driving-current = <0x01 0x01 0x01 0x01 0x01 0x01 0x01>;
		mediatek,bblpm-support = "enable";
		pwrap-dcxo-en = <0x188 0x00 0x188 0x01 0x188 0x00>;
		pwrap-dcxo-cfg = <0x18c 0x19c>;
		spm-pwr-status = <0x180 0x00 0x180 0x01>;
		pwrap = <0x12>;
		sleep = <0x62>;
		phandle = <0xdd>;
	};

	pbm {
		compatible = "mediatek,pbm";
		io-channels = <0x23 0x00>;
		io-channel-names = "pmic_batadc";
		phandle = <0xde>;
	};

	usb_phy_tuning {
		compatible = "mediatek,phy_tuning";
		u2_vrt_ref = <0x03>;
		u2_term_ref = <0x03>;
		u2_vrt_otg = <0x06>;
		u2_term_otg = <0x06>;
	};

	pseudo_m4u {
		compatible = "mediatek,mt-pseudo_m4u";
		iommus = <0x63 0x02>;
	};

	pseudo_m4u-larb0 {
		compatible = "mediatek,mt-pseudo_m4u-port";
		mediatek,larbid = <0x00>;
		iommus = <0x63 0x00 0x63 0x01 0x63 0x02 0x63 0x03 0x63 0x04 0x63 0x05 0x63 0x06 0x63 0x07>;
	};

	pseudo_m4u-larb1 {
		compatible = "mediatek,mt-pseudo_m4u-port";
		mediatek,larbid = <0x01>;
		iommus = <0x63 0x20 0x63 0x21>;
	};

	pseudo_m4u-larb2 {
		compatible = "mediatek,mt-pseudo_m4u-port";
		mediatek,larbid = <0x02>;
		iommus = <0x63 0x40 0x63 0x41>;
	};

	radio_md_cfg {
		compatible = "mediatek,radio_md_cfg";
		phandle = <0xdf>;
	};

	dynamic_options {
		compatible = "mediatek,dynamic_options";
		phandle = <0xe0>;
	};

	cm_mgr@10200000 {
		compatible = "mediatek,mt6761-cm_mgr";
		reg = <0x00 0x10200000 0x00 0x4000>;
		reg-names = "cm_mgr_base";
		required-opps = <0x2d 0x2e 0x2f>;
		cm_mgr,cp_down = <0x64 0x64>;
		cm_mgr,cp_up = <0x64 0x64>;
		cm_mgr,dt_down = <0x00 0x03>;
		cm_mgr,dt_up = <0x00 0x03>;
		cm_mgr,vp_down = <0x64 0x64>;
		cm_mgr,vp_up = <0x64 0x64>;
		use_cpu_to_dram_map = "enable";
		cm_mgr_cpu_opp_to_dram = <0x00 0x00 0x00 0x00 0x01 0x01 0x01 0x01 0x01 0x02 0x02 0x02 0x02 0x02 0x02 0x02>;
		phandle = <0xe1>;
	};

	dram_ctrl {
		compatible = "mediatek,dram-qosctrl";
		required-opps = <0x2d 0x2e>;
	};

	__symbols__ {
		chosen = "/chosen";
		cluster0_opp = "/opp_table0";
		cpu0 = "/cpus/cpu@000";
		cpu1 = "/cpus/cpu@001";
		cpu2 = "/cpus/cpu@002";
		cpu3 = "/cpus/cpu@003";
		STANDBY = "/cpus/idle-states/standby";
		MCDI_CPU = "/cpus/idle-states/mcdi-cpu";
		MCDI_CLUSTER = "/cpus/idle-states/mcdi-cluster";
		SODI = "/cpus/idle-states/sodi";
		SODI3 = "/cpus/idle-states/sodi3";
		DPIDLE = "/cpus/idle-states/dpidle";
		SUSPEND = "/cpus/idle-states/suspend";
		consys_mem = "/reserved-memory/consys-reserve-memory";
		wifi_mem = "/reserved-memory/wifi-reserve-memory";
		cpu_dbgapb = "/cpu_dbgapb@0d410000";
		gic = "/interrupt-controller@0c000000";
		sysirq = "/intpol-controller@10200a80";
		infracfg_ao = "/infracfg_ao@10001000";
		scpsys = "/scpsys@10001000";
		scp_infra = "/scp_infra@10001000";
		topckgen = "/topckgen@10000000";
		dcm = "/dcm@10001000";
		io_cfg_lt = "/io_cfg_lt@10002000";
		io_cfg_lm = "/io_cfg_lm@10002200";
		io_cfg_lb = "/io_cfg_lb@10002400";
		io_cfg_bl = "/io_cfg_bl@10002600";
		io_cfg_rr = "/io_cfg_rr@10002800";
		io_cfg_rb = "/io_cfg_rb@10002a00";
		io_cfg_rt = "/io_cfg_rt@10002c00";
		pericfg = "/pericfg@10003000";
		smart_pa = "/smart_pa";
		tcpc_pd = "/tcpc_pd";
		md1_sim1_hot_plug_eint = "/md1_sim1_hot_plug_eint";
		md1_sim2_hot_plug_eint = "/md1_sim2_hot_plug_eint";
		gpio_usage_mapping = "/gpio";
		gpio = "/gpio@10005000";
		syscfg_pctl_0 = "/syscfg_pctl_0@10005000";
		sleep = "/sleep@10006000";
		eint = "/eint@1000b000";
		pio = "/pinctrl@10005000";
		msdc0_pins_default = "/pinctrl@10005000/msdc0@default";
		msdc0_pins_hs400 = "/pinctrl@10005000/msdc0@hs400";
		msdc0_pins_hs200 = "/pinctrl@10005000/msdc0@hs200";
		msdc0_register_setting_default = "/pinctrl@10005000/msdc0@register_default";
		msdc1_pins_default = "/pinctrl@10005000/msdc1@default";
		msdc1_pins_sdr104 = "/pinctrl@10005000/msdc1@sdr104";
		msdc1_pins_sdr50 = "/pinctrl@10005000/msdc1@sdr50";
		msdc1_pins_ddr50 = "/pinctrl@10005000/msdc1@ddr50";
		msdc1_register_setting_default = "/pinctrl@10005000/msdc1@register_default";
		msdc3_pins_default = "/pinctrl@10005000/msdc3@default";
		msdc3_register_setting_default = "/pinctrl@10005000/msdc3@register_default";
		dual_chg_pins_default = "/pinctrl@10005000/dualdefault";
		dual_chg_pins_high = "/pinctrl@10005000/dual_high";
		dual_chg_pins_low = "/pinctrl@10005000/dual_low";
		toprgu = "/toprgu@10007000";
		clk26m = "/clocks/clk26m";
		clk13m = "/clocks/clk13m";
		clk32k = "/clocks/clk32k";
		apmixed = "/apmixed@1000c000";
		fhctl = "/fhctl@1000ce00";
		pwrap = "/pwrap@1000d000";
		main_pmic = "/pwrap@1000d000/main_pmic";
		pmic_accdet = "/pwrap@1000d000/main_pmic/pmic_accdet";
		mt6357keys = "/pwrap@1000d000/main_pmic/mt6357keys";
		pmic_auxadc = "/pwrap@1000d000/main_pmic/pmic_auxadc";
		mtk_gauge = "/pwrap@1000d000/main_pmic/mtk_gauge";
		mtk_charger_type = "/pwrap@1000d000/main_pmic/mtk_charger_type";
		mt6357_charger = "/pwrap@1000d000/main_pmic/mt6357_charger";
		mtk_ts_pmic = "/pwrap@1000d000/main_pmic/mtk_ts_pmic";
		mt6357_ts_buck1 = "/pwrap@1000d000/main_pmic/mt6357_ts_buck1";
		mt6357_ts_buck2 = "/pwrap@1000d000/main_pmic/mt6357_ts_buck2";
		pmic_efuse = "/pwrap@1000d000/main_pmic/pmic_efuse";
		mt6357regulator = "/pwrap@1000d000/main_pmic/mt6357regulator";
		mt_pmic_vs1_buck_reg = "/pwrap@1000d000/main_pmic/mt6357regulator/buck_vs1";
		mt_pmic_vmodem_buck_reg = "/pwrap@1000d000/main_pmic/mt6357regulator/buck_vmodem";
		mt_pmic_vcore_buck_reg = "/pwrap@1000d000/main_pmic/mt6357regulator/buck_vcore";
		mt_pmic_vproc_buck_reg = "/pwrap@1000d000/main_pmic/mt6357regulator/buck_vproc";
		mt_pmic_vpa_buck_reg = "/pwrap@1000d000/main_pmic/mt6357regulator/buck_vpa";
		mt_pmic_vfe28_ldo_reg = "/pwrap@1000d000/main_pmic/mt6357regulator/ldo_vfe28";
		mt_pmic_vxo22_ldo_reg = "/pwrap@1000d000/main_pmic/mt6357regulator/ldo_vxo22";
		mt_pmic_vrf18_ldo_reg = "/pwrap@1000d000/main_pmic/mt6357regulator/ldo_vrf18";
		mt_pmic_vrf12_ldo_reg = "/pwrap@1000d000/main_pmic/mt6357regulator/ldo_vrf12";
		mt_pmic_vefuse_ldo_reg = "/pwrap@1000d000/main_pmic/mt6357regulator/ldo_vefuse";
		mt_pmic_vcn33_bt_ldo_reg = "/pwrap@1000d000/main_pmic/mt6357regulator/ldo_vcn33_bt";
		mt_pmic_vcn33_wifi_ldo_reg = "/pwrap@1000d000/main_pmic/mt6357regulator/ldo_vcn33_wifi";
		mt_pmic_vcn28_ldo_reg = "/pwrap@1000d000/main_pmic/mt6357regulator/ldo_vcn28";
		mt_pmic_vcn18_ldo_reg = "/pwrap@1000d000/main_pmic/mt6357regulator/ldo_vcn18";
		mt_pmic_vcama_ldo_reg = "/pwrap@1000d000/main_pmic/mt6357regulator/ldo_vcama";
		mt_pmic_vcamd_ldo_reg = "/pwrap@1000d000/main_pmic/mt6357regulator/ldo_vcamd";
		mt_pmic_vcamio_ldo_reg = "/pwrap@1000d000/main_pmic/mt6357regulator/ldo_vcamio";
		mt_pmic_vldo28_ldo_reg = "/pwrap@1000d000/main_pmic/mt6357regulator/ldo_vldo28";
		mt_pmic_vsram_others_ldo_reg = "/pwrap@1000d000/main_pmic/mt6357regulator/ldo_vsram_others";
		mt_pmic_vsram_proc_ldo_reg = "/pwrap@1000d000/main_pmic/mt6357regulator/ldo_vsram_proc";
		mt_pmic_vaux18_ldo_reg = "/pwrap@1000d000/main_pmic/mt6357regulator/ldo_vaux18";
		mt_pmic_vaud28_ldo_reg = "/pwrap@1000d000/main_pmic/mt6357regulator/ldo_vaud28";
		mt_pmic_vio28_ldo_reg = "/pwrap@1000d000/main_pmic/mt6357regulator/ldo_vio28";
		mt_pmic_vio18_ldo_reg = "/pwrap@1000d000/main_pmic/mt6357regulator/ldo_vio18";
		mt_pmic_vdram_ldo_reg = "/pwrap@1000d000/main_pmic/mt6357regulator/ldo_vdram";
		mt_pmic_vmc_ldo_reg = "/pwrap@1000d000/main_pmic/mt6357regulator/ldo_vmc";
		mt_pmic_vmch_ldo_reg = "/pwrap@1000d000/main_pmic/mt6357regulator/ldo_vmch";
		mt_pmic_vemc_ldo_reg = "/pwrap@1000d000/main_pmic/mt6357regulator/ldo_vemc";
		mt_pmic_vsim1_ldo_reg = "/pwrap@1000d000/main_pmic/mt6357regulator/ldo_vsim1";
		mt_pmic_vsim2_ldo_reg = "/pwrap@1000d000/main_pmic/mt6357regulator/ldo_vsim2";
		mt_pmic_vibr_ldo_reg = "/pwrap@1000d000/main_pmic/mt6357regulator/ldo_vibr";
		mt_pmic_vusb33_ldo_reg = "/pwrap@1000d000/main_pmic/mt6357regulator/ldo_vusb33";
		mtk_rtc = "/pwrap@1000d000/main_pmic/mtk_rtc";
		fg_init = "/pwrap@1000d000/main_pmic/mtk_rtc/fg_init";
		fg_soc = "/pwrap@1000d000/main_pmic/mtk_rtc/fg_soc";
		ext_32k = "/pwrap@1000d000/main_pmic/mtk_rtc/ext_32k";
		pmic_codec = "/pwrap@1000d000/main_pmic/pmic_codec";
		clock_buffer_ctrl = "/pwrap@1000d000/main_pmic/clock_buffer_ctrl";
		scp = "/scp@10500000";
		keypad = "/kp@10010000";
		mrdump_ext_rst = "/mrdump_ext_rst";
		touch = "/touch";
		accdet = "/accdet";
		goodix_fp = "/fingerprint";
		dvfsrc = "/dvfsrc@10012000";
		dvfsrc_freq_opp2 = "/dvfsrc@10012000/opp2";
		dvfsrc_freq_opp1 = "/dvfsrc@10012000/opp1";
		dvfsrc_freq_opp0 = "/dvfsrc@10012000/opp0";
		timer = "/timer@10017000";
		iommu = "/m4u@10205000";
		hwrng = "/hwrng";
		ccifdriver = "/ccifdriver@10209000";
		cldmadriver = "/cldmadriver@10014000";
		mddriver = "/mddriver@10014000";
		md_auxadc = "/md_auxadc";
		gce = "/gce@10238000";
		gce_mbox = "/gce_mbox@10238000";
		auxadc = "/auxadc@11001000";
		apdma = "/dma-controller@11000580";
		uart0 = "/serial@11020000";
		uart1 = "/serial@11030000";
		pwm = "/pwm@11006000";
		i2c_common = "/i2c_common";
		i2c0 = "/i2c0@11007000";
		i2c1 = "/i2c1@11008000";
		i2c2 = "/i2c2@11009000";
		i2c3 = "/i2c3@1100f000";
		i2c4 = "/i2c4@11011000";
		i2c5 = "/i2c5@11016000";
		i2c6 = "/i2c6@1100d000";
		i2c7 = "/i2c7";
		i2c8 = "/i2c8";
		i2c9 = "/i2c9";
		spi0 = "/spi0@1100a000";
		tboard_thermistor1 = "/thermal-sensor1";
		tboard_thermistor2 = "/thermal-sensor2";
		tboard_thermistor3 = "/thermal-sensor3";
		consys = "/consys@18002000";
		spi1 = "/spi1@11010000";
		spi2 = "/spi2@11012000";
		spi3 = "/spi3@11013000";
		spi4 = "/spi4@11014000";
		spi5 = "/spi5@11015000";
		usb = "/usb0@11200000";
		msdc0 = "/msdc@11230000";
		msdc1 = "/msdc@11240000";
		msdc2 = "/msdc@11250000";
		msdc3 = "/msdc@11260000";
		msdc1_ins = "/msdc1_ins@0";
		audclk = "/audclk@11220000";
		audio = "/audio@11220000";
		audgpio = "/mt_soc_dl1_pcm@11220000";
		btcvsd_snd = "/mtk-btcvsd-snd@18050000";
		mipi_rx_ana_csi0a = "/mipi_rx_ana_csi0a@11c10000";
		mipi_rx_ana_csi0b = "/mipi_rx_ana_csi0b@11c11000";
		mipi_rx_ana_csi1a = "/mipi_rx_ana_csi1a@11c12000";
		mipi_rx_ana_csi1b = "/mipi_rx_ana_csi1b@11c13000";
		mipi_rx_ana_csi2a = "/mipi_rx_ana_csi2a@11c14000";
		mipi_rx_ana_csi2b = "/mipi_rx_ana_csi2b@11c15000";
		efuse = "/efuse@11c50000";
		efuse_segment = "/efuse@11c50000/segment@78";
		cpu_freq_segment = "/efuse@11c50000/segment@1c";
		thermal_efuse = "/efuse@11c50000/segment@190";
		efuse_analog7 = "/efuse@11c50000/efuse_analog7@1ac";
		mfg_clark = "/mfg_clark@13000000";
		mfg_cfg = "/mfg_cfg@13ffe000";
		gpufreq = "/gpufreq";
		ged = "/ged";
		mmsys_config = "/mmsys_config@14000000";
		dispsys_config = "/dispsys_config@14000000";
		nfc = "/nfc";
		irq_nfc = "/irq_nfc";
		disp_mutex0 = "/disp_mutex0@14001000";
		smi_common = "/smi_common@14002000";
		smi_larb0 = "/smi_larb0@14003000";
		mdp_rdma0 = "/mdp_rdma0@14004000";
		mdp_ccorr = "/mdp_ccorr0@14005000";
		mdp_rsz0 = "/mdp_rsz0@14006000";
		mdp_rsz1 = "/mdp_rsz1@14007000";
		mdp_wdma0 = "/mdp_wdma0@14008000";
		mdp_wrot0 = "/mdp_wrot0@14009000";
		mdp_tdshp0 = "/mdp_tdshp0@1400a000";
		disp_color0 = "/disp_color0@1400f000";
		mtkfb = "/mtkfb@0";
		dsi_te = "/dsi_te";
		mm_mutex = "/mm_mutex@14016000";
		camsys = "/camsys@15000000";
		smi_larb2 = "/smi_larb2@15001000";
		kd_camera_hw1 = "/kd_camera_hw1@15040000";
		camera_af_hw_node = "/camera_af_hw_node";
		flashlights_aw36515 = "/flashlights_aw36515";
		flashlight_core = "/flashlight_core";
		flashlights_mt6370 = "/flashlights_mt6370";
		flashlights_aw3644 = "/flashlights_aw3644";
		vcodecsys = "/vcodecsys@17000000";
		venc_gcon = "/venc_gcon@17000000";
		smi_larb1 = "/smi_larb1@17010000";
		otg_iddig = "/otg_iddig";
		odm = "/odm";
		tran_battery = "/tran_battery";
		tran_battery_aging = "/tran_battery_aging";
		mt_charger = "/mt_charger";
		lk_charger = "/lk_charger";
		pdc = "/pdc";
		pe4 = "/pe4";
		charger = "/charger";
		pmic_clock_buffer_ctrl = "/pmic_clock_buffer_ctrl";
		pbm = "/pbm";
		radio_md_cfg = "/radio_md_cfg";
		dynamic_options = "/dynamic_options";
		cm_mgr = "/cm_mgr@10200000";
	};
};
